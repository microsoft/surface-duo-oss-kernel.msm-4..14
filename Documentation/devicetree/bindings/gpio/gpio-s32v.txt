## Documentation/devicetree/bindings/pci/fsl,s32-pcie.txt
```
* NXP S32 PCIe interface *

This PCIe host controller is based on the Synopsys DesignWare PCIe IP
and thus inherits all the common properties defined in designware-pcie.txt.

Required properties:
- compatible:
	- "fsl,s32v234-pcie", for S32V234 SoCs
	- "fsl,s32gen1-pcie", for S32Gen1 SoCs
- reg: base address and length of the PCIe controller
- interrupts: A list of interrupt outputs of the controller. Must contain an
  entry for each entry in the interrupt-names property.
- interrupt-names: Must include the following entries:
	- "msi": The interrupt that is asserted when an MSI is received
Optional:
- msi-parent: Use this option pointing to the GIC controller node which will
  handle the MSIs. This property can be used only in Root Complex case.
  By default, MSIs are handled by iMSI-RX -Integrated MSI Receiver [AXI Bridge]-,
  an integrated MSI reception module in AXI Bridge which detects and terminates
  inbound MSI requests (received on the RX wire). These MSIs will no longer appear
  on the AXI bus. The disadvantage of this approach is that only one hardware
  interrupt can be used, the one named "msi" from the interrupt list, which will
  make impossible MSIs balancing between several cores.
  If one wants to use more than one hardware interrupt, iMSI-RX should be skipped
  and MSIs should be generated as SPIs.
  This can be achived by adding the "msi-parent" property. The msi-parent
  should be declared as "msi-controller" and the list of available SPIs that
  can be used will be declared using "mbi-ranges".

Example:

	pcie: pcie@0x72000000 {
		compatible = "fsl,s32v234-pcie";
		reg = <0 0x72ffc000 0 0x4000>, <0 0x72f00000 0 0x80000>;
		reg-names = "dbi", "config";
		#address-cells = <3>;
		#size-cells = <2>;
		device_type = "pci";
		ranges = <0x81000000 0 0          0 0x72f80000 0 0x00010000 /* downstream I/O */
			  0x82000000 0 0x72000000 0 0x72000000 0 0x00f00000>; /* non-prefetchable memory */
		num-lanes = <1>;
		bus-range = <0x0 0xff>;
		interrupts =  <0 103 4>, <0 104 4>, <0 105 4>;
		interrupt-names = "link_req_rst_not", "dma","msi";
		#interrupt-cells = <1>;
		interrupt-map-mask = <0 0 0 0x7>;
		interrupt-map = <0 0 0 1 &gic 0 108 4>,
				<0 0 0 2 &gic 0 107 4>,
				<0 0 0 3 &gic 0 106 4>,
				<0 0 0 4 &gic 0 105 4>;

		/* msi-parent = <&gic>; */
		status = "disabled";
	};
```

## Documentation/devicetree/bindings/pfe_reserved/fsl,s32g-pfe-ddr.txt
```
PFE BMU subsystem
-----------------

This binding describes the reserved memory for PFE.
The PFE BMU subsystem requires memory allocation under 0xB0000000,
so it can be added to the CMA subsystem and be linked with the
pfe driver.


Example:

	pfe_reserved: pfebufs@83400000 {
		compatible = "fsl,s32g-pfe-ddr";
		reg = <0 0x83400000 0 0xc00000>;
		no-map;
		status = "okay";
	};
```

## Documentation/devicetree/bindings/phy/fsl,s32gen1-serdes.yaml
```yaml
# SPDX-License-Identifier: (GPL-2.0-only OR BSD-2-Clause)
# Copyright 2021 NXP
%YAML 1.2
---
$id: "http://devicetree.org/schemas/phy/fsl,s32gen1-serdes.yaml#"
$schema: "http://devicetree.org/meta-schemas/core.yaml#"

title: S32GEN1 SerDes PHY Tree Bindings

maintainers:
  - Ghennadi Procopciuc <ghennadi.procopciuc@nxp.com>

description: |
  The SerDes subsystem on S32GEN1 chips includes two types of PHYs:
    * One PCIe PHY
	Supports various PCIe operation modes
    * Two Ethernet Physical Coding Sublayer (XPCS) controllers
	Supports various PCIe and Ethernet operation modes

  SerDes operation mode selects the enabled PHYs and speeds. Clock frequency
  must be adapted accordingly. Below table describes all possible operation
  modes.

  Mode  PCIe	XPCS0		XPCS1		PHY clock	Description
		SGMII		SGMII		  (MHz)
  -------------------------------------------------------------------------

  0	Gen3	N/A		N/A		100		Single PCIe

  1	Gen2	1.25Gbps	N/A		100		PCIe/SGMII
								bifurcation
  2	Gen2	N/A		1.25Gbps	100		PCIe/SGMII
								bifurcation
  3	N/A	1.25Gbps	1.25Gbps	100,125		SGMII
								bifurcation
	N/A	3.125Gbps	N/A     	125

properties:
  '#phy-cells':
    const: 3
    description: |
        - PHY Type. Can be PHY_TYPE_PCIE or PHY_TYPE_XPCS.
        - Instance number
        - SerDes Line (0 or 1)

  compatible:
    enum:
      - fsl,s32gen1-serdes

  clocks:
    description:
      A list of phandle and clock-specifier pairs for the clocks
      listed in clock-names.
    items:
      - description: AXI AMBA clock
      - description: Auxiliary clock for low power
      - description: APB interface clock
      - description: Reference clock
      - description: External reference clock. Optional clock. Its presence
                     informs the driver to use external reference clock
                     instead of the internal one, which is used by default.

  clock-names:
    items:
      - const: axi
      - const: aux
      - const: apb
      - const: ref
      - const: ext

  resets:
    description:
      A list of phandle and reset-specifier pairs for the resets
      listed in reset-names.
    items:
        - description: SerDes reset
        - description: PCIe reset

  reset-names:
    items:
      - const: serdes
      - const: pcie

  fsl,sys-mode:
    $ref: /schemas/types.yaml#/definitions/uint32
    description: |
      SerDes operational mode. See above table for possible values.

  reg:
    items:
      - description: Address and size of PCIE subsystem registers
      - description: Address and size of PCIE PHY subsystem registers
      - description: Address and size of XPCS0 access registers
      - description: Address and size of XPCS1 access registers

  reg-names:
    items:
      - const: ss_pcie
      - const: pcie_phy
      - const: xpcs0
      - const: xpcs1

required:
  - '#phy-cells'
  - compatible
  - clocks
  - clock-names
  - resets
  - reset-names
  - 'fsl,sys-mode'
  - reg
  - reg-names

additionalProperties: false

examples:
  - |
      #include <dt-bindings/clock/s32gen1-scmi-clock.h>
      #include <dt-bindings/clock/s32gen1-scmi-reset.h>
      #include <dt-bindings/phy/phy.h>

      serdes1: serdes@44180000 {
        #phy-cells = <3>;
        compatible = "fsl,s32gen1-serdes";
        clocks = <&clks S32GEN1_SCMI_CLK_SERDES_AXI>,
           <&clks S32GEN1_SCMI_CLK_SERDES_AUX>,
           <&clks S32GEN1_SCMI_CLK_SERDES_APB>,
           <&clks S32GEN1_SCMI_CLK_SERDES_REF>,
           <&serdes_125_ext>;
        clock-names = "axi", "aux", "apb", "ref", "ext";
        resets = <&clks S32GEN1_RST_SERDES1>, <&clks S32GEN1_RST_PCIE1>;
        reset-names = "serdes", "pcie";
        fsl,sys-mode = <3>;
        reg = <0x0 0x44180000 0x0 0x108>,
              <0x0 0x44183008 0x0 0x10>,
              <0x0 0x44182000 0x0 0x800>,
              <0x0 0x44182800 0x0 0x800>;
        reg-names = "ss_pcie", "pcie_phy", "xpcs0", "xpcs1";
        status = "okay";
      };
```
