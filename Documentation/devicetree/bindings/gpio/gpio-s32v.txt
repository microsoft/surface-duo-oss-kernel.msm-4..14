## Documentation/devicetree/bindings/gpio/gpio-s32v.txt
```
* Freescale S32V SIUL2 GPIO controller

Required properties:
- compatible : Should be "fsl,s32v234-siul2-gpio", "fsl,s32gen1-siul2-gpio"
- reg : 4 or 5 ranges. 4 for nodes without EIRQ management and 5 for others.
	Ranges index meaning :
		- 0 Address and length of the Parallel GPIO Pad Data Out Register
		- 1 Address and length of the Parallel GPIO Pad Data Input Register
		- 2 and 3 are unused, reserved for Pad Data Output/Input Registers.
		- 4 Address and length of the EIRQ controller.
- interrupts : Should be the port interrupt shared by all 32 EIRQs
- gpio-controller : Marks the device node as a gpio controller.
- #gpio-cells : Should be two.  The first cell is the pin number and
  the second cell is used to specify the gpio polarity:
      0 = active high
      1 = active low
- interrupt-controller: Marks the device node as an interrupt controller.
- gpio-ranges : Interaction with the PINCTRL subsystem.

Example:

gpioeirq: siul2-gpio@4006C000 {
	compatible = "fsl,s32v234-siul2-gpio";
	gpio-controller;
	#gpio-cells = <2>;
		/* GPIO 0-31 */
	gpio-ranges = <&pinctrl 0 0 32>,
		/* EIRQ pins */
		<&pinctrl 590 590 32>;
		/* Output pad */
	reg = <0x4 0x0 0x0 0x4>,
		/* Input Pad */
		<0x4 0x40 0x0 0x4>,
		/* Reserved */
		<0x2 0x0 0x0 0x1C>,
		<0x3 0x0 0x0 0x1C>,
		/* EIRQ */
		<0x0 0x0 0x0 0xC4>;
	interrupt-controller;
	interrupts = <0 70 4>;
	status = "disabled";
};
```

## Documentation/devicetree/bindings/gpu/fsl,s32v234-gpu.txt
```
Vivante GC3000 Graphics Processing Unit

Required properties:
- compatible: "fsl,s32v234-gpu"
- reg: Physical base address and length of the controller's registers,
       then the start of physical RAM addresses to be used by the GPU.
- interrupts: Must contain an entry for the GPU interrupt
- pu-supply: regulator for supply voltage.
- clocks: Must contain an entry for each entry in clock-names.
  See ../clocks/clock-bindings.txt for details.
- clock-names: Must include the following entries:
  - gpu3d_clk
  - gpu3d_shader_clk
- resets: Must contain an entry for each entry in reset-names.
  See ../reset/reset.txt for details.
- reset-names: Must include the following entries:
  - gpu3d

Example:

	gpu: gpu@40020000 {
		compatible = "fsl,s32v234-gpu";
		reg = <0x0 0x40020000 0x0 0x1000>,
			  <0x0 0xC0000000 0x0 0x0>;
		reg-names = "iobase_3d", "phys_baseaddr";
		interrupts = <0 101 0x04>;
		interrupt-names = "irq_3d";
		clocks = <&clks S32V234_CLK_GPU>,
				 <&clks S32V234_CLK_GPU_SHD>;
		clock-names = "gpu3d_clk", "gpu3d_shader_clk";
		resets = <&src 0>;
		reset-names = "gpu3d";
		pu-supply = <&pu_dummy>; /* ldo-bypass:use pu_dummy
							  if VDDSOC share with VDDPU */
	};
```

## Documentation/devicetree/bindings/iio/adc/s32v234-adc.txt
```
NXP S32 Analog-to-Digital Converter (SAR-ADC)

Required properties:
- compatible: Should be "fsl,s32v234-adc" or "fsl,s32gen1-adc"
- reg: Location and length of the register set for the device
- interrupts: The interrupt for the device
- clocks: ADC clock input (bus clock)
- clock-names: Input clock name; should be "adc"
- vref: Reference voltage (in millivolts)

Examples:
saradc0: adc@4004d000 {
	compatible = "fsl,s32v234-adc";
	reg = <0x0 0x4004d000 0x0 0x1000>;
	interrupts = <0 39 4>;
	clocks = <&clks S32V234_CLK_SARADC0>;
	clock-names = "adc";
	vref = <1800>;
};

saradc0: adc@401f8000 {
	compatible = "fsl,s32gen1-adc";
	reg = <0x0 0x401f8000 0x0 0x1000>;
	interrupts = <0 70 4>;
	clocks = <&clks S32GEN1_CLK_PER>;
	clock-names = "adc";
	vref = <1800>;
	status = "okay";
};
```

## Documentation/devicetree/bindings/iommu/arm,smmu.txt
```
* ARM System MMU Architecture Implementation

ARM SoCs may contain an implementation of the ARM System Memory
Management Unit Architecture, which can be used to provide 1 or 2 stages
of address translation to bus masters external to the CPU.

The SMMU may also raise interrupts in response to various fault
conditions.

** System MMU required properties:

- compatible    : Should be one of:

                        "arm,smmu-v1"
                        "arm,smmu-v2"
                        "arm,mmu-400"
                        "arm,mmu-401"
                        "arm,mmu-500"

                  depending on the particular implementation and/or the
                  version of the architecture implemented.

- reg           : Base address and size of the SMMU.

- #global-interrupts : The number of global interrupts exposed by the
                       device.

- interrupts    : Interrupt list, with the first #global-irqs entries
                  corresponding to the global interrupts and any
                  following entries corresponding to context interrupts,
                  specified in order of their indexing by the SMMU.

                  For SMMUv2 implementations, there must be exactly one
                  interrupt per context bank. In the case of a single,
                  combined interrupt, it must be listed multiple times.

- #iommu-cells  : See Documentation/devicetree/bindings/iommu/iommu.txt
                  for details. Should be 1, where each "iommus" entry on
                  the device represents a distinct stream ID emitted by
                  that device into the relevant SMMU. Cells beyond 1 are
                  reserved for future use.

** System MMU optional properties:

- dma-coherent  : Present if page table walks made by the SMMU are
                  cache coherent with the CPU.

                  NOTE: this only applies to the SMMU itself, not
                  masters connected upstream of the SMMU.

- calxeda,smmu-secure-config-access : Enable proper handling of buggy
                  implementations that always use secure access to
                  SMMU configuration registers. In this case non-secure
                  aliases of secure registers have to be used during
                  SMMU configuration.

** Deprecated properties:

- mmu-masters (deprecated in favour of the generic "iommus" binding) :
                  A list of phandles to device nodes representing bus
                  masters for which the SMMU can provide a translation
                  and their corresponding StreamIDs (see example below).
                  Each device node linked from this list must have a
                  "#stream-id-cells" property, indicating the number of
                  StreamIDs associated with it.

** Example:

        smmu1: iommu {
                compatible = "arm,smmu-v1";
                reg = <0xba5e0000 0x10000>;
                #global-interrupts = <2>;
                interrupts = <0 32 4>,
                             <0 33 4>,
                             <0 34 4>, /* This is the first context interrupt */
                             <0 35 4>,
                             <0 36 4>,
                             <0 37 4>;
                #iommu-cells = <1>;
        };

        /* device with two stream IDs, 0 and 7 */
        master {
                iommus = <&smmu1 0>,
                         <&smmu1 7>;
        };
```

## Documentation/devicetree/bindings/iommu/msm,iommu-v0.txt
```
* QCOM IOMMU

The QCOM IOMMU is an implementation compatible with the ARM VMSA short
descriptor page tables. It provides address translation for bus masters outside
of the CPU, each connected to the IOMMU through a port called micro-TLB.

Required Properties:

  - compatible: Must contain "qcom,iommu-v0".
  - reg: Base address and size of the IOMMU registers.
  - interrupts: Specifiers for the MMU fault interrupts. For instances that
    support secure mode two interrupts must be specified, for non-secure and
    secure mode, in that order. For instances that don't support secure mode a
    single interrupt must be specified.
  - #iommu-cells: This is the total number of stream ids that a master would
		  use during transactions which will be specified as a list
		  as a part of iommus property below.
  - ncb: The total number of context banks in the IOMMU.
  - clocks	: List of clocks to be used during SMMU register access. See
		  Documentation/devicetree/bindings/clock/clock-bindings.txt
		  for information about the format. For each clock specified
		  here, there must be a corresponding entry in clock-names
		  (see below).

  - clock-names	: List of clock names corresponding to the clocks specified in
		  the "clocks" property (above). See
		  Documentation/devicetree/bindings/clock/clock-bindings.txt
		  for more info.

Each bus master connected to an IOMMU must reference the IOMMU in its device
node with the following property:

  - iommus: A reference to the IOMMU in multiple cells. The first cell is a
	    phandle to the IOMMU and the second cell is the list of the
	    stream ids used by the device.

Example: mdp iommu and its bus master

                mdp_port0: qcom,iommu@7500000 {
			compatible = "msm,iommu-v0";
			#iommu-cells = <2>;
			clock-names =
			    "smmu_pclk",
			    "iommu_clk";
			clocks =
			    <&mmcc SMMU_AHB_CLK>,
			    <&mmcc MDP_AXI_CLK>;
			reg = <0x07500000 0x100000>;
			interrupts =
			    <GIC_SPI 63 0>,
			    <GIC_SPI 64 0>;
			ncb = <2>;
		};

		mdp: qcom,mdp@5100000 {
			compatible = "qcom,mdp";
			...
			iommus = <&mdp_port0 0 2>;
		};
```

## Documentation/devicetree/bindings/mailbox/arm-smc.yaml
```yaml
# SPDX-License-Identifier: (GPL-2.0 OR BSD-2-Clause)
%YAML 1.2
---
$id: http://devicetree.org/schemas/mailbox/arm-smc.yaml#
$schema: http://devicetree.org/meta-schemas/core.yaml#

title: ARM SMC Mailbox Interface

maintainers:
  - Peng Fan <peng.fan@nxp.com>

description: |
  This mailbox uses the ARM smc (secure monitor call) or hvc (hypervisor
  call) instruction to trigger a mailbox-connected activity in firmware,
  executing on the very same core as the caller. The value of r0/w0/x0
  the firmware returns after the smc call is delivered as a received
  message to the mailbox framework, so synchronous communication can be
  established. The exact meaning of the action the mailbox triggers as
  well as the return value is defined by their users and is not subject
  to this binding.

  One example use case of this mailbox is the SCMI interface, which uses
  shared memory to transfer commands and parameters, and a mailbox to
  trigger a function call. This allows SoCs without a separate management
  processor (or when such a processor is not available or used) to use
  this standardized interface anyway.

  This binding describes no hardware, but establishes a firmware interface.
  Upon receiving an SMC using the described SMC function identifier, the
  firmware is expected to trigger some mailbox connected functionality.
  The communication follows the ARM SMC calling convention.
  Firmware expects an SMC function identifier in r0 or w0. The supported
  identifier is listed in the the arm,func-id property as described below.
  The firmware can return one value in the first SMC result register,
  it is expected to be an error value, which shall be propagated to the
  mailbox client.

  Any core which supports the SMC or HVC instruction can be used, as long
  as a firmware component running in EL3 or EL2 is handling these calls.

properties:
  compatible:
    oneOf:
      - description:
          For implementations using ARM SMC instruction.
        const: arm,smc-mbox

      - description:
          For implementations using ARM HVC instruction.
        const: arm,hvc-mbox

  "#mbox-cells":
    const: 0

  arm,func-id:
    description: |
      An single 32-bit value specifying the function ID used by the mailbox.
      The function ID follows the ARM SMC calling convention standard.
    $ref: /schemas/types.yaml#/definitions/uint32

required:
  - compatible
  - "#mbox-cells"
  - arm,func-id

examples:
  - |
    sram@93f000 {
      compatible = "mmio-sram";
      reg = <0x0 0x93f000 0x0 0x1000>;
      #address-cells = <1>;
      #size-cells = <1>;
      ranges = <0x0 0x93f000 0x1000>;

      cpu_scp_lpri: scp-shmem@0 {
        compatible = "arm,scmi-shmem";
        reg = <0x0 0x200>;
      };
    };

    smc_tx_mbox: tx_mbox {
      #mbox-cells = <0>;
      compatible = "arm,smc-mbox";
      arm,func-id = <0xc20000fe>;
    };

    firmware {
      scmi {
        compatible = "arm,scmi";
        mboxes = <&smc_tx_mbox>;
        mbox-names = "tx";
        shmem = <&cpu_scp_lpri>;
      };
    };

...
```
