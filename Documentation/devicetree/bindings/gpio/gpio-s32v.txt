## Documentation/devicetree/bindings/net/can/fsl-flexcan.txt
```
Flexcan CAN controller on Freescale's ARM and PowerPC system-on-a-chip (SOC).

Required properties:

- compatible : Should be "fsl,<processor>-flexcan"

  An implementation should also claim any of the following compatibles
  that it is fully backwards compatible with:

  - fsl,p1010-flexcan
  - fsl,s32v234-flexcan
  - fsl,s32gen1-flexcan

- reg : Offset and length of the register set for this device
- interrupts : Interrupt tuple(s) for this device. If interrupt-names are
               missing, these should specify, in order:
               - for S32V234:
                 1. ERRINT | BOFFINT | BOFFDONEINT | TWRNINT | RWRNINT;
                 2. MB0-63 interrupts;
               - for S32GEN1:
                 1. BOFFINT | BOFFDONEINT | TWRNINT | RWRNINT;
                 2. ERRINT;
                 3. MB0-7 interrupts;
                 4. MB8-127 interrupts;
               - for all the other SoCs:
                 1. all interrupts combined.

Optional properties:

- clock-frequency : The oscillator frequency driving the flexcan device

- xceiver-supply: Regulator that powers the CAN transceiver

- big-endian: This means the registers of FlexCAN controller are big endian.
              This is optional property.i.e. if this property is not present in
              device tree node then controller is assumed to be little endian.
              if this property is present then controller is assumed to be big
              endian.

- fsl,stop-mode: register bits of stop mode control, the format is
		 <&gpr req_gpr req_bit ack_gpr ack_bit>.
		 gpr is the phandle to general purpose register node.
		 req_gpr is the gpr register offset of CAN stop request.
		 req_bit is the bit offset of CAN stop request.
		 ack_gpr is the gpr register offset of CAN stop acknowledge.
		 ack_bit is the bit offset of CAN stop acknowledge.

- fsl,clk-source: Select the clock source to the CAN Protocol Engine (PE).
		  It's SoC Implementation dependent. Refer to RM for detailed
		  definition. If this property is not set in device tree node
		  then driver selects clock source 1 by default.
		  0: clock source 0 (oscillator clock)
		  1: clock source 1 (peripheral clock)

- wakeup-source: enable CAN remote wakeup

- interrupt-names: Allows the interrupt specifiers in "interrupts" to be stated
                   in any order, one for each name in here. Can contain:
                   "state" - BOFFINT | BOFFDONEINT | TWRNINT | RWRNINT;
                   "berr" - ERRINT;
                   "mb_0-7" - MB0-7 interrupts;
                   "mb_8-127" - MB8-127 interrupts;
                   "state-berr" - ERRINT | BOFFINT | BOFFDONEINT | TWRNINT |
                                  RWRNINT;
                   "mb" - all MB interrupts;
                   "all" - all interrupts combined.

- s32v234-ocotp: On S32V234 SoCs, phandle pointer to the On-Chip One Time
                 Programmable (OCOTP) node, if CAN FD support is desired on
                 compatible parts

Examples:

	can@1c000 {
		compatible = "fsl,p1010-flexcan";
		reg = <0x1c000 0x1000>;
		interrupts = <48 0x2>;
		interrupt-parent = <&mpic>;
		clock-frequency = <200000000>; // filled in by bootloader
		fsl,clk-source = <0>; // select clock source 0 for PE
	};

	flexcan@40055000 {
		compatible = "fsl,s32v234-flexcan";
		reg = <0x0 0x40055000 0x0 0x1000>;
		interrupts = <0 41 4>,
			     <0 42 4>;
		interrupt-names = "state-berr", "mb";
		clocks = <&clks S32V234_CLK_CAN0>,
			 <&clks S32V234_CLK_CAN>;
		clock-names = "ipg", "per";
		s32v234-ocotp = <&ocotp>;
	};
```

## Documentation/devicetree/bindings/net/can/fsl-llcelogger.txt
```
LLCE engine on NXP's ARM based SOCs.

Required properties:

- compatible : Should be "fsl,s32g-llcelogger"
- reg : Offset and length of the register set or shared memory regions
		for this device (LLCE HW IP)
- reg-names: Name for the mapped registers or shared memory regions
- interrupts : Interrupt tuple for this device - CAN frame processed.

Examples:
	llce: llcelogger@43000000 {
		compatible = "fsl,s32g-llcelogger";
		reg = <0x0 0x43000000 0x0 0x1000000>,
			<0x0 0x43800000 0x0 0x3D000>,
			<0x0 0x43A0C40C 0x0 0x4>,
			<0x0 0x43A0C424 0x0 0x4>,
			<0x0 0x43A0C014 0x0 0x4>,
			<0x0 0x43A0C408	0x0 0x4>;
		reg-names = "llce-range",
			"llce-shared-mem",
			"fifo-ier",
			"fifo-pop0",
			"fifo-push0",
			"fifo-status1";
		interrupts = <0x0 184 0x4>;
	};
```

## Documentation/devicetree/bindings/net/can/microchip,mcp25xxfd.yaml
```yaml
# SPDX-License-Identifier: (GPL-2.0 OR BSD-2-Clause)
%YAML 1.2
---
$id: http://devicetree.org/schemas/net/can/microchip,mcp25xxfd.yaml#
$schema: http://devicetree.org/meta-schemas/core.yaml#

title: Microchip MCP25XXFD stand-alone CAN controller binding

maintainers:
  -  Martin Sperl <kernel@martin.sperl.org>
  -  Manivannan Sadhasivam <manivannan.sadhasivam@linaro.org>

properties:
  compatible:
    const: microchip,mcp2517fd

  reg:
    maxItems: 1

  clocks:
    maxItems: 1

  interrupts:
    maxItems: 1

  gpio-controller: true

  "#gpio-cells":
    const: 2

  vdd-supply:
    description: Regulator that powers the CAN controller

  xceiver-supply:
    description: Regulator that powers the CAN transceiver

  microchip,clock-out-div:
    description: Clock output pin divider
    allOf:
      - $ref: /schemas/types.yaml#/definitions/uint32
    enum: [0, 1, 2, 4, 10]
    default: 10

  microchip,clock-div2:
    description: Divide the internal clock by 2
    type: boolean

  microchip,gpio-open-drain:
    description: Enable open-drain for all pins
    type: boolean

required:
  - compatible
  - reg
  - clocks
  - interrupts
  - gpio-controller
  - vdd-supply
  - xceiver-supply

additionalProperties: false

examples:
  - |
    spi {
           #address-cells = <1>;
           #size-cells = <0>;

           can0: can@1 {
                   compatible = "microchip,mcp2517fd";
                   reg = <1>;
                   clocks = <&clk24m>;
                   interrupt-parent = <&gpio4>;
                   interrupts = <13 0x8>;
                   vdd-supply = <&reg5v0>;
                   xceiver-supply = <&reg5v0>;
                   gpio-controller;
                   #gpio-cells = <2>;
           };
    };

...
```

## Documentation/devicetree/bindings/net/can/nxp,s32g274a-llce-can.yaml
```yaml
# SPDX-License-Identifier: (GPL-2.0-only or BSD-2-Clause)
%YAML 1.2
---
$id: http://devicetree.org/schemas/net/can/nxp,s32g274a-llce-can.yaml#
$schema: http://devicetree.org/meta-schemas/core.yaml#

title: LLCE CAN controller on NXP's SoC

maintainers:
  - Ghennadi Procopciuc <ghennadi.procopciuc@nxp.com>

description: |
  The Low Latency Communications Engine (LLCE) controls the traditional automotive
  communication interfaces such as CAN, LIN, FlexRay, and SPI.

  There are multiple components involved in LLCE CAN:
    * LLCE firmware
    * LLCE firmware loader
    * LLCE CAN driver which implements SocketCAN interface

  This file will only cover the CAN interface.

  The name of the node must be suffixed with a number which will be used as
  interface id.

  E.g. 'llce_can13' will generate 'llcecan13'. This is used to have an 1:1
       mapping between HW IDs and the interfaces exposed by the driver.

properties:
  compatible:
    const: nxp,s32g274a-llce-can

  mbox-names:
    items:
      - const: config
      - const: rx
      - const: tx

  mboxes:
    description: |
      List of <&phandle type channel>.
      Where 'type' is:
        * S32G274_LLCE_CAN_CONF_MB - Configuration channel
        * S32G274_LLCE_CAN_RX_MB   - RX channel
        * S32G274_LLCE_CAN_TX_MB   - TX channel
      'channel' is a part of the range: [0-15] (max 16 CAN controllers)
      (see mailbox/nxp,s32g274a-llce-mailbox.yaml)

  clock-names:
    const: can_pe

  clocks:
    description: LLCE CAN clock


  pinctrl-0:
    description:
      A phandle to the default pinctrl state.

  pinctrl-names:
    const: default
    description:
      A pinctrl state named "default" must be defined.

required:
  - compatible
  - mboxes
  - mbox-names
  - clock-names
  - clocks
  - pinctrl-names
  - pinctrl-0

unevaluatedProperties: false
additionalProperties: false

examples:
  - |
    #include <dt-bindings/clock/s32g274a-scmi-clock.h>
    #include <dt-bindings/mailbox/nxp-llce-mb.h>
    llce_can0: llce_can0 {
        compatible = "nxp,s32g274a-llce-can";
        mboxes = <&llce_mb S32G274_LLCE_CAN_CONF_MB 0>,
             <&llce_mb S32G274_LLCE_CAN_RX_MB 0>,
             <&llce_mb S32G274_LLCE_CAN_TX_MB 0>;
        mbox-names = "config", "rx", "tx";
        clocks = <&clks S32G274A_SCMI_CLK_LLCE_CAN_PE>;
        clock-names = "can_pe";
        pinctrl-names = "default";
        pinctrl-0 = <&pinctrl0_llce_can0>, <&pinctrl1_llce_can0>;
        status = "disabled";
    };
```

## Documentation/devicetree/bindings/net/fsl-s32cc-dwmac.txt
```
* NXP S32G/R GMAC ethernet controller

This device is a platform glue layer for stmmac.
Please see stmmac.txt for the other unchanged properties.

Required properties:
- compatible: must be the following string:
		"fsl,s32cc-dwmac"
- reg: two tuples are required:
  1) address and length of the register set for the device.
  2) address and length of the MAC control register
- interrupts: interrupt for the device
- interrupt-names: must be "macirq"
- clocks: A phandle to the reference clock for this device
- clock-names: must be "stmmaceth" and "pclk"
- phy-mode: See ethernet.txt
- phy-handle: See ethernet.txt

Optional child node of emac:
- mdio bus node: should be named mdio with compatible "snps,dwmac-mdio"

The device node referenced by "phy" or "phy-handle" must be a child node
of the mdio node. See phy.txt for the generic PHY bindings.

Example:
gmac0: ethernet@4033c000 {
	compatible = "fsl,s32cc-dwmac";
	reg = <0x0 0x4033c000 0x0 0x2000>, /* gmac IP */
	      <0x0 0x4007C004 0x0 0x4>;    /* S32 CTRL_STS reg */
	interrupt-parent = <&gic>;
	interrupts = <0 57 4>;
	interrupt-names = "macirq";
	tx-fifo-depth = <20480>;
	rx-fifo-depth = <20480>;
	clocks = <&clks S32GEN1_CLK_XBAR>, <&clks S32GEN1_CLK_XBAR>,
		     <&clks S32GEN1_CLK_GMAC_0_TX>;
	clock-names = "stmmaceth", "pclk", "tx";
	phy-handle = <&rgmii_phy>;
	phy-mode = "rgmii";
	gmac0_mdio: mdio0 {
		compatible = "snps,dwmac-mdio";
		#address-cells = <1>;
		#size-cells = <0>;
		rgmii_phy: ethernet-phy@1 {
			reg = <1>;
		};
	};
};
```

## Documentation/devicetree/bindings/net/nxp,sja11050switch.txt
```
SJA1105 Ethernet Switch controller from NXP

Properties of the sja1105p node:

- "compatible"
	- String that is matched against the of_device_id table "sja1105p_dt_ids"
	in sja1105p_init.c. Used to determine the switch type
	- values: "nxp,sja1105p-switch"
- "firmware_name" (optional)
	- Name of the firmware (in /lib/firmware) to be loaded for that switch
- "spi-max-frequency"
	- the max SPI frequency
- "spi-cpha"
	- SPI configuration to be used
- "reg"
	- address of chip select
- "port-X"
	- port node specifies the configuration of the nth port of the switch.
	- See bellow for components


Properties of the port-X child node:

- "is-host" (optional)
	- Determines if the port is a host port or not
- "null-phy" (optional)
	-Determines if the port has a phy connected to it or not
- "phy-ref" (optional)
	- phandle to the connected ethernet phy
	- Must be 0x0 in case there is no phy connected to it (for example a
	 host port or a cascaded port)
- "logical-port-num" (optional)
	- logical port number, used for the port mapping
	- Must be 0xff in case the port is a cascaded port

Example:

sja1105p@0 {
	compatible = "nxp,sja1105p-switch";
	firmware_name = "sja1105_cfg_mra2lt_1-2.bin";
	spi-max-frequency = <0x3D0900>;
	spi-cpha;
	fsl,spi-cs-sck-delay = <100>;
	fsl,spi-sck-cs-delay = <100>;

	reg = <0>;
	port-0 {
		is-host = <0x1>;
		null-phy = <0x1>;
		phy-ref = < 0 >;
	};
	port-1 {
		is-host = <0x0>;
		null-phy = <0x1>;
		phy-ref = < 0 >;
	};
	port-2 {
		is-host = <0x0>;
		null-phy = <0x1>;
		phy-ref = < 0 >;
	};
	port-3 {
		is-host = <0x0>;
		null-phy = <0x1>;
		phy-ref = < 0 >;
	};
	port-4 {
		is-host = <0x0>;
		null-phy = <0x0>;
		phy-ref = < &phy0 >;
	};
};


--------------------------------------------------------------------------------

Former and obsolete DTS compatible strings


Required properties:

- compatible : should be "nxp,sja1105-switch", "nxp,sja1105-switch-1-2",
		"nxp,sja1105-switch-2-2","nxp,sja1105-switch-1-3",
		"nxp,sja1105-switch-2-3" or "nxp,sja1105-switch-3-3".

Note:
	1. If two switches are connected in cascade, first switch should
use "nxp,sja1105-switch-1-2" as compatible string and the second one
"nxp,sja1105-switch-2-2".
	2. If three switches are connected in cascade, first switch should
use "nxp,sja1105-switch-1-3" as compatible string, the second one
"nxp,sja1105-switch-2-3" and the third one "nxp,sja1105-switch-3-3".

- reg : should specify the chip select of SPI controller used to
select this switch

- spi-max-frequency: Maximum frequency used for communication between
SPI controller and SJA1105 switch

- spi-cpha: SJA1105 switch needs to be configure 0x1 SPI mode

- port-<n>: port node specifies the configuration of the nth port of the
switch. The port node
		must have the following mandatory properties:
		- is-host:	Port Interface mode: MAC or PHY:
			<0x0> 	: MAC Mode
			<0x1>	: PHY Mode
		- speed: 	Port Speed:
			<0x00>	:	Port Disabled
			<0x01>	:	1	Gbit/s
			<0x10>	:	100	Mbit/s
			<0x11>	:	10	Mbit/s
		- xmii-mode: Port xMii Mode:
			"RGMII"
			"RMII"
			"MII"
		- null-phy: Port has PHY connected or not:
			<0x0>	:	PHY connected
			<0x1>	:	No PHY connected

For further information, please have a look to the SJA1105 data sheet.

Examples:

sja1105_0: sja1105@0 {
        compatible = "nxp,sja1105-switch-1-3";
        spi-max-frequency = <4000000>;
        spi-cpha;
        reg = <0>;
        port-0 {
                is-host = <1>;
                speed = <1000>;
                xmii-mode = "RGMII";
                null-phy =  <1>;
        };
        port-1 {
                is-host = <0>;
                speed = <1000>;
                xmii-mode = "RGMII";
                null-phy =  <0>;
        };
        port-2 {
                is-host = <0>;
                speed = <100>;
                xmii-mode = "RMII";
                null-phy = <0>;
        };
        port-3 {
                is-host = <0>;
                speed = <1000>;
                xmii-mode = "RGMII";
                null-phy = <0>;
        };
        port-4 {
                is-host = <0>;
                speed = <1000>;
                xmii-mode = "RGMII";
                null-phy = <0>;
        };
};
```

## Documentation/devicetree/bindings/nvmem/fsl,s32-siul2-nvmem.yaml
```yaml
# SPDX-License-Identifier: (GPL-2.0 or BSD-2-Clause)
%YAML 1.2
---
$id: http://devicetree.org/schemas/nvmem/fsl,s32-siul2-nvmem.yaml#
$schema: http://devicetree.org/meta-schemas/core.yaml#

title: NXP S32 SIUL2 NVMEM driver

maintainers:
  - Catalin Udma <catalin-dan.udma@nxp.com>

description: |
  The drivers provides a unique interface to access non volatile SoC
  information from SIUL2 module, for example SoC Revision

allOf:
  - $ref: "nvmem.yaml#"

properties:
  compatible:
    const: fsl,s32gen1-siul2-nvmem

  reg:
    description:
      Address and Size of the SIUL2 MCU ID Registers (MIDR1 & MIDR2).
    maxItems: 1

  '#address-cells':
    const: 1

  '#size-cells':
    const: 1

required:
  - compatible
  - reg
  - '#address-cells'
  - '#size-cells'

unevaluatedProperties: false

examples:
  - |

        nvram: nvram@4009C000 {
                compatible = "fsl,s32gen1-siul2-nvmem";
                reg = <0x0 0x0 0x0 10>;
                #address-cells = <1>;
                #size-cells = <1>;
                status = "okay";
                soc_revision: soc_revision@0 {
                        reg = <0x0 0x4>;
                };
        };
```
