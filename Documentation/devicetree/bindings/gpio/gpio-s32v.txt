## Documentation/devicetree/bindings/mailbox/nxp,s32g274a-llce-mailbox.yaml
```yaml
# SPDX-License-Identifier: (GPL-2.0-only or BSD-2-Clause)
%YAML 1.2
---
$id: http://devicetree.org/schemas/mailbox/nxp,s32g274a-llce-mailbox.yaml#
$schema: http://devicetree.org/meta-schemas/core.yaml#

title: NXP LLCE Mailbox

maintainers:
  - Ghennadi Procopciuc <ghennadi.procopciuc@nxp.com>

description: |
  This mailbox is present on NXP SoC's where LLCE accelerator is present.
  It facilitates the communication between Linux and LLCE cores.

properties:
  compatible:
    const: nxp,s32g274a-llce-mailbox

  '#mbox-cells':
    description:
      First number represents the channel type and the second
      represents the ID of the channel.
      Channel types
        * S32G274_LLCE_CAN_CONF_MB
        * S32G274_LLCE_CAN_RX_MB
        * S32G274_LLCE_CAN_TX_MB
    const: 2

  memory-region:
    description:
      phandle to a node describing the shared memory (System RAM memory)
      used by LLCE accelelerator.
    maxItems: 1
    minItems: 1

  reg-names:
    items:
      - const: rxin_fifo
      - const: rxout_fifo
      - const: icsr
      - const: blrin_fifo
      - const: blrout_fifo
      - const: txack_fifo

  reg:
    minItems: 6
    maxItems: 6
    items:
      - description: Address and Size of the RXIN fifo memory region
      - description: Address and Size of the RXOUT fifo memory region
      - description: Address and Size of the Interrupt concentrator memory region
      - description: Address and Size of the BLRIN fifo memory region
      - description: Address and Size of the BLROUT fifo memory region
      - description: Address and Size of the TXACK fifo memory region

  interrupt-names:
    items:
      - const: rxin_fifo_0_7
      - const: rxin_fifo_8_15
      - const: rxout_fifo_0_7
      - const: rxout_fifo_8_15
      - const: txack_fifo_0_7
      - const: txack_fifo_8_15

  interrupts:
    maxItems: 6
    minItems: 6
    items:
      - description: Shared interrupt line for RXIN 0-7 fifos
      - description: Shared interrupt line for RXIN 8-15 fifos
      - description: Shared interrupt line for RXOUT 0-7 fifos
      - description: Shared interrupt line for RXOUT 8-15 fifos
      - description: Shared interrupt line for TXACK 0-7 fifos
      - description: Shared interrupt line for TXACK 8-15 fifos

  clock-names:
    const: llce_sys

  clocks:
    description: LLCE system clock

required:
  - compatible
  - '#mbox-cells'
  - memory-region
  - reg-names
  - reg
  - interrupt-names
  - interrupts
  - clock-names
  - clocks

unevaluatedProperties: false
additionalProperties: false

examples:
  - |
    #include <dt-bindings/interrupt-controller/irq.h>
    #include <dt-bindings/clock/s32g-scmi-clock.h>
    llce_mb: llce_mailbox@43800000 {
        compatible = "nxp,s32g274a-llce-mailbox";
        #mbox-cells = <2>;

        reg = <0x0 0x0 0x0 0x6000>,
            <0x1 0x0 0x0 0x8000>,
            <0x2 0x0 0x0 0x1000>,
            <0x3 0x0 0x0 0x6000>,
            <0x4 0x0 0x0 0x6000>,
            <0x5 0x0 0x0 0x8000>;
        reg-names = "rxin_fifo",
            "rxout_fifo",
            "icsr",
            "blrin_fifo",
            "blrout_fifo",
            "txack_fifo";
        clocks = <&clks S32G_SCMI_CLK_LLCE_SYS>;
        clock-names = "llce_sys";

        memory-region = <&llce_shmem>;
        interrupts = <0 174 IRQ_TYPE_LEVEL_HIGH>,
            <0 175 IRQ_TYPE_LEVEL_HIGH>,
            <0 176 IRQ_TYPE_LEVEL_HIGH>,
            <0 177 IRQ_TYPE_LEVEL_HIGH>,
            <0 182 IRQ_TYPE_LEVEL_HIGH>,
            <0 183 IRQ_TYPE_LEVEL_HIGH>;
        interrupt-names = "rxin_fifo_0_7",
            "rxin_fifo_8_15",
            "rxout_fifo_0_7",
            "rxout_fifo_8_15",
            "txack_fifo_0_7",
            "txack_fifo_8_15";
        status = "okay";
    };
```

## Documentation/devicetree/bindings/mfd/nxp,s32g274a-llce-core.yaml
```yaml
# SPDX-License-Identifier: (GPL-2.0-only or BSD-2-Clause)
%YAML 1.2
---
$id: http://devicetree.org/schemas/mfd/nxp,s32g274a-llce-core.yaml#
$schema: http://devicetree.org/meta-schemas/core.yaml#

title: NXP LLCE Firmware Loader

maintainers:
  - Ghennadi Procopciuc <ghennadi.procopciuc@nxp.com>

description: |
  The Low Latency Communications Engine (LLCE) controls the traditional automotive
  communication interfaces such as CAN, LIN, FlexRay, and SPI.

  The loader is usually a dependency for the drivers associated with the LLCE accelerator:
    * LLCE mailbox
    * LLCE CAN

properties:
  compatible:
    const: nxp,s32g274a-llce-core

  firmware-name:
    items:
      - const: dte.bin
      - const: ppe_rx.bin
      - const: ppe_tx.bin
      - const: frpe.bin

  memory-region:
    maxItems: 5
    minItems: 5
    description: |
      A set of phandles to memory regions corresponding to the firmware
      components and a link to the region where the firmware load status
      can be read.

  reg-names:
      const: sysctrl

  reg:
    description:
      Offset and length of the LLCE system control registers

  clock-names:
    const: llce_sys

  clocks:
    description: LLCE system clock

  ranges:
    minItems: 6
    maxItems: 6
    description:
       LLCE FIFOs registers ranges

  '#address-cells':
    const: 2

  '#size-cells':
    const: 2

  '#interrupt-cells':
    const: 3

  interrupt-controller: true

patternProperties:
  '^llce_mb.*':
    type: object

  '^llce_can[0-9]+.*':
    type: object

required:
  - compatible
  - firmware-name
  - memory-region
  - reg-names
  - reg
  - clock-names
  - clocks
  - ranges
  - '#address-cells'
  - '#size-cells'
  - '#interrupt-cells'

unevaluatedProperties: false
additionalProperties: false

examples:
  - |
    #include <dt-bindings/clock/s32g-scmi-clock.h>

    bus {
        #address-cells = <2>;
        #size-cells = <2>;

        llce_core: llce_core@43000000 {
            compatible = "nxp,s32g274a-llce-core";
            clocks = <&clks S32G_SCMI_CLK_LLCE_SYS>;
            clock-names = "llce_sys";
            firmware-name = "dte.bin", "ppe_rx.bin",
                "ppe_tx.bin", "frpe.bin";
            memory-region = <&llce0_sram>, <&llce1_sram>,
                <&llce2_sram>, <&llce3_sram>,
                <&llce_boot_status>;
            reg = <0x6 0 0x0 0xc>;
            reg-names = "sysctrl";
            /* RX-IN_FIFO */
            ranges = <0x0 0 0x0 0x43A00000 0x0 0x6000>,
                /* RX-OUT_FIFO */
                <0x1 0 0x0 0x43A08000 0x0 0x8000>,
                /* LLCE interrupt Concentrator */
                <0x2 0 0x0 0x43A14000 0x0 0x1000>,
                /* BLR-IN_FIFO */
                <0x3 0 0x0 0x43B00000 0x0 0x6000>,
                /* BLR-OUT_FIFO */
                <0x4 0 0x0 0x43B08000 0x0 0x6000>,
                /* Tx_Ack_FIFO */
                <0x5 0 0x0 0x43B10000 0x0 0x8000>;
            #address-cells = <2>;
            #size-cells = <2>;
            #interrupt-cells = <3>;
            status = "okay";
        };
    };
```

## Documentation/devicetree/bindings/misc/fsl,s32-fccu.txt
```
Fault Collection and Control Unit in S32v234 or S32-Gen1 Soc

This is a module, it used to collect and control fault signals from
peripherals. It requires a correct configuration to enable reception and react
to a signal from a channel.

After it is configured successfully, a reset signal from a configured channel can
reset system. If a signal is generated before FCCU is configured, the signal
will be ignored.

Required properties:
 - compatible: 		should be set to "fsl,s32v234-fccu" or "fsl,s32gen1-fccu"
 - nxp,ncf_fault_off:	array of faults for NCF_Sn registers
 - reg:				the address range

Any driver requiring access to FCCU registers should reference it from its own
device tree node.

Example:

fccu: fccu@400B0000 {
				compatible = "fsl,s32v234-fccu";
				reg = <0x0 0x400B0000 0x0 0x1000>;
				clocks = <&clks S32V234_CLK_SYS6>;
				clock-names = "fccu";
				nxp,ncf_fault_off = <35 36 37 38>;
				status = "disabled";
			};

....

some-device {
	....
	memory-region = <&shared_memory>;
};
```

## Documentation/devicetree/bindings/misc/fsl,s32-gen1-gpr.txt
```
* NXP S32-Gen1 GPR Model

The SoC has a dedicated set of Cluster GPR (General Purpose Registers)
modules for the A53 cores.
These registers provide cluster and core level configurations
as well as event generation mechanisms.
Other cores may also have dedicated Cluster GPR modules
(e.g. the Cortex M7 cores).

Required properties:
- compatible:
	Should be:
	- "fsl,s32gen1-a53gpr" for the A53 clusters
- reg:
	Location and length of the register set

Example:

a53_gpr: a53_gpr@4007C400 {
	compatible = "fsl,s32gen1-a53gpr";
	reg = <0x0 0x4007C400 0x0 0x100>;
};
```

## Documentation/devicetree/bindings/misc/fsl,s32v234-fccu.txt
```
S32V234 Fault Collection and Control Unit

This is a module, it used to collect and control fault signals from
peripherals. It requires a correct configuration to enable reception and react
to a signal from a channel.

After it is configured successfully, a reset signal from a configured channel can
reset system. If a signal is generated before FCCU is configured, the signal
will be ignored.

Required properties:
 - compatible: 		should be set to "fsl,s32v234-fccu"
 - cfg_reg_off: 	the offsets of NCF_CFGn and NCF_Sn register
 - cfg_reg_val: 	the values of NCF_CFGn and NCF_Sn register
 - reg:				the address range

Any driver requiring access to FCCU registers should reference it from its own
device tree node.

Example:

fccu: fccu@400B0000 {
				compatible = "fsl,s32v234-fccu";
				reg = <0x0 0x400B0000 0x0 0x1000>;
				clocks = <&clks S32V234_CLK_SYS6>;
				clock-names = "fccu";
				cfg_reg_off = <0x9C 0x5C 0x60>;
				cfg_reg_val = <0x3C000 0xA0000000 0xA>;
				status = "disabled";
			};

....

some-device {
	....
	memory-region = <&shared_memory>;
};
```

## Documentation/devicetree/bindings/misc/fsl,s32v234-mscm.txt
```
Generic on-chip MSCM for S32V234

Simple iomem memory block containing the mapping of the address space
of the Miscellaneous System Control Module (MSCM).
For S32V234 this module occupies a 4 Kb address space.

Required properties:

- compatible : fsl,s32v234-mscm

- reg : the address range

- interrupts : the interrupts managed by registers in this module
	(e.g. the CPU 2 CPU directed interrupts)

address (@<address>) should be
appended to the name.

Example:

mscm1: mscm@40081000 {
	compatible = "fsl,s32v234-mscm";

	reg = <0x0 0x40081000 0x0 0x1000>;

	/* CPU2CPU interrupts */
	interrupts = <0 0 4 >,
			<0 1 4 >,
			<0 2 4 >,
			<0 3 4 >;
};
```

## Documentation/devicetree/bindings/misc/fsl,s32v234-shm.txt
```
S32V234 Shared Memory Block

This is a shared memory block to be used by various S32V234 generic devices,
which require a dedicated contiguous memory block to be reserved in the kernel
memory space.

It must reside inside the 'reserved-memory' section of the device tree.
device is matched via its bus drivers, and has a number of properties
that apply in on the generic device (independent from the bus).
It may be used by more than one device at once, as long as each one follows
a proper synchronization mechanism for accessing the data.

Required properties:
 - compatible: 		should be set to "fsl,s32v234-shm"
 - reg:			the address range

address (@<address>) should be appended to the name.

Any device requiring access to this shared memory block should reference it
from its own device tree node.

Example:

reserved-memory {
	....
	/* 1Mb shared memory */
	shared_memory: shm@0xC1000000 {
		compatible = "fsl,s32v234-shm";
		reg = <0x0 0xC1000000 0x0 0x100000>;    /* 1 MB */
		no-map;
	};
};

....

some-device {
	....
	memory-region = <&shared_memory>;
};
```

## Documentation/devicetree/bindings/misc/fsl,s32v234-sram.txt
```
Generic on-chip SRAM for S32V234

Simple iomem memory block to be used by APIs requiring SRAM access.
Compatible to mmio-sram.

Required properties:

- compatible : fsl,s32v234-sram

- reg : SRAM iomem address range

Optional properties:

- device_type : sram

address (@<address>) should be
appended to the name.

Example:

sram: sram@3E800000 {
	device_type = "sram";
	compatible = "mmio-sram","fsl,s32v234-sram";
	reg = <0 0x3E800000 0 0x400000>;
};
```

## Documentation/devicetree/bindings/mmc/qcom-sdcc.txt
```
Device Tree Bindings for the Qualcomm SD Card Controller

  The bindings follow the mmc[1], clock[2] and interrupt[3] bindings. Only
  deviations are documented here.

  [1] Documentation/devicetree/bindings/mmc/mmc.txt
  [2] Documentation/devicetree/bindings/clock/clock-bindings.txt
  [3] Documentation/devicetree/bindings/interrupt-controller/interrupts.txt

Required Properties:
  - compatible: Compatibility string. Must be "qcom,sdcc"
	or "qcom,<SOC>-sdcc" like "qcom,apq8064-sdcc".
  - reg: From mmc bindings: Register location and length.
  - clocks: From clock bindings: Handles to clock inputs.
  - clock-names: From clock bindings: Tuple including "sdc_clk" and "sdc_pclk"
  - interrupts: Interrupt specifier
  - interrupt-names: Should be "cmd_irq" for command IRQ and
	"status_irq" for card status IRQ.

Example:

	sdcc1: sdcc@12400000 {
		compatible	= "qcom,sdcc", "qcom,apq8064-sdcc";
		status		= "disabled";
		reg		= <0x12400000 0x8000>;
		reg-names	= "core_mem";
		interrupts	= <GIC_SPI 104 IRQ_TYPE_LEVEL_HIGH>;
		interrupt-names	= "cmd_irq";
		clocks		= <&gcc SDC1_CLK>, <&gcc SDC1_H_CLK>;
		clock-names	= "sdc_clk", "sdc_pclk";
		bus-width	= <8>;
		max-frequency	= <960/00000>;
		non-removable;
		cap-sd-highspeed;
		cap-mmc-highspeed;
	};
```
