## Documentation/devicetree/bindings/arm/msm/ids.txt
```
* MSM-ID

The qcom,msm-id entry specifies the MSM chipset and hardware revision.  It can
optionally be an array of these to indicate multiple hardware that use the same
device tree.  It is expected that the bootloader will use this information at
boot-up to decide which device tree to use when given multiple device trees,
some of which may not be compatible with the actual hardware.  It is the
bootloader's responsibility to pass the correct device tree to the kernel.

PROPERTIES

- qcom,msm-id:
	Usage: required
	Value type: <prop-encoded-array> (<chipset_id, rev_id> [, <c2, r2> ..])
	Definition:
		The "chipset_id" consists of three fields as below:

		bits 0-15  = The unique MSM chipset id.
		bits 16-31 = Reserved.  Should be 0

		chipset_id is an exact match value

		The "rev_id" is a chipset specific 32-bit id that represents
		the version of the chipset.

		The rev_id is a best match id.  The bootloader will look for
		the closest possible patch.

* BOARD-ID

The qcom,board-id entry specifies the board type and revision information.  It
can optionally be an array of these to indicate multiple boards that use the
same device tree.  It is expected that the bootloader will use this information
at boot-up to decide which device tree to use when given multiple device trees,
some of which may not be compatible with the actual hardware.  It is the
bootloader's responsibility to pass the correct device tree to the kernel.

PROPERTIES

- qcom,board-id:
	Usage: required
	Value type: <prop-encoded-array> (<board_id, subtype_id> [, <b2, s2> ..])
	Definition:
		The "board_id" consists of three fields as below:

		bits 31-24 = Unusued.
		bits 23-16 = Platform Version Major
		bits 15-8  = Platfrom Version Minor
		bits 7-0   = Platform Type

		Platform Type field is an exact match value.  The Platform
		Major/Minor field is a best match.  The bootloader will look
		for the closest possible match.

		The "subtype_id" is unique to a Platform Type/Chipset ID.  For
		a given Platform Type, there will typically only be a single
		board and the subtype_id will be 0.  However in some cases board
		variants may need to be distinquished by different subtype_id
		values.

		subtype_id is an exact match value.

EXAMPLE:
	qcom,board-id = <15 2>;
	qcom,msm-id = <0x1007e 0>;
```

## Documentation/devicetree/bindings/arm/msm/qcom,idle-state.txt
```
QCOM Idle States for cpuidle driver

ARM provides idle-state node to define the cpuidle states, as defined in [1].
cpuidle-qcom is the cpuidle driver for Qualcomm SoCs and uses these idle
states. Idle states have different enter/exit latency and residency values.
The idle states supported by the QCOM SoC are defined as -

    * WFI
    * Retention
    * Standalone Power Collapse (Standalone PC or SPC)
    * Power Collapse (PC)

WFI: WFI does a little more in addition to architectural clock gating.  ARM
processors when execute the wfi instruction will gate their internal clocks.
QCOM cpus use this instruction as a trigger for the SPM state machine. Usually
with a cpu entering WFI, the SPM is configured to do clock-gating as well. The
SPM state machine waits for the interrrupt to trigger the core back in to
active. When all CPUs in the SoC, clock gate using the ARM wfi instruction, the
second level cache usually can also clock gate sensing no cpu activity. When a
cpu is ready to run, it needs the cache to be active before starting execution.
Allowing the SPM to execute the clock gating statemachine and waiting for
interrupt on behalf of the processor has a benefit of guaranteeing that the
system state is conducive for the core to resume execution.

Retention: Retention is a low power state where the core is clockgated and the
memory and the registers associated with the core are retained.  The voltage
may be reduced to the minimum value needed to keep the processor registers
active. Retention is triggered when the core executes wfi instruction. The SPM
should be configured to execute the retention sequence and would wait for
interrupt, before restoring the cpu to execution state. Retention may have a
slightly higher latency than WFI.

Standalone PC: A cpu can power down and warmboot if there is a sufficient time
between now and the next know wake up. SPC mode is used to indicate a core
entering a power down state without consulting any other cpu or the system
resources. This helps save power only on that core. Like WFI and Retention, the
core executes wfi and the SPM programmed to do SPC would use the cpu control
logic to power down the core's supply and restore it back when woken up by an
interrupt.  Applying power and reseting the core causes the core to warmboot
back into secure mode which trampolines the control back to the kernel. To
enter a power down state the kernel needs to call into the secure layer which
would then execute the ARM wfi instruction. Failing to do so, would result in a
crash enforced by the warm boot code in the secure layer. On a SoC with
write-back L1 cache, the cache would need to be flushed.

Power Collapse: This state is similiar to the SPC mode, but distinguishes
itself in the fact that the cpu acknowledges and permits the SoC to enter
deeper sleep modes. In a hierarchical power domain SoC, this means L2 and other
caches can be flushed, system bus, clocks - lowered, and SoC main XO turned off
and voltages reduced, provided all cpus enter this state. In other words, it is
a coupled idle state.  Since the span of low power modes possible at this state
is vast, the exit latency and the residency of this low power mode would be
considered high even though at a cpu level, this essentially is cpu power down.
The SPM in this state also may handshake with the Resource power manager
processor in the SoC to indicate a complete subsystem shut down.

The idle-state for QCOM SoCs are distinguished by the compatible property of
the node. They indicate to the cpuidle driver the entry point to use for
cpuidle. The devicetree representation of the idle state should be -

Required properties:

- compatible: Must be "arm,idle-state"
		and one of -
			"qcom,idle-state-wfi",
			"qcom,idle-state-ret",
			"qcom,idle-state-spc",
			"qcom,idle-state-pc",

Other required and optional properties are specified in [1].

[1]. Documentation/devicetree/bindings/arm/idle-states.txt
```

## Documentation/devicetree/bindings/arm/msm/spm.txt
```
* Subsystem Power Manager (SAW2)

S4 generation of MSMs have SPM hardware blocks to control the Application
Processor Sub-System power. These SPM blocks run individual state machine
to determine what the core (L2 or Krait/Scorpion) would do when the WFI
instruction is executed by the core.

The devicetree representation of the SPM block should be:

Required properties

- compatible: Could be one of -
		"qcom,spm-v2.1"
- reg: The physical address and the size of the SPM's memory mapped registers
- qcom,cpu: phandle for the CPU that the SPM block is attached to.
	This field is required on only for SPMs that control the CPU.
- qcom,saw2-clk-div: SAW2 configuration register to program the SPM runtime
	clocks.
- qcom,saw2-delays: The SPM delay values that SPM sequences would refer to.
- qcom,saw2-enable: The SPM control register to enable/disable the sleep state
	machine.

Optional properties

- qcom,saw2-spm-cmd-wfi: The WFI command sequence
- qcom,saw2-spm-cmd-ret: The Retention command sequence
- qcom,saw2-spm-cmd-spc: The Standalone PC command sequence
- qcom,saw2-spm-cmd-pc: The Power Collapse command sequence. This sequence may
	turn off other SoC components.
- qcom,saw2-spm-cmd-gdhs: GDHS (Globally Distributed Head Switch) command
	sequence. This sequence will retain the memory but turn off the logic.
-
Example:
	spm@f9089000 {
		compatible = "qcom,spm-v2.1";
		#address-cells = <1>;
		#size-cells = <1>;
		reg = <0xf9089000 0x1000>;
		qcom,cpu = <&CPU0>;
		qcom,saw2-clk-div = <0x1>;
		qcom,saw2-delays = <0x20000400>;
		qcom,saw2-enable = <0x1>;
		qcom,saw2-spm-cmd-wfi = [03 0b 0f];
		qcom,saw2-spm-cmd-spc = [00 20 50 80 60 70 10 92
				a0 b0 03 68 70 3b 92 a0 b0
				82 2b 50 10 30 02 22 30 0f];
	};
```

## Documentation/devicetree/bindings/clock/fsl,s32-pit.txt
```
Freescale PIT timer used as clocksource/clockevents

This PIT timer driver is designed to be used as clocksource/clockevents
for VF610 and S32 SoCs.

Required properties:
- compatible : "fsl,s32v234-pit", "fsl,vf610-pit", "fsl,s32gen1-pit"
- reg : Should contain 1 register range(address and length)
- interrupts : One interrupt for PIT timer
- cpu: The virtual cpu id which will use the timer as
	clockevents generator.

Example:

pit0: pit@4003A000{
	compatible = "fsl,s32v234-pit";
	reg = <0x0 0x4003A000 0x0 0x1000>;
	interrupts= <0 31 4>;
	clocks = <&clks S32V234_CLK_SYS6>;
	clock-names = "pit";
	cpu = <0>;
	status = "disabled";
};

&pit0 {
	status = "okay";
};
```

## Documentation/devicetree/bindings/clock/fsl,s32-stm-global.txt
```
NXP STM timer used as universal time source

This STM timer driver is designed to be used as universal time source
for S32 Gen1 SoCs.

Required properties:
- compatible : "fsl,s32gen1-stm-global"
- reg : Should contain 1 register range(address and length)

Example:

stm0: stm@4000D000{
	compatible = "fsl,s32gen1-stm-global";
	reg = <0x0 0x4000D000 0x0 0x1000>;
	clock-names = "stm";
	status = "disabled";
};

&stm0 {
	status = "okay";
};
```

## Documentation/devicetree/bindings/clock/fsl,s32-stm.txt
```
Freescale STM timer used as clockevents

This STM timer driver is designed to be used as clockevents
for S32 SoCs.

Required properties:
- compatible : "fsl,s32v234-stm", "fsl,s32gen1-stm"
- reg : Should contain 1 register range(address and length)
- interrupts : One interrupt for STM timer
- cpu: The virtual cpu id which will use the timer as
	clockevents generator.

Example:

stm0: stm@4000D000{
	compatible = "fsl,s32v234-stm";
	reg = <0x0 0x4000D000 0x0 0x1000>;
	interrupts= <0 19 4>;
	clocks = <&clks S32V234_CLK_SYS6>;
	clock-names = "stm";
	cpu = <1>;
	status = "disabled";
};

&stm0 {
	status = "okay";
};
```

## Documentation/devicetree/bindings/clock/fsl,s32v234-pit.txt
```
Freescale PIT timer used as clocksource/clockevents

This PIT timer driver is designed to be used as clocksource/clockevents
for VF610 and S32V234 SoCs.

Required properties:
- compatible : "fsl,s32v234-pit", "fsl,vf610-pit"
- reg : Should contain 1 register ranges(address and length)
- interrupts : One interrupt for PIT timer
- core: The core which will use the timer as
	clockevents generator.

Example:

pit0: pit@4003A000{
	compatible = "fsl,s32v234-pit";
	reg = <0x0 0x4003A000 0x0 0x1000>;
	interrupts= <0 31 0xf08>;
	clocks = <&clks S32V234_CLK_SYS6>;
	clock-names = "pit";
	core = <0>;
	status = "disabled";
};

&pit0 {
	status = "okay";
};
```

## Documentation/devicetree/bindings/clock/qcom,a53cc.txt
```
Qualcomm A53 CPU Clock Controller Binding
------------------------------------------------
The A53 CPU Clock Controller is hardware, which provides a combined
mux and divider functionality for the CPU clocks. It can choose between
a fixed rate clock and the dedicated A53 PLL. This hardware block is used
on platforms such as msm8916.

Required properties :
- compatible : shall contain:

			"qcom,a53cc-msm8916"

- reg : shall contain base register location and length
	of the APCS region
- #clock-cells : shall contain 1

Example:

	apcs: syscon@b011000 {
		compatible = "qcom,a53cc-msm8916";
		reg = <0x0b011000 0x1000>;
		#clock-cells = <1>;
	};
```

## Documentation/devicetree/bindings/clock/qcom,a53pll.txt
```
MSM8916 A53 PLL Binding
---------------
The A53 PLL on MSM8916 platforms is the main CPU PLL used for frequencies
above 1GHz.

Required properties :
- compatible : Shall contain only one of the following:

		"qcom,a53pll-msm8916"

- reg : shall contain base register location and length
- #clock-cells : must be set to <0>

Example:

	a53pll: a53pll@b016000 {
		compatible = "qcom,a53pll-msm8916";
		reg = <0x0b016000 0x40>;
		#clock-cells = <0>;
	};
```

## Documentation/devicetree/bindings/clock/qcom,gcc.txt
```
Qualcomm Global Clock & Reset Controller Binding
------------------------------------------------

Required properties :
- compatible : shall contain only one of the following:

			"qcom,gcc-apq8064"
			"qcom,gcc-apq8084"
			"qcom,gcc-ipq8064"
			"qcom,gcc-msm8660"
			"qcom,gcc-msm8916"
			"qcom,gcc-msm8960"
			"qcom,gcc-msm8974"
			"qcom,gcc-msm8974pro"
			"qcom,gcc-msm8974pro-ac"

- reg : shall contain base register location and length
- #clock-cells : shall contain 1
- #reset-cells : shall contain 1

Optional properties :
- Qualcomm TSENS (thermal sensor device) on some devices can
be part of GCC and hence the TSENS properties can also be
part of the GCC/clock-controller node.
For more details on the TSENS properties please refer
Documentation/devicetree/bindings/thermal/qcom-tsens.txt
- #power-domain-cells : shall contain 1

Example:
	clock-controller@900000 {
		compatible = "qcom,gcc-msm8960";
		reg = <0x900000 0x4000>;
		#clock-cells = <1>;
		#reset-cells = <1>;
		#power-domain-cells = <1>;
	};

Example of GCC with TSENS properties:
	clock-controller@900000 {
		compatible = "qcom,gcc-apq8064";
		reg = <0x00900000 0x4000>;
		nvmem-cells = <&tsens_calib>, <&tsens_backup>;
		nvmem-cell-names = "calib", "calib_backup";
		qcom,tsens-slopes = <1176 1176 1154 1176 1111
				1132 1132 1199 1132 1199 1132>;
		#clock-cells = <1>;
		#reset-cells = <1>;
		#thermal-sensor-cells = <1>;
	};
```

## Documentation/devicetree/bindings/clock/qcom,rpmcc.txt
```
Qualcomm RPM Clock Controller Binding
------------------------------------------------

Required properties :
- compatible : shall contain only one of the following:

			"qcom,rpmcc-msm8916"

- #clock-cells : shall contain 1

Example:
	rpmcc: rpmcc {
		compatible = "qcom,rpmcc-msm8916";
		#clock-cells = <1>;
	};
```

## Documentation/devicetree/bindings/clock/s32gen1-clocking.txt
```
* NXP S32GEN1 CLOCKING

The internal clocks are generated from one of these input clock sources:
- FIRC – 48 MHz (mainly used as backup clock)
- SIRC – 32 kHz
- FXOSC – 20-40 MHz
- PLLs:
	- CORE_PLL (FM)
	- PERIPH_PLL (Non-FM)
	- DDR_PLL (Non-FM)
	- ACCEL_PLL (FM)
	- AURORA_PLL (Non-FM)
- DFS blocks:
	- CORE_PLL DFS
	- PERIPH_PLL DFS

The PLLDIG module provides a user interface and control over PLL system composed
of a single PLL analog block and the digital interface.
The DFS digital block implements registers to control the analog DFS block.

Required properties:
- compatible:
	Should be:
	- "fsl,s32r45x-clocking", "fsl,s32g275-clocking", "fsl,s32v344-clocking"
- reg:
	Location and length of the register set

Example:

clks: clocking@40038000 {
	compatible = "fsl,s32r45x-clocking";
	reg = <0x0 0x40038000 0x0 0x3000>, /*armpll*/
		<0x0 0x4003C000 0x0 0x3000>, /*periphpll*/
		<0x0 0x40040000 0x0 0x3000>, /*accelpll*/
		<0x0 0x40044000 0x0 0x3000>, /*ddrpll*/
		<0x0 0x40048000 0x0 0x3000>, /*aurorapll*/
		<0x0 0x40050000 0x0 0x3000>, /*xosc*/
		<0x0 0x40054000 0x0 0x3000>, /*armdfs*/
		<0x0 0x40058000 0x0 0x3000>; /*periphdfs*/
	#clock-cells = <1>;
};


* NXP S32GEN1 Clock Generation Modules (MC_CGMs)

Clock Generation Modules provides registers for system and peripherals clock
source selection and division.

This binding uses the common clock binding:
    Documentation/devicetree/bindings/clock/clock-bindings.txt

Required properties:
- compatible:
	Should be:
	- "fsl,s32gen1-mc_cgm0" for MC_CGM_0
	- "fsl,s32gen1-mc_cgm1" for MC_CGM_1
	- "fsl,s32gen1-mc_cgm5" for MC_CGM_5
- reg:
	Location and length of the register set
- #clock-cells (only for MC_CGM_0):
	Should be <1>. See dt-bindings/clock/s32gen1-clock.h for the clock
	specifiers allowed in the clocks property of consumers.

Example:
clks: mc_cgm0@40030000 {
	compatible = "fsl,s32gen1-mc_cgm0";
	reg = <0x0 0x40030000 0x0 0x3000>;
	#clock-cells = <1>;
};
```
