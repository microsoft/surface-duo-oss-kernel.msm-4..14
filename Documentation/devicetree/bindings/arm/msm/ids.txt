## Documentation/devicetree/bindings/clock/s32v234-mc_me.txt
```
* NXP S32V234 Mode Entry Module (MC_ME)

Required properties:
- compatible: Should be "fsl,s32v234-mc_me"
- reg: Location and length of the register set

Example:
mc_me: mc_me@4004a000 {
	compatible = "fsl,s32v234-mc_me";
	reg = <0x0 0x4004A000 0x0 0x1000>;
};
```

## Documentation/devicetree/bindings/crypto/fsl-cse3.txt
```
Freescale CSE3 Cryptographic Services Engine included in some chips.
Currently only S32V234 is supported.

Required properties:
- compatible : Should be "fsl,<soc>-cse3"
- reg : Should contain CSE3 registers location and length
- interrupts : Should contain CSE3 interrupt number

Example:

cse3: crypto@40001000 {
	compatible = "fsl,s32v234-cse3";
	reg = <0x0 0x40001000 0x0 0x1000>;
	interrupts = <0 18 4>;
	status = "disabled";
};
```

## Documentation/devicetree/bindings/ddr/fsl,s32gen1-ddr.txt
```
NXP LPDDR4 ERR050543

The ddr dts node provides a configuration handle for the DDR controller driver.

Required properties:
- compatible should be: "fsl,s32gen1-ddr"
- reg: should be the DDRC base address
- perf-phandle: the phandle to the ddr-perf node

Example:

ddr: ddr@403C0000 {
		compatible = "fsl,s32gen1-ddr";
		reg = <0x0 0x403C0000 0x0 0x100>;
		perf-phandle = <&perf>;
};
```

## Documentation/devicetree/bindings/display/bridge/lontium,lt9611.yaml
```yaml
# SPDX-License-Identifier: (GPL-2.0-only OR BSD-2-Clause)
%YAML 1.2
---
$id: http://devicetree.org/schemas/display/bridge/lontium,lt9611.yaml#
$schema: http://devicetree.org/meta-schemas/core.yaml#

title: Lontium LT9611 2 Port MIPI to HDMI Bridge

maintainers:
  - Vinod Koul <vkoul@kernel.org>

description: |
  The LT9611 is a bridge device which converts DSI to HDMI

properties:
  compatible:
    enum:
      - lontium,lt9611

  reg:
    maxItems: 1
    description: base I2C address of the device.

  "#sound-dai-cells":
    const: 1

  interrupts:
    maxItems: 1
    description: interrupt line for the chip

  reset-gpios:
    maxItems: 1
    description: GPIO connected to active high RESET pin.

  vdd-supply:
    description: Regulator for 1.8V MIPI phy power.

  vcc-supply:
    description: Regulator for 3.3V IO power.

  ports:
    type: object

    properties:
      "#address-cells":
        const: 1

      "#size-cells":
        const: 0

      port@0:
        type: object
        additionalProperties: false

        description: |
          HDMI port for HDMI output

        properties:
          reg:
            const: 0

        patternProperties:
          endpoint:
            type: object
            additionalProperties: false

            properties:
              remote-endpoint: true

        required:
          - reg

      port@1:
        type: object
        additionalProperties: false

        description: |
          MIPI port-1 for MIPI input

        properties:
          reg:
            const: 1

        patternProperties:
          endpoint:
            type: object
            additionalProperties: false

            properties:
              remote-endpoint: true

        required:
          - reg

      port@2:
        type: object
        additionalProperties: false

        description: |
          MIPI port-2 for MIPI input

        properties:
          reg:
            const: 2

        patternProperties:
          endpoint:
            type: object
            additionalProperties: false

            properties:
              remote-endpoint: true

        required:
          - reg

    required:
      - "#address-cells"
      - "#size-cells"
      - port@0
      - port@1

required:
  - compatible
  - reg
  - interrupts
  - vdd-supply
  - vcc-supply
  - ports

additionalProperties: false

examples:
  - |
    #include <dt-bindings/gpio/gpio.h>
    #include <dt-bindings/interrupt-controller/irq.h>

    i2c10 {
      #address-cells = <1>;
      #size-cells = <0>;

      lt9611_codec: hdmi-bridge@3b {
        compatible = "lontium,lt9611";
        reg = <0x3b>;

        reset-gpios = <&tlmm 128 GPIO_ACTIVE_HIGH>;
        interrupts-extended = <&tlmm 84 IRQ_TYPE_EDGE_FALLING>;

        vdd-supply = <&lt9611_1v8>;
        vcc-supply = <&lt9611_3v3>;

        ports {
          #address-cells = <1>;
          #size-cells = <0>;

          port@0 {
            reg = <0>;
            lt9611_out: endpoint {
              remote-endpoint = <&hdmi_con>;
            };
          };

          port@1 {
            reg = <1>;
            lt9611_a: endpoint {
              remote-endpoint = <&dsi0_out>;
            };
          };

          port@2 {
            reg = <2>;
            lt9611_b: endpoint {
              remote-endpoint = <&dsi1_out>;
            };
          };
        };
      };
    };
```

## Documentation/devicetree/bindings/display/fsl,dec200.txt
```
Device Tree bindings for Freescale DEC200 Driver

Required properties:
- compatible:		Should be one of
	* "fsl,s32v234-dec200_dec".
	* "fsl,s32v234-dec200_enc".

- reg:			Address and length of the register set for dec200.
- clocks:		Handle to "dcu", "sys3" and "sys6" clock.
			See ../clock/clock-bindings.txt for details.
- clock-names:		Should be "dcu", "sys6" for dec200_dec and
                                "sys3" and "sys6" for dec200_dec
			See ../clock/clock-bindings.txt for details.

Examples:
dec200_dec: dec200@40026000 {
        compatible = "fsl,s32v234-dec200_dec";
        reg = <0x0 0x40026000 0x0 0x1000>;
        interrupts = <0 97 4>;
        clocks = <&clks S32V234_CLK_DCU_AXI>,
                        <&clks S32V234_CLK_DEC200_ENC_IPS>;
        clock-names = "dcu", "sys6";
        status = "disabled";
};

dec200_enc: dec200@40027000 {
        compatible = "fsl,s32v234-dec200_enc";
        reg = <0x0 0x40027000 0x0 0x1000>;
        interrupts = <0 98 4>;
        clocks = <&clks S32V234_CLK_DEC200_ENC_AHB>,
                        <&clks S32V234_CLK_DEC200_ENC_IPS>;
        clock-names = "sys3", "sys6";
        status = "disabled";
};
```

## Documentation/devicetree/bindings/dma/fsl-fdma.txt
```
Freescale Fast DMA

Describes Fast DMA configuration.

Required properties:
- compatible: "fsl,<chip>-fdma", chip should be s32v234
- reg: Should contain the FDMA register range (address and length - both 64bit)
- interrupts: Should enumerate FDMA NVIC interrupt IDs.

Example:
fdma: fast_dma@7C040000 {
		compatible = "fsl,s32v234-fdma";
		reg = <0x0 0x7C040000 0x0 0x1000>;
		interrupts = 	<0 83 1>,
		<0 84 1>;
		status = "disabled";
};

&fdma {
	status = "okay";
};
```

## Documentation/devicetree/bindings/drm/msm/sde-shp.txt
```
QTI Snapdragon Display Engine (SDE) shared plane

This driver allows to create multiple virtual planes from the same
physical plane. Only one plane can be activated at a time.

Required properties:
- compatible:		"qcom,sde-shared-plane"
- qcom,add-planes:	Shared planes to add to the DRM system. Each child
			represents a new plane, which has the properties of:
	qcom,plane-parent: required string, name of parent plane
			where this plane is created from.
	qcom,plane-name: optional string, name of the new plane.
	qcom,plane-seamless-mode: optional string, seamless mode when plane being
			displayed can be handed off to another plane or not.
			The candidate modes are:
			"restrict": default mode, handoff can only happen
				between connectors that are sharing the same ROI
				of the same physical display.
			"shared": handoff can only happen between connectors that
				are sharing the same physical displays. ROI will
				not be checked in this mode.
			"none": handoff can only happen when plane is detached
				from display. No seamless handoff is allowed.
	qcom,plane-init-handoff: optional boolean, if set, the plane is inited
			to handoff state at system bootup. For planes with the
			same parent, only one can set to init-handoff or
			init-active state.
	qcom,plane-init-active: optional boolean, if set, the plane is inited to
			active state at system bootup. For planes with the same
			parent, only one can set to init-handoff or init-active
			state.
	qcom,plane-detach-handoff: optional boolean, if set, the plane is set to
			handoff state whenever it is detached.


Example:

/ {
	...

	qcom,sde-shared-plane {
		compatible = "qcom,sde-shared-plane";
		qcom,add-planes {
			plane@0 {
				qcom,plane-name = "plane-0-splash";
				qcom,plane-parent = "plane-0";
				qcom,plane-init-handoff;
				qcom,plane-seamless-mode = "shared";
			};
			plane@1 {
				qcom,plane-name = "plane-1-splash";
				qcom,plane-parent = "plane-1";
				qcom,plane-init-handoff;
				qcom,plane-seamless-mode = "shared";
			};
		};
	};
};
```

## Documentation/devicetree/bindings/eeprom/eeprom.txt
```
= EEPROM Data Device Tree Bindings =

This binding is intended to represent the location of hardware
configuration data stored in EEPROMs.

On a significant proportion of boards, the manufacturer has stored
some data on an EEPROM-like device, for the OS to be able to retrieve
these information and act upon it. Obviously, the OS has to know
about where to retrieve these data from, and where they are stored on
the storage device.

This document is here to document this.

= Data providers =
Contains bindings specific to provider drivers and data cells as children
to this node.

= Data cells =
These are the child nodes of the provider which contain data cell
information like offset and size in eeprom provider.

Required properties:
reg:	specifies the offset in byte within that storage device, and the length
	in bytes of the data we care about.
	There could be more then one offset-length pairs in this property.

Optional properties:
As required by specific data parsers/interpreters.

For example:

	/* Provider */
	qfprom: qfprom@00700000 {
		compatible 	= "qcom,qfprom";
		reg		= <0x00700000 0x1000>;
		...

		/* Data cells */
		tsens_calibration: calib@404 {
			reg = <0x404 0x10>;
		};

		serial_number: sn {
			reg = <0x104 0x4>, <0x204 0x4>, <0x30c 0x4>;

		};
		...
	};

= Data consumers =
Are device nodes which consume eeprom data cells.

Required properties:

eeproms: List of phandle and data cell the device might be interested in.

Optional properties:

eeprom-names: List of data cell name strings sorted in the same order
	      as the eeproms property. Consumers drivers will use
	      eeprom-names to differentiate between multiple cells,
	      and hence being able to know what these cells are for.

For example:

	tsens {
		...
		eeproms = <&tsens_calibration>;
		eeprom-names = "calibration";
	};
```

## Documentation/devicetree/bindings/eeprom/qfprom.txt
```
= Qualcomm QFPROM device tree bindings =

This binding is intended to represent QFPROM which is found in most QCOM SOCs.

Required properties:
- compatible: should be "qcom,qfprom"
- reg: Should contain registers location and length

= Data cells =
Are child nodes of qfprom, bindings of which as described in
bindings/eeprom/eeprom.txt

Example:

	qfprom: qfprom@00700000 {
		compatible 	= "qcom,qfprom";
		reg		= <0x00700000 0x1000>;
		...
		/* Data cells */
		tsens_calibration: calib@404 {
			reg = <0x404 0x10>;
		};
	};
```

## Documentation/devicetree/bindings/extcon/extcon-usb-gpio.txt
```
USB GPIO Extcon device

This is a virtual device used to generate USB cable states from the USB
ID and VBUS signals connected to GPIO pins.

The extcon cable states USB and USB_HOST are actually VBUS and !ID
pin states and do not indicate what mode the USB needs to operate in.
That decision is done by the USB stack.

Some devices have only one of these GPIO pins, so we support cases when
only one of them is present. Hence properties 'id-gpio' and 'vbus-gpio'
are described as optional, but at least one of them has to be present
in extcon-usb-gpio node.

In general we have three cases:
1. If VBUS and ID gpios are present we pass them as is
	USB-HOST = !ID, USB = VBUS
2. If only VBUS gpio is present we assume that ID pin is always High.
	USB-HOST = false, USB = VBUS.
3. If only ID pin is available we infer the VBUS pin states based on ID.
	USB-HOST = !ID, USB = ID

Required properties:
- compatible: Should be "linux,extcon-usb-gpio"

Optional properties
- id-gpio: gpio for USB ID pin. See gpio binding.
- vbus-gpio: gpio for USB VBUS pin. See gpio binding.
- debounce: gpio debounce time in milliseconds (u32).


Example: Examples of extcon-usb-gpio node in dra7-evm.dts as listed below:
 	extcon_usb1 {
 		compatible = "linux,extcon-usb-gpio";
 		id-gpio = <&gpio6 1 GPIO_ACTIVE_HIGH>;
		vbus-gpio = <&gpio6 2 GPIO_ACTIVE_HIGH>;
		debounce = <25>;
 	}

 	&omap_dwc3_1 {

		extcon = <&extcon_usb1>;
	};
```

## Documentation/devicetree/bindings/fb/fsl_fbdcu.txt
```
* Freescale Display Control Unit (DCU)

Required properties:
- compatible: Should be "fsl,s32v234-dcu".
- reg: Address and length of the register set for DCU.
- interrupts: Should contain DCU interrupts.
- clocks: From common clock binding: handle to DCU clock.
- clock-names: From common clock binding: Shall be "dcu".
- display: The phandle to display node.

* display node

Required properties:
- bits-per-pixel: <24> for RGB888.

Required sub-node:
- display-timings: Refer to binding doc display-timing.txt for details.

Examples:

&dcu0 {
	display = <&display>;
	status = "okay";
	display: display@0 {
		bits-per-pixel = <32>;

		display-timings {
			native-mode = <&timing0>;

			timing0: nl4827hc19 {
				clock-frequency = <56000000>;
				hactive = <1920>;
				vactive = <1080>;
				hback-porch = <30>;
				hfront-porch = <60>;
				vback-porch = <30>;
				vfront-porch = <3>;
				hsync-len = <60>;
				vsync-len = <3>;
			};
		};
	};
};
```
