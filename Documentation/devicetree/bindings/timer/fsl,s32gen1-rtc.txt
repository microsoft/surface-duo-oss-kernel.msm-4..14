## Documentation/devicetree/bindings/timer/fsl,s32gen1-rtc.txt
```
NXP S32GEN1 family Device Tree Bindings
---------------------------------------------

Required properties:

- compatible : should be "fsl,s32gen1-rtc"
- reg : the size of the memory address space of the device.
- interrupts : specifies the Real Time Clock interrupts id
- clksel : input clock selector; choose one of: 0-SIRC, 2-FIRC
- dividers : an array of two u32 elements, the former encoding DIV512,
  the latter encoding DIV32. These are dividers that can be enabled
  individually, or cascaded. Use 0 to disable the respective divider,
  and 1 to enable it.

Example:
rtc0: rtc@40060000 {
		compatible = "fsl,s32gen1-rtc";
		#interrupt-cells = <3>;
		reg = <0x0 0x40060000 0x0 0x1000>;
		interrupts = <0 121 4>; // RTC irq - GIC 153
		clksel = <2>; // FIRC
		dividers = <1 0>; // div512 enabled, div32 disabled
};
```

## Documentation/devicetree/bindings/usb/qcom,pmic-typec.yaml
```yaml
# SPDX-License-Identifier: (GPL-2.0-only OR BSD-2-Clause)
%YAML 1.2
---
$id: "http://devicetree.org/schemas/usb/qcom,pmic-typec.yaml#"
$schema: "http://devicetree.org/meta-schemas/core.yaml#"

title: Qualcomm PMIC based USB type C Detection Driver

maintainers:
  - Wesley Cheng <wcheng@codeaurora.org>

description: |
  Qualcomm PMIC Type C Detect

properties:
  compatible:
    enum:
      - qcom,pm8150b-usb-typec

  reg:
    maxItems: 1
    description: Type C base address

  interrupts:
    maxItems: 1
    description: CC change interrupt from PMIC

  connector:
    description: Connector type for remote endpoints
    type: object

    properties:
      compatible:
        $ref: /connector/usb-connector.yaml#/properties/compatible
        enum:
          - usb-c-connector

      power-role: true
      data-role: true

      ports:
        description: Remote endpoint connections
        type: object
        $ref: /connector/usb-connector.yaml#/properties/ports

        properties:
          port@0:
            description: Remote endpoints for the High Speed path
            type: object

          port@1:
            description: Remote endpoints for the Super Speed path
            type: object

            properties:
              endpoint@0:
                description: Connection to USB type C mux node
                type: object

              endpoint@1:
                description: Connection to role switch node
                type: object

    required:
      - compatible

required:
  - compatible
  - interrupts
  - connector

additionalProperties: false

examples:
  - |
    #include <dt-bindings/interrupt-controller/irq.h>
    pm8150b {
        #address-cells = <1>;
        #size-cells = <0>;
        pm8150b_typec: typec@1500 {
            compatible = "qcom,pm8150b-usb-typec";
            reg = <0x1500>;
            interrupts = <0x2 0x15 0x5 IRQ_TYPE_EDGE_RISING>;

            connector {
                compatible = "usb-c-connector";
                power-role = "dual";
                data-role = "dual";
                ports {
                    #address-cells = <1>;
                    #size-cells = <0>;
                    port@0 {
                        reg = <0>;
                    };
                    port@1 {
                        reg = <1>;
                        #address-cells = <1>;
                        #size-cells = <0>;
                        usb3_data_ss: endpoint@0 {
                            reg = <0>;
                            remote-endpoint = <&qmp_ss_mux>;
                        };
                        usb3_role: endpoint@1 {
                            reg = <1>;
                            remote-endpoint = <&dwc3_drd_switch>;
                        };
                    };
                };
            };
        };
    };
...
```

## Documentation/devicetree/bindings/usb/toshiba,tc7usb40mu.txt
```
Toshiba TC7USB40MU

This device muxes USB D+/D- lines between two outputs called 1D+/1D- and 2D+/2D-.
When the switch pin is asserted, we mux out 2D+/2D-, and when it's deasserted we
select 1D+/1D-.

This can be used to mux USB D+/D- lines between a USB hub and an OTG port.

PROPERTIES

- compatible:
    Usage: required
    Value type: <string>
    Definition: Should contain "toshiba,tc7usb40mu"

- switch-gpios:
    Usage: required
    Value type: <prop-encoded-array>
    Definition: Should contain the gpio used to toggle the switch. Logically
                asserting the gpio will cause the device to mux the "host"
                D+/D- lines instead of the "device" lines.

- extcon:
    Usage: required
    Value type: <prop-encoded-array>
    Definition: Should contain the extcon device for USB_HOST cable events

Example:

	usb-switch {
		compatible = "toshiba,tc7usb40mu";
		switch-gpios = <&gpio 10 GPIO_ACTIVE_HIGH>;
		extcon = <&usb_id>;
	};
```

## Documentation/devicetree/bindings/video/fsl,s32v234-h264decoder.txt
```
Freescale H264 Decoder interface

Describes the H264 decoder configuration.

Required properties:
- compatible: "fsl,<chip>-h264dcd", chip should be s32v234
- registers: should contain the H264 decoder register range
            (64 bits address and 32 bits length)
- interrupts: Should enumerate all the H264 Decoder interrupt
              IDs: 136 to 149.

Required nodes:
- clocks: Must contain an entry for each entry in clock-names.
		See ../clocks/clock-bindings.txt for details.
- clock-names: Must include the following entries:
	- fsl_h264dcd
	- ips_clock


Example:

aips1: aips-bus@40080000 {

	...

	h264decoder: h264decoder@400D8000 {
			compatible = "fsl,s32v234-h264dcd";
			reg = <0x0 0x400D8000 0x0 0x1000>;
			interrupts = <0 136 1>,
				     <0 137 1>,
				     <0 138 1>,
				     <0 139 1>,
				     <0 140 1>,
				     <0 141 1>,
				     <0 142 1>,
				     <0 143 1>,
				     <0 144 1>,
				     <0 145 1>,
				     <0 146 1>,
				     <0 147 1>,
				     <0 148 1>,
				     <0 149 1>;
			clocks = <&clks S32V234_CLK_H264_DEC>,
				 <&clks S32V234_CLK_SYS6>;
			clock-names = "fsl_h264dcd", "ips_clock";
			status = "disabled";
		};
	...

};

&h264decoder {
	status = "okay";
};
```

## Documentation/devicetree/bindings/video/fsl,s32v234-jpegdecoder.txt
```
Freescale JPEG Decoder interface

Describes the JPEG decoder configuration.

Required properties:
- compatible: "fsl,<chip>-jpegdcd", chip should be s32v234
- registers: should contain the JPEG decoder register range
            (64 bits address and 32 bits length)
- interrupts: Should enumerate all the JPEG Decoder interrupt
              IDs: 128 to 135.

Required nodes:
- clocks: Must contain an entry for each entry in clock-names.
		See ../clocks/clock-bindings.txt for details.
- clock-names: Must include the following entries:
	- fsl_jpegdcd
	- bclock


Example:

aips1: aips-bus@40080000 {

	...

	jpegdecoder: jpegdecoder@400D4000 {
			compatible = "fsl,s32v234-jpegdcd";
			reg = <0x0 0x400D4000 0x0 0x1000>;
			interrupts = <0 128 1>,
				     <0 129 1>,
				     <0 130 1>,
				     <0 131 1>,
				     <0 132 1>,
				     <0 133 1>,
				     <0 134 1>,
				     <0 135 1>;
			clocks = <&clks S32V234_CLK_MJPEG>,
				 <&clks S32V234_CLK_SYS6>;
			clock-names = "fsl_jpegdcd" "bclock";
			status = "disabled";
		};
	...

};

&jpegdecoder {
	status = "okay";
};
```

## Documentation/devicetree/bindings/video/fsl,s32v234-mipicsi2.txt
```
Freescale MIPI-CSI2 interface

Describes camera serial interface configuration.

Required properties:
- compatible: "fsl,<chip>-mipicsi2-<I/F ID>", chip should be s32v234
- reg: Should contain the mipicsi2 register range (address and length - both
		64bit)
- interrupts: Should enumerate MIPICSI2 NVIC interrupt IDs.

Required nodes:
- sensor: Phandle to a sensor node placed in corresponding I2C bus.
	Additional, the sensor node has to define properties:
	- compatible: "fsl,<chip>-mipicsi2", chip should be s32v234
	- reg: address of the device on i2c bus (without r/w bit)
	- init_mode: string description of the image mode to be configured by default.
			String format: "<width>x<height>x<pixel_format>".
			Unsupported strings will be ignored.
- clocks: Must contain an entry for each entry in clock-names.
		See ../clocks/clock-bindings.txt for details.
- clock-names: Must include the following entries:
	- mipicsi2

Pinmuxing note:
- Connected sensor might require specific pin muxing setup. Corresponding
	entries have to be added to s32v234-evb.dts and defined in:
	include/dt-bindings/pinctrl/s32v234-pinctrl.h and
	drivers/pinctrl/freescale/pinctrl-s32v234.c.

Example:
aips0: aips-bus@40000000 {

	...

	mipicsi0: mipicsi2_0@40030000{
		compatible = "fsl,s32v234-mipicsi2-0";
		reg = <0x0 0x40030000 0x0 0x1000>;
		interrupts =  <0 91 1>,
		<0 93 1>;
		sensor = <0x0>; // nothing connected
		clocks = <&clks S32V234_CLK_SYS6>;
		clock-names = "mipicsi2";

		status = "disabled";
	};

	...

	i2c0: i2c@40051000 {
		// sony camera
		sony_cam: sensor@1a {
			compatible = "sony,imx224mqv";
			reg = <0x1a>;
			init_mode = "1280x720xRAW12";
		};
	};
};

aips1: aips-bus@40080000 {

	...

	mipicsi1: mipicsi2_1@400A0000{
		compatible = "fsl,s32v234-mipicsi2-1";
		reg = <0x0 0x400A0000 0x0 0x1000>;
		interrupts = 	<0 92 1>,
		<0 94 1>;
		sensor = <0x0>;   // nothing connected
		clocks = <&clks S32V234_CLK_SYS6>;
		clock-names = "mipicsi2";

		status = "disabled";
	};

	...

};

&mipicsi0 {
	status = "okay";
};

&mipicsi1 {
	status = "okay";
};
```

## Documentation/devicetree/bindings/video/fsl,s32v234-vseq.txt
```
Freescale Vision Sequencer

Describes Vision Sequencer HW configuration.

Required properties:
- compatible: "fsl,<chip>-vseq", chip should be s32v234
- reg: Should contain the Sequencer control block and event control block
		register ranges (address and length - both 64bit)
- interrupts: Should enumerate Sequencer NVIC interrupt IDs.

Example:
vseq: vision_sequencer@7C021000 {
		compatible = "fsl,s32v234-vseq";
		reg = <0x0 0x7C021000 0x0 0x1000>,
		<0x0 0x7C022000 0x0 0x1000>;
		interrupts = 	<0 113 1>,
									<0 114 1>;
		status = "disabled";
};

&vseq {
	status = "okay";
};
```

## Documentation/devicetree/bindings/video/fsl,sii902x.txt
```
Silicon Image HDMI transceiver as integrated on some Freescale boards

Describes HDMI transceiver configuration.

Required properties:
- compatible: "fsl,sii902x"
- reg: address of the device on i2c bus (without r/w bit)

Example:

hdmi: sii9022a@39 {
	compatible = "fsl,sii902x";
	reg = <0x39>;
};
```

## Documentation/devicetree/bindings/virtio/blocknames.txt
```
* virtio block names

Required properties:

- compatible:	"virt_blk,names" compatibility string
- block-names:	Name of the partitions to set for virtual disks

Example:

        virt_blk: virt_blk {
                compatible = "virt_blk,names";
                block-names = "la_system",
                                "la_userdata",
                                "la_vendor",
                                "la_persist",
                                "modem",
                                "bluetooth",
                                "la_misc",
                                "vbmeta";
        };
```

## Documentation/devicetree/bindings/viulite/fsl_viulite.txt
```
* Freescale Video Interface Unit Lite (VIULite)

Required properties:
- compatible: Should be "fsl,s32v234-viulite0" or "fsl,s32v234-viulite1".
- reg: Address and length of the register set for VIULite.
- interrupts: Should contain VIULite interrupts.


Examples:

viulite0: viulite0@40064000 {
 	compatible = "fsl,s32v234-viulite0";
 	reg = <0x0 0x40064000 0x0 0x1000>;
 	interrupts = <0 96 4>;
 	status = "disabled";
 };

viulite1: viulite1@400D0000 {
 	compatible = "fsl,s32v234-viulite1";
 	reg = <0x0 0x400D0000 0x0 0x1000>;
 	interrupts = <0 100 4>;
 	status = "disabled";
 };
```

## Documentation/devicetree/bindings/watchdog/fsl,s32gen1-swt.txt
```
* NXP S32-Gen1 Watchdog Timer (WDT) Controller

Required properties:
- compatible : Should be "fsl,s32gen1-wdt"
- reg : Should contain WDT registers location and length
- clocks: Should contain WDT clock source

Examples:

swt3: swt@4010C000 {
	compatible = "fsl,s32gen1-wdt", "fsl,sac58r-wdt";
	reg = <0x0 0x4010C000 0x0 0x1000>;
	clocks = <&clks S32GEN1_CLK_FIRC>;
	clock-names = "swt";
	status = "disabled";
};
```

## arch/arm/configs/android_origen_defconfig
```kconfig
CONFIG_EXPERIMENTAL=y
CONFIG_SYSVIPC=y
CONFIG_POSIX_MQUEUE=y
CONFIG_BSD_PROCESS_ACCT=y
CONFIG_IKCONFIG=y
CONFIG_IKCONFIG_PROC=y
CONFIG_LOG_BUF_SHIFT=16
CONFIG_BLK_DEV_INITRD=y
# CONFIG_SYSCTL_SYSCALL is not set
CONFIG_KALLSYMS_ALL=y
CONFIG_ASHMEM=y
CONFIG_EMBEDDED=y
CONFIG_SLAB=y
CONFIG_PROFILING=y
CONFIG_OPROFILE=y
CONFIG_KPROBES=y
CONFIG_MODULES=y
CONFIG_MODULE_FORCE_LOAD=y
CONFIG_MODULE_UNLOAD=y
CONFIG_MODULE_FORCE_UNLOAD=y
CONFIG_MODVERSIONS=y
CONFIG_MODULE_SRCVERSION_ALL=y
# CONFIG_BLK_DEV_BSG is not set
CONFIG_ARCH_EXYNOS4=y
CONFIG_S3C_LOWLEVEL_UART_PORT=2
CONFIG_MACH_SMDKC210=y
CONFIG_MACH_SMDKV310=y
CONFIG_MACH_ARMLEX4210=y
CONFIG_MACH_UNIVERSAL_C210=y
CONFIG_MACH_NURI=y
CONFIG_PL310_ERRATA_588369=y
CONFIG_PL310_ERRATA_727915=y
CONFIG_NO_HZ=y
CONFIG_HIGH_RES_TIMERS=y
CONFIG_SMP=y
CONFIG_NR_CPUS=2
CONFIG_AEABI=y
CONFIG_CMDLINE="root=/dev/mmcblk0p1 rw rootwait console=ttySAC2,115200 init=/linuxrc"
CONFIG_KEXEC=y
CONFIG_FPE_NWFPE=y
CONFIG_VFP=y
CONFIG_NEON=y
CONFIG_BINFMT_MISC=y
CONFIG_WAKELOCK=y
# CONFIG_EARLYSUSPEND is not set
CONFIG_PM_RUNTIME=y
CONFIG_PM_DEBUG=y
CONFIG_NET=y
CONFIG_PACKET=y
CONFIG_UNIX=y
CONFIG_XFRM_USER=y
CONFIG_NET_KEY=y
CONFIG_NET_KEY_MIGRATE=y
CONFIG_INET=y
CONFIG_IP_PNP=y
# CONFIG_IPV6 is not set
CONFIG_UEVENT_HELPER_PATH="/sbin/hotplug"
CONFIG_BLK_DEV_LOOP=y
CONFIG_BLK_DEV_RAM=y
CONFIG_BLK_DEV_RAM_SIZE=8192
CONFIG_SCSI=y
CONFIG_BLK_DEV_SD=y
CONFIG_CHR_DEV_SG=y
CONFIG_NETDEVICES=y
CONFIG_NET_ETHERNET=y
CONFIG_INPUT_EVDEV=y
CONFIG_INPUT_MISC=y
CONFIG_SERIAL_8250=y
CONFIG_SERIAL_SAMSUNG=y
CONFIG_SERIAL_SAMSUNG_CONSOLE=y
CONFIG_HW_RANDOM=y
CONFIG_I2C_S3C2410=y
CONFIG_SPI=y
# CONFIG_HWMON is not set
CONFIG_MFD_MAX8997=y
CONFIG_REGULATOR=y
CONFIG_REGULATOR_MAX8997=y
CONFIG_MEDIA_SUPPORT=y
CONFIG_VIDEO_DEV=y
# CONFIG_MEDIA_TUNER_CUSTOMISE is not set
CONFIG_VIDEO_FIXED_MINOR_RANGES=y
CONFIG_VIDEO_HELPER_CHIPS_AUTO=y
CONFIG_DRM=y
CONFIG_ION=y
CONFIG_VIDEO_OUTPUT_CONTROL=y
CONFIG_FB=y
CONFIG_FIRMWARE_EDID=y
CONFIG_BACKLIGHT_LCD_SUPPORT=y
CONFIG_LCD_CLASS_DEVICE=y
CONFIG_BACKLIGHT_CLASS_DEVICE=y
CONFIG_DISPLAY_SUPPORT=y
CONFIG_FRAMEBUFFER_CONSOLE=y
CONFIG_FRAMEBUFFER_CONSOLE_DETECT_PRIMARY=y
CONFIG_LOGO=y
CONFIG_SOUND=y
CONFIG_SND=y
CONFIG_SND_SOC=y
CONFIG_SND_SOC_SAMSUNG=y
CONFIG_USB_GADGET=y
CONFIG_USB_ULPI=y
CONFIG_MMC=y
CONFIG_MMC_SDHCI=y
CONFIG_MMC_SDHCI_PLTFM=y
CONFIG_MMC_SDHCI_S3C=y
CONFIG_MMC_SDHCI_S3C_DMA=y
CONFIG_SWITCH=y
CONFIG_RTC_CLASS=y
CONFIG_RTC_DRV_S3C=y
CONFIG_STAGING=y
CONFIG_ANDROID=y
CONFIG_ANDROID_BINDER_IPC=y
CONFIG_ANDROID_LOGGER=y
CONFIG_ANDROID_RAM_CONSOLE=y
CONFIG_ANDROID_TIMED_GPIO=y
CONFIG_ANDROID_LOW_MEMORY_KILLER=y
CONFIG_EXT2_FS=y
CONFIG_EXT3_FS=y
CONFIG_EXT4_FS=y
CONFIG_MSDOS_FS=y
CONFIG_VFAT_FS=y
CONFIG_TMPFS=y
CONFIG_TMPFS_POSIX_ACL=y
CONFIG_CRAMFS=y
CONFIG_ROMFS_FS=y
CONFIG_NFS_FS=y
CONFIG_ROOT_NFS=y
CONFIG_PARTITION_ADVANCED=y
CONFIG_BSD_DISKLABEL=y
CONFIG_SOLARIS_X86_PARTITION=y
CONFIG_NLS_CODEPAGE_437=y
CONFIG_NLS_ASCII=y
CONFIG_NLS_ISO8859_1=y
CONFIG_MAGIC_SYSRQ=y
CONFIG_DEBUG_KERNEL=y
CONFIG_DETECT_HUNG_TASK=y
CONFIG_DEBUG_RT_MUTEXES=y
CONFIG_DEBUG_SPINLOCK=y
CONFIG_DEBUG_MUTEXES=y
CONFIG_DEBUG_SPINLOCK_SLEEP=y
CONFIG_DEBUG_INFO=y
CONFIG_DEBUG_MEMORY_INIT=y
CONFIG_SYSCTL_SYSCALL_CHECK=y
CONFIG_DEBUG_USER=y
CONFIG_DEBUG_LL=y
CONFIG_EARLY_PRINTK=y
CONFIG_DEBUG_S3C_UART=2
CONFIG_CRC_CCITT=y
CONFIG_XZ_DEC=y
```
