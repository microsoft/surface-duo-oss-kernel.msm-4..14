## Documentation/devicetree/bindings/sound/qcom,q6adm.txt
```
Qualcomm Audio Device Manager (Q6ADM) binding

Q6ADM is one of the APR audio service on Q6DSP.
Please refer to qcom,apr.txt for details of the coommon apr service bindings
used by the apr service device.

- but must contain the following property:

- compatible:
	Usage: required
	Value type: <stringlist>
	Definition: must be "qcom,adm-v<MAJOR-NUMBER>.<MINOR-NUMBER>".
		   Or "qcom,adm" where the version number can be queried
		   from DSP.
		   example "qcom,adm-v2.0"


= ADM routing
"routing" subnode of the ADM node represents adm routing specific configuration

- #sound-dai-cells
	Usage: required
	Value type: <prop-encoded-array>
	Definition: Must be 0

= EXAMPLE
q6adm: q6adm {
	compatible = "qcom,q6adm";
	qcom,apr-svc-name = "ADM";
	qcom,apr-svc-id = <APR_SVC_ADM>;
	q6routing: routing {
		#sound-dai-cells = <0>;
	};
};
```

## Documentation/devicetree/bindings/sound/qcom,q6afe.txt
```
Qualcomm Audio Front End (Q6AFE) binding

AFE is one of the APR audio service on Q6DSP
Please refer to qcom,apr.txt for details of the common apr service bindings
used by all apr services.

- but must contain the following property:

- compatible:
	Usage: required
	Value type: <stringlist>
	Definition: must be "qcom,afe-v<MAJOR-NUMBER>.<MINOR-NUMBER>"
		  Or "qcom,afe" where the version number can be queried
		  from DSP.
		  example "qcom,afe-v2.0"

= AFE DAIs (Digial Audio Interface)
"dais" subnode of the AFE node represents dai specific configuration

- #sound-dai-cells
	Usage: required
	Value type: <prop-encoded-array>
	Definition: Must be 1

- reg
	Usage: required
	Value type: <prop-encoded-array>
	Definition: Must be dai id

- interface-type
	Usage: required
	Value type: <stringlist>
	Definition: Must be one of following
	"mi2s"
	"hdmi"
	"pcm"
	"slim"

- qcom,sd-lines
	Usage: required for mi2s interface
	Value type: <prop-encoded-array>
	Definition: Must be list of serial data lines used by this dai.
	should be one or more of the 1-4 sd lines.

= EXAMPLE

q6afe {
	compatible = "qcom,q6afe";
	qcom,apr-svc-name = "AFE";
	qcom,apr-svc-id = <APR_SVC_AFE>;

	q6asmdai: dais {
		#sound-dai-cells = <1>;
		hdmi@1 {
			reg = <1>;
			interface-type = "hdmi";
		};

		prim-mi2s-rx@16 {
			reg = <16>;
			qcom,sd-lines = <1 3>;
			interface-type = "mi2s";
		};

		prim-mi2s-tx@17 {
			reg = <17>;
			qcom,sd-lines = <2>;
			interface-type = "mi2s";
		};

		sec-mi2s-rx@18 {
			reg = <18>;
			qcom,sd-lines = <1 4>;
			interface-type = "mi2s";
		};

		sec-mi2s-tx@19 {
			reg = <19>;
			qcom,sd-lines = <2>;
			interface-type = "mi2s";
		};

		tert-mi2s-rx@20 {
			reg = <20>;
			qcom,sd-lines = <2 4>;
			interface-type = "mi2s";
		};

		tert-mi2s-tx@21 {
			reg = <21>;
			qcom,sd-lines = <1>;
			interface-type = "mi2s";
		};

		quat-mi2s-rx@22 {
			reg = <22>;
			qcom,sd-lines = <1>;
			interface-type = "mi2s";
		};

		quat-mi2s-tx@23 {
			reg = <23>;
			qcom,sd-lines = <2>;
			interface-type = "mi2s";
		};
	};
};
```

## Documentation/devicetree/bindings/sound/qcom,q6asm.txt
```
Qualcomm Audio Stream Manager (Q6ASM) binding

Q6ASM is one of the APR audio service on Q6DSP.
Please refer to qcom,apr.txt for details of the coommon apr service bindings
used by the apr service device.

- but must contain the following property:

- compatible:
	Usage: required
	Value type: <stringlist>
	Definition: must be "qcom,asm-v<MAJOR-NUMBER>.<MINOR-NUMBER>".
		    Or "qcom,asm" where the version number can be queried
		    from DSP.
		    example "qcom,asm-v2.0"

= ASM DAIs (Digial Audio Interface)
"dais" subnode of the ASM node represents dai specific configuration

- #sound-dai-cells
	Usage: required
	Value type: <prop-encoded-array>
	Definition: Must be 1

= EXAMPLE

q6asm: q6asm {
	compatible = "qcom,q6asm";
	qcom,apr-svc-name = "ASM";
	qcom,apr-svc-id = <APR_SVC_ASM>;
	q6asmdai: dais {
		#sound-dai-cells = <1>;
	};
};
```

## Documentation/devicetree/bindings/thermal/qcom-spmi-adc-tm5.yaml
```yaml
# SPDX-License-Identifier: (GPL-2.0 OR BSD-2-Clause)
%YAML 1.2
---
$id: http://devicetree.org/schemas/thermal/qcom-spmi-adc-tm5.yaml#
$schema: http://devicetree.org/meta-schemas/core.yaml#

title: Qualcomm's SPMI PMIC ADC-TM
maintainers:
  - Dmitry Baryshkov <dmitry.baryshkov@linaro.org>

properties:
  compatible:
    const: qcom,spmi-adc-tm5

  reg:
    maxItems: 1

  interrupts:
    maxItems: 1

  "#thermal-sensor-cells":
    const: 1
    description:
      Number of cells required to uniquely identify the thermal sensors. Since
      we have multiple sensors this is set to 1

  "#address-cells":
    const: 1

  "#size-cells":
    const: 0

  io-channels:
    description:
      From common IIO binding. Used to pipe PMIC ADC channel to thermal monitor

  io-channel-names:
    description:
      From common IIO binding. Names each of IIO channels. The name should
      be equal to the sensor's subnode name.

  qcom,avg-samples:
    $ref: /schemas/types.yaml#/definitions/uint32
    description: Number of samples to be used for measurement.
    enum:
      - 1
      - 2
      - 4
      - 8
      - 16
    default: 1

  qcom,decimation:
    $ref: /schemas/types.yaml#/definitions/uint32
    description: This parameter is used to decrease ADC sampling rate.
    enum:
      - 250
      - 420
      - 840
    default: 840

patternProperties:
  "^([-a-z0-9]*)@[0-9]+$":
    type: object
    description:
      Represent one thermal sensor.

    properties:
      reg:
        description: Specify the sensor channel.
        maxItems: 1

      qcom,adc-channel:
        $ref: /schemas/types.yaml#/definitions/uint32
        description: Corresponding ADC channel ID.

      qcom,ratiometric:
        $ref: /schemas/types.yaml#/definitions/flag
        description:
          Channel calibration type.
          If this property is specified VADC will use the VDD reference
          (1.875V) and GND for channel calibration. If property is not found,
          channel will be calibrated with 0V and 1.25V reference channels,
          also known as absolute calibration.

      qcom,hw-settle-time:
        $ref: /schemas/types.yaml#/definitions/uint32
        description: Time between AMUX getting configured and the ADC starting conversion.

      qcom,pre-scaling:
        $ref: /schemas/types.yaml#/definitions/uint32-array
        description: Used for scaling the channel input signal before the signal is fed to VADC. See qcom,spi-vadc specification for the list of possible values.
        minItems: 2
        maxItems: 2

    required:
      - reg
      - qcom,adc-channel

    additionalProperties:
      false

required:
  - compatible
  - reg
  - interrupts
  - "#address-cells"
  - "#size-cells"
  - "#thermal-sensor-cells"

additionalProperties: false

examples:
  - |
        pm8150b_adc: adc@3100 {
            compatible = "qcom,spmi-adc5";
            /* Other propreties are omitted */
            conn-therm@4f {
                reg = <ADC5_AMUX_THM3_100K_PU>;
                qcom,ratiometric;
                qcom,hw-settle-time = <200>;
            };
        };

        pm8150b_adc_tm: adc-tm@3500 {
            compatible = "qcom,spmi-adc-tm5";
            reg = <0x3500>;
            interrupts = <0x2 0x35 0x0 IRQ_TYPE_EDGE_RISING>;
            #thermal-sensor-cells = <1>;
            #address-cells = <1>;
            #size-cells = <0>;
            io-channels = <&pm8150b_adc ADC5_AMUX_THM3_100K_PU>;
            io-channel-names = "conn-therm";

            conn-therm@0 {
                reg = <0>;
                qcom,adc-channel = <ADC5_AMUX_THM3_100K_PU>;
                qcom,ratiometric;
                qcom,hw-settle-time = <200>;
            };
        };
...
```

## Documentation/devicetree/bindings/thermal/qcom-tsens.txt
```
* QCOM SoC Temperature Sensor (TSENS)

Required properties:
- compatible :
 - "qcom,msm8916-tsens" : For 8916 Family of SoCs
 - "qcom,msm8974-tsens" : For 8974 Family of SoCs

- reg: Address range of the thermal registers
- qcom,tsens-slopes : Must contain slope value for each of the sensors controlled
			by this device
- #thermal-sensor-cells : Should be 1. See ./thermal.txt for a description.
- Refer to Documentation/devicetree/bindings/nvmem/nvmem.txt to know how to specify
nvmem cells

Optional properties:
- qcom,sensor-id: List of sensor instances used in a given SoC. A TSENS IP can
		  have a fixed number of sensors (like 11) but a given SoC can
		  use only 5 of these and they might not always the first 5. They
		  could be sensors 0, 1, 4, 8 and 9. This property is used to
		  describe the subset of the sensors used. If this property is
		  missing they are assumed to be the first 'n' sensors numbered
		  sequentially in which case the number of sensors defaults to
		  the number of slope values.

Example:
tsens: thermal-sensor@900000 {
		compatible = "qcom,msm8916-tsens";
		nvmem-cells = <&tsens_caldata>, <&tsens_calsel>;
		nvmem-cell-names = "caldata", "calsel";
		qcom,tsens-slopes = <3200 3200 3200 3200 3200>;
		qcom,sensor-id = <0 1 2 4 5>;
		#thermal-sensor-cells = <1>;
	};
```

## Documentation/devicetree/bindings/thermal/s32gen1-thermal.txt
```
Copyright (C) NXP Semiconductors 2020

Required properties:
- compatible : "fsl,s32gen1-tmu"
- reg : Address range of the TMU registers

Example:
    tmu: tmu@400A8000 {
        compatible = "fsl,s32gen1-tmu";
        reg = <0x0 0x400A8000 0x0 0x3000>;
    };
```

## Documentation/devicetree/bindings/thermal/s32v234-thermal.txt
```
Copyright (C) NXP Semiconductors 2017

Required properties:
- compatible : "fsl,s32v234-tmu"
- reg : Address range of the TMU registers
- clocks : One entry, the clock for the TMU device
- clock-names : "tsens"

Example:
	tmu: tmu@400CE000 {
		compatible = "fsl,s32v234-tmu";
		reg = <0x0 0x400CE000 0x0 0x1000>;
		clocks = <&clks S32V234_CLK_TSENS>;
		clock-names = "tsens";
		status = "disabled";
	};
```
