## Documentation/devicetree/bindings/phy/qcom-qmp-phy.txt
```
Qualcomm QMP PHY
----------------

QMP phy controller supports physical layer functionality for a number of
controllers on Qualcomm chipsets, such as, PCIe, UFS, and USB.

Required properties:
 - compatible: compatible list, contains:
	       "qcom,msm8996-qmp-pcie-phy" for 14nm PCIe phy on msm8996,
	       "qcom,msm8996-qmp-usb3-phy" for 14nm USB3 phy on msm8996.
 - reg: list of offset and length pair of the PHY register sets.
	at index 0: offset and length of register set for PHY common
		    serdes block.
	from index 1 - N: offset and length of register set for each lane,
			  for N number of phy lanes (ports).
 - lane-offsets: array of offsets to tx, rx and pcs blocks for phy lanes.
 - #phy-cells: must be 1
    - Cell after phy phandle should be the port (lane) number.
 - clocks: a list of phandles and clock-specifier pairs,
	   one for each entry in clock-names.
 - clock-names: must be "cfg_ahb" for phy config clock,
			"aux" for phy aux clock,
			"ref_clk" for 19.2 MHz ref clk,
			"ref_clk_src" for reference clock source,
			"pipe<port-number>" for pipe clock specific to
			each port/lane (Optional).
 - resets: a list of phandles and reset controller specifier pairs,
	   one for each entry in reset-names.
 - reset-names: must be "phy" for reset of phy block,
			"common" for phy common block reset,
			"cfg" for phy's ahb cfg block reset (Optional).
			"port<port-number>" for reset specific to
			each port/lane (Optional).
 - vdda-phy-supply: Phandle to a regulator supply to PHY core block.
 - vdda-pll-supply: Phandle to 1.8V regulator supply to PHY refclk pll block.

Optional properties:
 - vddp-ref-clk-supply: Phandle to a regulator supply to any specific refclk
			pll block.

Example:
	pcie_phy: pciephy@34000 {
		compatible = "qcom,msm8996-qmp-pcie-phy";
		reg = <0x034000 0x48f>,
			<0x035000 0x5bf>,
			<0x036000 0x5bf>,
			<0x037000 0x5bf>;
				/* tx, rx, pcs */
		lane-offsets = <0x0 0x200 0x400>;
		#phy-cells = <1>;

		clocks = <&gcc GCC_PCIE_PHY_AUX_CLK>,
			<&gcc GCC_PCIE_PHY_CFG_AHB_CLK>,
			<&rpmcc MSM8996_RPM_SMD_LN_BB_CLK>,
			<&gcc GCC_PCIE_CLKREF_CLK>,
			<&gcc GCC_PCIE_0_PIPE_CLK>,
			<&gcc GCC_PCIE_1_PIPE_CLK>,
			<&gcc GCC_PCIE_2_PIPE_CLK>;
		clock-names = "aux", "cfg_ahb",
				"ref_clk_src", "ref_clk",
				"pipe0", "pipe1", "pipe2";

		vdda-phy-supply = <&pm8994_l28>;
		vdda-pll-supply = <&pm8994_l12>;

		resets = <&gcc GCC_PCIE_PHY_BCR>,
			<&gcc GCC_PCIE_PHY_COM_BCR>,
			<&gcc GCC_PCIE_PHY_COM_NOCSR_BCR>,
			<&gcc GCC_PCIE_0_PHY_BCR>,
			<&gcc GCC_PCIE_1_PHY_BCR>,
			<&gcc GCC_PCIE_2_PHY_BCR>;
		reset-names = "phy", "common", "cfg",
				"lane0", "lane1", "lane2";
	};
```

## Documentation/devicetree/bindings/pinctrl/fsl,s32v234-siul2-pinctrl.txt
```
* Freescale SIUL2 iomux controller

See chapter 20 ("System Integration Unit Lite2 (SIUL2)") in the reference
manual[1].

Based on fsl,imx-pincontrol implementation.

Required properties:
- compatible:
	* "fsl,s32v234-siul2-pinctrl"
	  Latest version.
	* "fsl,s32v234-siul2" <DEPRECATED>
	  Backward compatible string for the use cases
	  when the user boots kernel with an old device tree. It's not
	  recommended to use it anymore.
- fsl,pins: two integers array, represents a group of pins mux and config
  setting. The format is fsl,pins = <PIN_FUNC_ID CONFIG>
  PIN_FUNC_ID - id of MSCR to be modified
  CONFIG - configuration to be written in the MSCR/IMCR register

  Even though IMCR register should be used as input register, it can be
  set and addressed in the same way as MSCR, only instead of passing the
  IMCR index, IMCR_IDX + 512 is passed[1].

  Some pads can be configured only through SRC_GPR regitsters. If this is
  the case, PIN_FUNC_ID will be obtained from SRC_GPR index and the offset
  in the register using S32V234_PAD_GPR macro:
	* S32V234_PAD_GPR(n, m) will address bit m from SRC_GPRn.
  CONFIG can be 1 or 0 in SRC_GPR case.
  Eg:
	#define S32V234_PAD_GPR8__SPI0_SCK_IN	\
			S32V234_PAD_GPR(8, 31) S32V234_PAD_GPR_EN

[1] https://www.nxp.com/webapp/Download?colCode=S32V234RM
```

## Documentation/devicetree/bindings/pinctrl/fsl,s32v234-siul2.txt
```
* Freescale SIUL2 iomux controller

Based on fsl,imx-pincontrol implementation.

Required properties:
- compatible: "fsl,siul2-pinctrl"
- fsl,pins: two integers array, represents a group of pins mux and config
  setting. The format is fsl,pins = <PIN_FUNC_ID CONFIG>
  PIN_FUNC_ID - id of MSCR to be modified
  CONFIG - configuration to be written in the MSCR/IMCR register

  Even though IMCR register should be used as input register, it can be
  set and addressed in the same way as MSCR, only instead of passing the
  IMCR index, IMCR_IDX + 512 is passed.

  Refer to s32v234-pinfunc.h in device tree source folder for all
  available s32v234 PIN_FUNC_IDS.
```

## Documentation/devicetree/bindings/pinctrl/nxp,s32gen1-siul2-pinctrl.txt
```
* NXP SIUL2 iomux controller

Based on S32Gen1 SIUL2 implementation.

Required properties:
- compatible:
	* "fsl,s32g275-siul2_0-pinctrl"
	* "fsl,s32g275-siul2_1-pinctrl"
	* "fsl,s32r45x-siul2_0-pinctrl"
	* "fsl,s32r45x-siul2_1-pinctrl"
	* "fsl,s32v344-siul2_0-pinctrl"
	* "fsl,s32v344-siul2_1-pinctrl"
	  Backward compatible string for the use cases
	  when the user boots kernel with an old device tree. It's not
	  recommended to use it anymore.
- fsl,pins: two integers array, represents a group of pins mux and config
  setting. The format is fsl,pins = <PIN_FUNC_ID CONFIG>
  PIN_FUNC_ID - id of MSCR to be modified
  CONFIG - configuration to be written in the MSCR/IMCR register

  Even though IMCR register should be used as input register, it can be
  set and addressed in the same way as MSCR, only instead of passing the
  IMCR index, IMCR_IDX + 512 is passed.
```

## Documentation/devicetree/bindings/pinctrl/qcom,pmic-mpp.txt
```
Qualcomm PMIC Multi-Purpose Pin (MPP) block

This binding describes the MPP block(s) found in the 8xxx series of pmics from
Qualcomm.

- compatible:
	Usage: required
	Value type: <string>
	Definition: must be one of:
		    "qcom,pm8841-mpp"
		    "qcom,pm8941-mpp"
		    "qcom,pma8084-mpp"

- reg:
	Usage: required
	Value type: <u32>
	Definition: Register base of the gpio block

- interrupts:
	Usage: required
	Value type: <prop-encoded-array>
	Definition: Must contain an array of encoded interrupt specifiers for
		    each available gpio

- gpio-controller:
	Usage: required
	Value type: <none>
	Definition: Mark the device node as a GPIO controller

- #gpio-cells:
	Usage: required
	Value type: <u32>
	Definition: Must be 2;
		    the first cell will be used to define gpio number and the
		    second denotes the flags for this gpio

Please refer to ../gpio/gpio.txt and ../interrupt-controller/interrupts.txt for
a general description of GPIO and interrupt bindings.

Please refer to pinctrl-bindings.txt in this directory for details of the
common pinctrl bindings used by client devices, including the meaning of the
phrase "pin configuration node".

The pin configuration nodes act as a container for an abitrary number of
subnodes. Each of these subnodes represents some desired configuration for a
pin or a list of pins. This configuration can include the
mux function to select on those pin(s), and various pin configuration
parameters, as listed below.


SUBNODES:

The name of each subnode is not important; all subnodes should be enumerated
and processed purely based on their content.

Each subnode only affects those parameters that are explicitly listed. In
other words, a subnode that lists a mux function but no pin configuration
parameters implies no information about any pin configuration parameters.
Similarly, a pin subnode that describes a pullup parameter implies no
information about e.g. the mux function.

The following generic properties as defined in pinctrl-bindings.txt are valid
to specify in a pin configuration subnode:

- pins:
	Usage: required
	Value type: <string-array>
	Definition: List of gpio pins affected by the properties specified in
		    this subnode.  Valid pins are:
		    mpp1-mpp4 for pm8841
		    mpp1-mpp8 for pm8941
		    mpp1-mpp4 for pma8084

- function:
	Usage: optional
	Value type: <string>
	Definition: Specify the alternative function to be configured for the
		    specified pins.  Valid values are:
		    "normal",
		    "paired",
		    "dtest1",
		    "dtest2",
		    "dtest3",
		    "dtest4"

- qcom,mode:
	Usage: optional
	Value type: <u32>
	Definition: Selects MPP mode of operation: Digital Input, Digital Output,
		    Digital Input and Digital Output, Bidirectional Logic,
		    Analog Input, Analog Output, Current Sink Valid values are
		    defined in <dt-bindings/pinctrl/qcom,pmic-mpp.h>
		    PMIC_MPP_MODE_DI, PMIC_MPP_MODE_DO, PMIC_MPP_MODE_DIO...

- bias-disable:
	Usage: optional
	Value type: <none>
	Definition: The specified pins should be configued as no pull.

- bias-pull-up:
	Usage: optional
	Value type:  <u32>
	Definition: The specified pins should be configued as pull up.
		    Valid values are 600, 10000 and 30000.

- bias-high-impedance:
	Usage: optional
	Value type: <none>
	Definition: The specified pins will put in high-Z mode and disabled.

- input-enable:
	Usage: optional
	Value type: <none>
	Definition: The specified pins are put in input mode.

- output-high:
	Usage: optional
	Value type: <none>
	Definition: The specified pins are configured in output mode, driven
		    high.

- output-low:
	Usage: optional
	Value type: <none>
	Definition: The specified pins are configured in output mode, driven
		    low.

- power-source:
	Usage: optional
	Value type: <u32>
	Definition: Selects the power source for the specified pins. Valid only
		    when pin operate in Digital I/O mode ("gpio"). Valid
		    power sources are defined in
		    <dt-bindings/pinctrl/qcom,pmic-mpp.h>

- drive-strength:
	Usage: optional
	Value type: <u32>
	Definition: Selects the drive strength for the specified pins. Value
		    drive strengths are: 5-40mA with 5mA step

- qcom,amux-route:
	Usage: optional
	Value type: <u32>
	Definition: Selects the source for analog input. Valid values are
		    defined in <dt-bindings/pinctrl/qcom,pmic-mpp.h>
		    PMIC_MPP_AMUX_ROUTE_CH5, PMIC_MPP_AMUX_ROUTE_CH6...

- qcom,vrefence:
	Usage: optional
	Value type: <u32>
	Definition: Selects the analog output voltage reference. Valid values
		    are defined in <dt-bindings/pinctrl/qcom,pmic-mpp.h>
		    PMIC_MPP_VREFERENCE_1V25, PMIC_MPP_VREFERENCE_0V625...

Example:

	mpps@a000 {
		compatible = "qcom,pm8841-mpp";
		reg = <0xa000>;
		gpio-controller;
		#gpio-cells = <2>;
		interrupts = <4 0xa0 0 0>, <4 0xa1 0 0>, <4 0xa2 0 0>, <4 0xa3 0 0>;

		pinctrl-names = "default";
		pinctrl-0 = <&pm8841_default>;

		pm8841_default: default {
			gpio {
				pins = "mpp1", "mpp2", "mpp3", "mpp4";
				function = "normal";

				input-enable;

				power-source = <PM8841_MPP_S3>;
				bias-pull-up = <600>;
			};
		};
	};
```

## Documentation/devicetree/bindings/power/reset/fsl,s32gen1-prstc.txt
```
* NXP S32GEN1 Power Reset Controller

Required properties:
- compatible :
  - "fsl,s32gen1-prstc" for device that has an S32GEN1 compatible reboot
  mechanism

Example:
reset_0: reset@40078000 {
	compatible = "fsl,s32gen1-prstc";
};
```

## Documentation/devicetree/bindings/power/reset/fsl,s32gen1-reset.txt
```
* NXP S32GEN1 Reboot

Required properties:
- compatible :
  - "fsl,s32gen1-reset" for device that has an S32GEN1 compatible reboot
  mechanism
- reg : A pair of addresses and lengths of the register set for the device. The
  first one is for the MC RGM registers, the second is for the MC ME registers.

Example:
reset_0: reset@40078000 {
	compatible = "fsl,s32gen1-reset";
	      /* MC RGM */
	reg = <0x0 0x40078000 0x0 0x3000>,
	      /* MC ME */
	      <0x0 0x40088000 0x0 0x1000>;
};
```

## Documentation/devicetree/bindings/regulator/fsl,s32v234-dummy-pureg.txt
```
Dummy regulator needed by the Vivante GPU driver

- The Vivante GPU driver requires a regulator to be set

- Example:
	pu_dummy: pudummy_reg {
		/* only used in ldo-bypass */
		/* used by the gpu driver */
		compatible = "fsl,s32v234-dummy-pureg";
	};
```

## Documentation/devicetree/bindings/reserved-memory/fsl,s32-shm.txt
```
* NXP Reserved Shared Memory regions *

Shared reserved memory is specified as a node under the /reserved-memory node.
The operating system shall exclude reserved memory from normal usage
one can create child nodes describing particular reserved (excluded from
normal use) memory regions. Such memory regions are usually designed for
the special usage by various device drivers.
tese nodes can be referenced from other nodes.

Required properties:
- compatible:
  - "fsl,s32v234-shm", for S32V234 SoCs
  - "fsl,s32gen1-shm", for S32Gen1 SoCs
- reg: base address and length of the shared mem block

Example:

  reserved-memory {
    #address-cells = <2>;
    #size-cells = <2>;
    ranges;

    /* 4Mb shared memory for PCIe shared mem transfers, EP mode */
    pci_shared_memory: shm@0xc0000000 {
      compatible = "fsl,s32gen1-shm";
      reg = <0x0 0xc0000000 0x0 0x400000>;    /* 4 MB */
      no-map;
    };
  };
```

## Documentation/devicetree/bindings/reset/fsl,s32gen1-reset.yaml
```yaml
# SPDX-License-Identifier: (GPL-2.0 OR BSD-2-Clause)
# Copyright 2021 NXP
%YAML 1.2
---
$id: "http://devicetree.org/schemas/reset/fsl,s32gen1-reset.yaml#"
$schema: "http://devicetree.org/meta-schemas/core.yaml#"

title: NXP S32GEN1 SoCs Reset Controller

maintainers:
  - Ghennadi Procopciuc <ghennadi.procopciuc@nxp.com>

properties:
  compatible:
    contains:
      enum:
        - fsl,s32g2-reset # Reset Controller for S32G2 SoCs
        - fsl,s32r45-reset # Reset Controller for S32R45 SoC

  reg:
    maxItems: 1

  "#reset-cells":
    const: 1

required:
  - compatible
  - reg
  - "#reset-cells"

additionalProperties: false

examples:
  - |
    reset: rgm@40078000 {
        compatible = "fsl,s32r45-reset";
        reg = <0x0 0x40078000 0x0 0x3000>;
        #reset-cells = <1>;
    };
```

## Documentation/devicetree/bindings/reset/fsl,s32v234-mc_rgm.txt
```
Copyright 2017 NXP
Reset Generation Module (MC_RGM)

The reset generation module (MC_RGM) centralizes the different
reset sources and manages the reset sequence of the chip. It
provides a register interface and the reset sequencer. Various
registers are available to monitor and control the chip reset
sequence. The reset sequencer is a state machine which controls
the different phases (PHASE0, PHASE1, PHASE2, PHASE3, and IDLE)
of the reset sequence and controls the reset signals generated
in the system.
===========================================

Please also refer to reset.txt in this directory for common reset
controller binding usage.

Required properties:
- compatible: Should be "fsl,s32v234-mc_rgm"
- reg: should be register base and length as documented in the
  datasheet

example:

mc_rgm: mc_rgm@40048000 {
				compatible = "fsl,s32v234-mc_rgm";
				reg = <0x0 0x40048000 0x0 0x1000>;
			};
```

## Documentation/devicetree/bindings/serial/fsl,s32-linflexuart.txt
```
* Freescale Linflex UART

Required properties:
- compatible :
  - "fsl,s32-linflexuart" for linflex configured in uart mode which
  is compatible with the one integrated on S32V234 SoC
- reg : Address and length of the register set for the device
- interrupts : Should contain uart interrupt
- clocks : phandle + clock specifier pairs, one for each entry in clock-names
- clock-names : should contain: "lin" - the uart clock

Example:
uart0:serial@40053000 {
	compatible = "fsl,s32-linflexuart";
	reg = <0x0 0x40053000 0x0 0x1000>;
	interrupts = <0 59 4>;
	clocks = <&clks	S32V234_CLK_LIN>;
	clock-names = "lin";
	status = "disabled";
};
```
