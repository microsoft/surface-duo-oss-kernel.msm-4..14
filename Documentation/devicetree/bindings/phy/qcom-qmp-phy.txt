## Documentation/devicetree/bindings/soc/qcom/qcom,apr.txt
```
Qualcomm APR (Asynchronous Packet Router) binding

This binding describes the Qualcomm APR. APR is a IPC protocol for
communication between Application processor and QDSP. APR is mainly
used for audio/voice services on the QDSP.

- compatible:
	Usage: required
	Value type: <stringlist>
	Definition: must be "qcom,apr-v<VERSION-NUMBER>", example "qcom,apr-v2"

- qcom,apr-dest-domain-id
	Usage: required
	Value type: <prop-encoded-array>
	Definition: Destination processor ID.
	Possible values are :
			1 - APR simulator
			2 - PC
			3 - MODEM
			4 - ADSP
			5 - APPS
			6 - MODEM2
			7 - APPS2

= APR SERVICES
Each subnode of the APR node represents service tied to this apr. The name
of the nodes are not important. The properties of these nodes are defined
by the individual bindings for the specific service
- All APR services MUST contain the following property:

- qcom,apr-svc-id
	Usage: required
	Value type: <prop-encoded-array>
	Definition: APR Service ID, used for matching the service.
	Possible values are :
			3 - DSP Core Service
			4 - Audio Front End Service.
			5 - Voice Stream Manager Service.
			6 - Voice processing manager.
			7 - Audio Stream Manager Service.
			8 - Audio Device Manager Service.
			9 - Multimode voice manager.
			10 - Core voice stream.
			11 - Core voice processor.
			12 - Ultrasound stream manager.
			13 - Listen stream manager.

- qcom,apr-svc-name
	Usage: required
	Value type: <stringlist>
	Definition: User readable name of a APR service.

= EXAMPLE
The following example represents a QDSP based sound card on a MSM8996 device
which uses apr as communication between Apps and QDSP.

	apr {
		compatible = "qcom,apr-v2";
		qcom,smd-channels = "apr_audio_svc";
		qcom,apr-dest-domain-id = <APR_DOMAIN_ADSP>;

		q6core {
			compatible = "qcom,q6core";
			qcom,apr-svc-name = "CORE";
			qcom,apr-svc-id = <APR_SVC_ADSP_CORE>;
		};

		q6afe {
			compatible = "qcom,q6afe";
			qcom,apr-svc-name = "AFE";
			qcom,apr-svc-id = <APR_SVC_AFE>;
		};

		q6asm {
			compatible = "qcom,q6asm";
			qcom,apr-svc-name = "ASM";
			qcom,apr-svc-id = <APR_SVC_ASM>;
		};

		q6adm {
			compatible = "qcom,q6adm";
			qcom,apr-svc-name = "ADM";
			qcom,apr-svc-id = <APR_SVC_ADM>;
		};
	};
```

## Documentation/devicetree/bindings/soc/qcom/qcom,rpm.txt
```
Qualcomm Resource Power Manager (RPM)

This driver is used to interface with the Resource Power Manager (RPM) found in
various Qualcomm platforms. The RPM allows each component in the system to vote
for state of the system resources, such as clocks, regulators and bus
frequencies.

- compatible:
	Usage: required
	Value type: <string>
	Definition: must be one of:
		    "qcom,rpm-apq8064"
		    "qcom,rpm-msm8660"
		    "qcom,rpm-msm8960"

- reg:
	Usage: required
	Value type: <prop-encoded-array>
	Definition: two entries specifying the RPM's message ram and ipc register

- reg-names:
	Usage: required
	Value type: <string-array>
	Definition: must contain the following, in order:
		    "msg_ram"
		    "ipc"

- interrupts:
	Usage: required
	Value type: <prop-encoded-array>
	Definition: three entries specifying the RPM's:
		    1. acknowledgement interrupt
		    2. error interrupt
		    3. wakeup interrupt

- interrupt-names:
	Usage: required
	Value type: <string-array>
	Definition: must be the three strings "ack", "err" and "wakeup", in order

- #address-cells:
	Usage: required
	Value type: <u32>
	Definition: must be 1

- #size-cells:
	Usage: required
	Value type: <u32>
	Definition: must be 0


= SUBDEVICES

The RPM exposes resources to its subnodes. The below bindings specify the set
of valid subnodes that can operate on these resources.

== Switch-mode Power Supply regulator

- compatible:
	Usage: required
	Value type: <string>
	Definition: must be one of:
		    "qcom,rpm-pm8058-smps"
		    "qcom,rpm-pm8901-ftsmps"
		    "qcom,rpm-pm8921-smps"
		    "qcom,rpm-pm8921-ftsmps"

- reg:
	Usage: required
	Value type: <u32>
	Definition: resource as defined in <dt-bindings/soc/qcom,rpm.h>

- bias-pull-down:
	Usage: optional
	Value type: <empty>
	Definition: enable pull down of the regulator when inactive

- qcom,switch-mode-frequency:
	Usage: required
	Value type: <u32>
	Definition: Frequency (Hz) of the switch-mode power supply;
		    must be one of:
		    19200000, 9600000, 6400000, 4800000, 3840000, 3200000,
		    2740000, 2400000, 2130000, 1920000, 1750000, 1600000,
		    1480000, 1370000, 1280000, 1200000

- qcom,force-mode-none:
	Usage: optional (default if no other qcom,force-mode is specified)
	Value type: <empty>
	Defintion: indicates that the regulator should not be forced to any
	           particular mode

- qcom,force-mode-lpm:
	Usage: optional
	Value type: <empty>
	Definition: indicates that the regulator should be forced to operate in
	            low-power-mode

- qcom,force-mode-auto:
	Usage: optional (only available for 8960/8064)
	Value type: <empty>
	Definition: indicates that the regulator should be automatically pick
	            operating mode

- qcom,force-mode-hpm:
	Usage: optional (only available for 8960/8064)
	Value type: <empty>
	Definition: indicates that the regulator should be forced to operate in
	            high-power-mode

- qcom,force-mode-bypass: (only for 8960/8064)
	Usage: optional (only available for 8960/8064)
	Value type: <empty>
	Definition: indicates that the regulator should be forced to operate in
	            bypass mode

- qcom,power-mode-hysteretic:
	Usage: optional
	Value type: <empty>
	Definition: indicates that the power supply should operate in hysteretic
		    mode (defaults to qcom,power-mode-pwm if not specified)

- qcom,power-mode-pwm:
	Usage: optional
	Value type: <empty>
	Definition: indicates that the power supply should operate in pwm mode

Standard regulator bindings are used inside switch mode power supply subnodes.
Check Documentation/devicetree/bindings/regulator/regulator.txt for more
details.

== Low-dropout regulator

- compatible:
	Usage: required
	Value type: <string>
	Definition: must be one of:
		    "qcom,rpm-pm8058-pldo"
		    "qcom,rpm-pm8058-nldo"
		    "qcom,rpm-pm8901-pldo"
		    "qcom,rpm-pm8901-nldo"
		    "qcom,rpm-pm8921-pldo"
		    "qcom,rpm-pm8921-nldo"
		    "qcom,rpm-pm8921-nldo1200"

- reg:
	Usage: required
	Value type: <u32>
	Definition: resource as defined in <dt-bindings/soc/qcom,rpm.h>

- bias-pull-down:
	Usage: optional
	Value type: <empty>
	Definition: enable pull down of the regulator when inactive

- qcom,force-mode-none:
	Usage: optional (default if no other qcom,force-mode is specified)
	Value type: <empty>
	Defintion: indicates that the regulator should not be forced to any
	           particular mode

- qcom,force-mode-lpm:
	Usage: optional
	Value type: <empty>
	Definition: indicates that the regulator should be forced to operate in
	            low-power-mode

- qcom,force-mode-auto:
	Usage: optional (only available for 8960/8064)
	Value type: <empty>
	Definition: indicates that the regulator should be automatically pick
	            operating mode

- qcom,force-mode-hpm:
	Usage: optional (only available for 8960/8064)
	Value type: <empty>
	Definition: indicates that the regulator should be forced to operate in
	            high-power-mode

- qcom,force-mode-bypass: (only for 8960/8064)
	Usage: optional (only available for 8960/8064)
	Value type: <empty>
	Definition: indicates that the regulator should be forced to operate in
	            bypass mode

Standard regulator bindings are used inside switch low-dropout regulator
subnodes.  Check Documentation/devicetree/bindings/regulator/regulator.txt for
more details.

== Negative Charge Pump

- compatible:
	Usage: required
	Value type: <string>
	Definition: must be one of:
		    "qcom,rpm-pm8058-ncp"
		    "qcom,rpm-pm8921-ncp"

- reg:
	Usage: required
	Value type: <u32>
	Definition: resource as defined in <dt-bindings/soc/qcom,rpm.h>

- qcom,switch-mode-frequency:
	Usage: required
	Value type: <u32>
	Definition: Frequency (Hz) of the swith mode power supply;
		    must be one of:
		    19200000, 9600000, 6400000, 4800000, 3840000, 3200000,
		    2740000, 2400000, 2130000, 1920000, 1750000, 1600000,
		    1480000, 1370000, 1280000, 1200000

Standard regulator bindings are used inside negative charge pump regulator
subnodes.  Check Documentation/devicetree/bindings/regulator/regulator.txt for
more details.

== Switch

- compatible:
	Usage: required
	Value type: <string>
	Definition: must be one of:
		    "qcom,rpm-pm8058-switch"
		    "qcom,rpm-pm8901-switch"
		    "qcom,rpm-pm8921-switch"

- reg:
	Usage: required
	Value type: <u32>
	Definition: resource as defined in <dt-bindings/soc/qcom/qcom,rpm.h>


= EXAMPLE

	#include <dt-bindings/soc/qcom,rpm.h>

	rpm@108000 {
		compatible = "qcom,rpm-msm8960";
		reg = <0x108000 0x1000 0x2011008 0x4>;

		interrupts = <0 19 0>, <0 21 0>, <0 22 0>;
		interrupt-names = "ack", "err", "wakeup";

		#address-cells = <1>;
		#size-cells = <0>;

		pm8921_s1: pm8921-s1 {
			compatible = "qcom,rpm-pm8921-smps";
			reg = <QCOM_RPM_PM8921_S1>;

			regulator-min-microvolt = <1225000>;
			regulator-max-microvolt = <1225000>;
			regulator-always-on;

			bias-pull-down;

			qcom,switch-mode-frequency = <3200000>;
		};
	};
```

## Documentation/devicetree/bindings/soc/qcom/qcom,smem.txt
```
Qualcomm Shared Memory binding

This binding describes the Qualcomm Shared Memory, used to share data between
various subsystems and OSes in Qualcomm platforms.

- compatible:
	Usage: required
	Value type: <stringlist>
	Definition: must be:
		    "qcom,smem"

- memory-region:
	Usage: required
	Value type: <prop-encoded-array>
	Definition: handle to memory reservation for main smem memory region.

- reg:
	Usage: optional
	Value type: <prop-encoded-array>
	Definition: base address and size pair for any additional memory areas
		    of the shared memory.

- hwspinlocks:
	Usage: required
	Value type: <prop-encoded-array>
	Definition: reference to a hwspinlock used to protect allocations from
		    the shared memory

= EXAMPLE

	reserved-memory {
		#address-cells = <1>;
		#size-cells = <1>;
		ranges;

		smem_region: smem@fa00000 {
			reg = <0xfa00000 0x200000>;
			no-map;
		};
	};

	smem@fa00000 {
		compatible = "qcom,smem";

		memory-region = <&smem_region>;
		reg = <0xfc428000 0x4000>;

		hwlocks = <&tcsr_mutex 3>;
	};
```

## Documentation/devicetree/bindings/sound/hisilicon,hi6210-hdmi-audio-codec.txt
```
Device-Tree bindings for hi6210 HDMI audio codec

Required properties:
	- compatible: should be "hisilicon,hi6210-hdmi-audio-codec".
	- #sound-dai-cells: should be <0>.

Example node:

hi6210_hdmi_codec: hi6210_hdmi_codec {
	compatible = "hisilicon,hi6210-hdmi-audio-codec";
	#sound-dai-cells = <0>;
};
```

## Documentation/devicetree/bindings/sound/hisilicon,hi6210-i2s.txt
```
* Hisilicon 6210 i2s controller

Required properties:

- compatible: should be one of the following:
   - "hisilicon,hi6210-i2s"
- reg: physical base address of the controller and length of memory mapped
  region. Should contain the i2s unit, syscon and pmctrl registers, in that
  order.
- interrupts: should contain the i2s interrupt.
 clocks: a list of phandle + clock-specifier pairs, one for each entry
  in clock-names.
- clock-names: should contain following:
   - "dacodec"
   - "i2s-base"
- dmas: DMA specifiers for tx dma. See the DMA client binding,
  Documentation/devicetree/bindings/dma/dma.txt
- dma-names: should be "tx" and "rx"


Example for the hi6210 i2s controller:

i2s0: hi6210_i2s {
	compatible = "hisilicon,hi6210-i2s";
	reg = <0x0 0xf7118000 0x0 0x8000>, /* i2s unit */
	      <0x0 0xf7030000 0x0 0x400>,  /* syscon */
	      <0x0 0xf7032000 0x0 0x400>;  /* pmctrl */
	interrupts = <0 123 0x4>; /* 155 "DigACodec_intr"-32 */
	pinctrl-names = "default";
	pinctrl-0 = <&bt_pmx_func &bt_cfg_func>;
	clocks = <&sys_ctrl HI6220_DACODEC_PCLK>,
		 <&sys_ctrl HI6220_BBPPLL0_DIV>;
	clock-names = "dacodec", "i2s-base";
	dmas = <&dma0 15 &dma0 14>;
	dma-names = "rx", "tx";
};
```

## Documentation/devicetree/bindings/sound/qcom,msm8916-wcd.txt
```
msm8916 audio CODEC aka Tombak audio CODEC

Codec IP is divided into two parts, first analog which is integrated in pmic pm8916
and secondly digital part which is integrated into application processor. Codec register
controls are also split across pmic an lpass. Analog part is controlled via spmi bus to pmic.

## Bindings for codec core on pmic:

Required properties
 - compatible = "qcom,msm8916-wcd-codec";
 - reg: represents the slave base address provided to the peripheral.
 - interrupt-parent : The parent interrupt controller.
 - interrupts: List of interrupts in given SPMI peripheral.
 - interrupt-names: Names specified to above list of interrupts in same
		    order. List of supported interrupt names are:
  "spk_cnp_int" - Speaker click and pop interrupt
  "spk_clip_int" - Speaker clip interrupt
  "spk_ocp_int" - Speaker over current protect interrupt.
  "ins_rem_det1" - jack insert removal detect interrupt 1.
  "but_rel_det" - button release interrupt
  "but_press_det" - button press event
  "ins_rem_det" - jack insert removal detect interrup
  "mbhc_int"	- multi button headset interrupt.
  "ear_ocp_int" - Earphone over current protect interrupt.
  "hphr_ocp_int" - Headphone R over current protect interrupt.
  "hphl_ocp_det" - Headphone L over current protect interrupt
  "ear_cnp_int" - earphone cnp interrupt.
  "hphr_cnp_int" - hphr click and pop interrupt.
  "hphl_cnp_int" - hphl click and pop interrupt

 - vddio-supply: phandle to VDD_CDC_IO regulator device tree node.
 - vdd-tx-rx-supply: phandle to VDD_CDC_TX/RX/CX regulator device tree node.
 - vdd-micbias-supply: phandle of VDD_MICBIAS supply's regulator device tree
			    node.
- qcom,lpass-codec-core: phandle to syscon node of lpass code core.

Optional Properties:
- qcom,micbias1-ext-cap: present if micbias1 has external capacitor connected.
- qcom,micbias2-ext-cap: present if micbias2 has external capacitor connected.

## Bindings codec core on lpass:

Required properties
 - compatible: should be "qcom,msm8916-lpass-codec" followed by "syscon".
 - reg: represents the lpass codec core register map.

Example:

spmi_bus {
	...
	msm8916_wcd_codec@f000{
		compatible = "qcom,msm8916-wcd-codec";
		reg = <0xf000 0x200>;
		reg-names = "pmic-codec-core";
		clocks = <&gcc GCC_CODEC_DIGCODEC_CLK>;
		clock-names = "mclk";
		interrupt-parent = <&spmi_bus>;
		interrupts = <0x1 0xf0 0x0 IRQ_TYPE_NONE>,
			     <0x1 0xf0 0x1 IRQ_TYPE_NONE>,
			     <0x1 0xf0 0x2 IRQ_TYPE_NONE>,
			     <0x1 0xf0 0x3 IRQ_TYPE_NONE>,
			     <0x1 0xf0 0x4 IRQ_TYPE_NONE>,
			     <0x1 0xf0 0x5 IRQ_TYPE_NONE>,
			     <0x1 0xf0 0x6 IRQ_TYPE_NONE>,
			     <0x1 0xf0 0x7 IRQ_TYPE_NONE>,
			     <0x1 0xf1 0x0 IRQ_TYPE_NONE>,
			     <0x1 0xf1 0x1 IRQ_TYPE_NONE>,
			     <0x1 0xf1 0x2 IRQ_TYPE_NONE>,
			     <0x1 0xf1 0x3 IRQ_TYPE_NONE>,
			     <0x1 0xf1 0x4 IRQ_TYPE_NONE>,
			     <0x1 0xf1 0x5 IRQ_TYPE_NONE>;
		interrupt-names = "spk_cnp_int",
				  "spk_clip_int",
				  "spk_ocp_int",
				  "ins_rem_det1",
				  "but_rel_det",
				  "but_press_det",
				  "ins_rem_det",
				  "mbhc_int",
				  "ear_ocp_int",
				  "hphr_ocp_int",
				  "hphl_ocp_det",
				  "ear_cnp_int",
				  "hphr_cnp_int",
				  "hphl_cnp_int";
		vddio-supply = <&pm8916_l5>;
		vdd-tx-rx-supply = <&pm8916_l5>;
		vdd-micbias-supply = <&pm8916_l13>;
		qcom,lpass-codec-core = <&lpass_codec_core>;
		#sound-dai-cells = <1>;
	};
};

soc {
	...
	lpass_codec_core: lpass-codec{
		compatible = "qcom,msm8916-lpass-codec", "syscon";
		reg = <0x0771c000 0x400>;
	};

};
```
