/*
 * Copyright 2016 Freescale Semiconductor, Inc.
 *
 * This program is free software; you can redistribute it and/or modify
 * it under the terms of the GNU General Public License as published by
 * the Free Software Foundation; either version 2 of the License, or
 * (at your option) any later version.
 */

/dts-v1/;
#include "s32v234-pcie.dtsi"

&fec {
	phy-mode = "rgmii";
	fixed-link = <1 1 1000 0 0>;
	status = "okay";
};
