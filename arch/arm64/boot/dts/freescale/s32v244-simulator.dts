/*
 * Copyright 2017 NXP
 *
 * This program is free software; you can redistribute it and/or modify
 * it under the terms of the GNU General Public License as published by
 * the Free Software Foundation; either version 2 of the License, or
 * (at your option) any later version.
 */

/dts-v1/;
#include "s32-gen1.dtsi"
/ {
	model = "Freescale S32V244";
	compatible = "fsl,s32v244-simu", "fsl,s32v244",
				 "arm,vexpress,v2p-aarch64", "arm,vexpress";

	chosen {
		linux,initrd-start = <0xa0000000>;
		linux,initrd-end = <0xa2000000>;

	};

	sysclk: clk10000000 {
		compatible = "fixed-clock";
		#clock-cells = <0>;
		clock-frequency = <10000000>;
		clock-output-names = "sysclk";
	};
};
