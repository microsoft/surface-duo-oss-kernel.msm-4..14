/*
 * Copyright 2015 Freescale Semiconductor, Inc.
 * (C) Copyright 2017 MicroSys Electronics GmbH
 *
 * This program is free software; you can redistribute it and/or modify
 * it under the terms of the GNU General Public License as published by
 * the Free Software Foundation; either version 2 of the License, or
 * (at your option) any later version.
 */

/dts-v1/;
#include "s32v234sbc.dtsi"

&fec {
	phy-mode = "rgmii";
	phy-handle = <&phy0>;
	status = "okay";
	mdio {
		#address-cells = <1>;
		#size-cells = <0>;
		phy0: ethernet-phy@1 {
			reg = <1>;
		};
	};
};
