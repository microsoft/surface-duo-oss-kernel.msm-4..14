// SPDX-License-Identifier: GPL-2.0+
/*
 * Copyright 2020 NXP
 *
 * This program is free software; you can redistribute it and/or modify
 * it under the terms of the GNU General Public License as published by
 * the Free Software Foundation; either version 2 of the License, or
 * (at your option) any later version.
 */

/dts-v1/;
#include "fsl-s32v234-campp.dtsi"

/ {
	chosen {
		stdout-path = "serial0:115200n8";
	};
};

&fec {
	phy-mode = "rgmii-txid";
	status = "okay";
	fixed-link {
		speed=<1000>;
		full-duplex;
	};
};

