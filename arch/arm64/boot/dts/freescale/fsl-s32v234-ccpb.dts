/*
 * (C) Copyright 2018 NXP
 *
 * This program is free software; you can redistribute it and/or modify
 * it under the terms of the GNU General Public License as published by
 * the Free Software Foundation; either version 2 of the License, or
 * (at your option) any later version.
 */

/dts-v1/;
#include "fsl-s32v234-ccpb.dtsi"

&fec {
	phy-mode = "rgmii";
	status = "okay";
	fixed-link {
		speed=<1000>;
		full-duplex;
	};
	mdio {
		#address-cells = <1>;
		#size-cells = <0>;
	};
};
