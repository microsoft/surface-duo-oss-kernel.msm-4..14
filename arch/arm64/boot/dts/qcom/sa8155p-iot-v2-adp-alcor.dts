/* Copyright (c) 2018-2019,2021, The Linux Foundation. All rights reserved.
 *
 * This program is free software; you can redistribute it and/or modify
 * it under the terms of the GNU General Public License version 2 and
 * only version 2 as published by the Free Software Foundation.
 *
 * This program is distributed in the hope that it will be useful,
 * but WITHOUT ANY WARRANTY; without even the implied warranty of
 * MERCHANTABILITY or FITNESS FOR A PARTICULAR PURPOSE.  See the
 * GNU General Public License for more details.
 */

/dts-v1/;

#include "sa8155p-iot-v2.dtsi"
#include "sa8155-adp-alcor.dtsi"

/ {
	model = "Qualcomm Technologies, Inc. SA8155P IOT ADP ALCOR";
	compatible = "qcom,sa8155p-adp-alcor", "qcom,sa8155p",
			"qcom,adp-alcor", "qcom,sa8155p-iot";
	qcom,board-id = <0x02000019 0>;
};
