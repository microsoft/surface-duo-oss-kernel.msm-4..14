/*
 * Copyright (c) 2020 Microsoft Corporation
 *
 * This program is free software; you can redistribute it and/or modify it
 * under the terms of the GNU General Public License version 2 as published by
 * the Free Software Foundation.
 */

/dts-v1/;

#include "../qcom/sm8150-v2.dtsi"
#include "surface-duo.dtsi"

/ {
	model = "Surface Duo EV1_B";
	compatible = "qcom,sm8150-mtp", "qcom,sm8150", "qcom,mtp";
	qcom,board-id = <8 7>;
};
