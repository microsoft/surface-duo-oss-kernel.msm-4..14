/*
 * Copyright (c) 2020 Microsoft Corporation
 *
 * This program is free software; you can redistribute it and/or modify it
 * under the terms of the GNU General Public License version 2 as published by
 * the Free Software Foundation.
 */

&soc {
    surface_util: surface_util {
            compatible = "surface,surface_util";
            module-names = "fuse_check", "mcfg_check";
        };
};