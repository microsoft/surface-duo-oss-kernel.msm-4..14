/*
 * Copyright (c) 2020 Microsoft Corporation
 *
 * This program is free software; you can redistribute it and/or modify it
 * under the terms of the GNU General Public License version 2 as published by
 * the Free Software Foundation.
 */

&mdss_mdp {
	dsi_lg_v2_amoled_dsc_vid_c3: qcom,mdss_dsi_panel_lg_v2_amoled_vid_c3 {

		qcom,mdss-dsi-panel-name = "dsi panel lg v2 amoled vid C3";
		qcom,mdss-dsi-panel-type = "dsi_video_mode";
		qcom,mdss-dsi-virtual-channel-id = <0>;
		qcom,mdss-dsi-stream = <0>;
		qcom,mdss-dsi-bpp = <24>;

		qcom,mdss-dsi-underflow-color = <0xff>;
		qcom,mdss-dsi-border-color = <0>;
		qcom,mdss-dsi-reset-sequence = <1 10>, <0 40>, <1 10>;
		qcom,mdss-dsi-color-order = "rgb_swap_rgb";
		qcom,mdss-dsi-lane-0-state;
		qcom,mdss-dsi-lane-1-state;
		qcom,mdss-dsi-lane-2-state;
		qcom,mdss-dsi-lane-3-state;
		qcom,mdss-dsi-dma-trigger = "trigger_sw";
		qcom,mdss-dsi-mdp-trigger = "none";

		/* Init */
		qcom,mdss-dsi-lp11-init;
		qcom,mdss-dsi-init-delay-us = <120>;

		// Backlight
		qcom,mdss-dsi-bl-pmic-control-type = "bl_ctrl_dcs";
		qcom,mdss-dsi-bl-min-level = <1>;
		qcom,mdss-dsi-bl-max-level = <255>;

		/* VSync & TE */
		qcom,mdss-dsi-te-pin-select = <1>;
		qcom,mdss-dsi-te-dcs-command = <1>;
		qcom,mdss-dsi-te-check-enable;
		qcom,mdss-dsi-te-using-te-pin;

		qcom,mdss-dsi-bllp-eof-power-mode;
		qcom,mdss-dsi-bllp-power-mode;

		qcom,mdss-pan-physical-width-dimension = <85>;
		qcom,mdss-pan-physical-height-dimension = <114>;

		qcom,ulps-enabled;
		qcom,suspend-ulps-enabled;

		qcom,mdss-dsi-wr-mem-start = <0x2c>;
		qcom,mdss-dsi-wr-mem-continue = <0x3c>;

		qcom,mdss-dsi-traffic-mode = "burst_mode";

		qcom,mdss-dsi-display-timings {
			timing@0{
				qcom,mdss-dsi-panel-width = <1350>;
				qcom,mdss-dsi-panel-height = <1804>;

				qcom,mdss-dsi-h-front-porch = <320>;
				qcom,mdss-dsi-h-back-porch = <320>;
				qcom,mdss-dsi-h-pulse-width = <4>;
				qcom,mdss-dsi-h-sync-skew = <0>;

				qcom,mdss-dsi-v-back-porch = <30>;
				qcom,mdss-dsi-v-front-porch = <10>;
				qcom,mdss-dsi-v-pulse-width = <4>;

				qcom,mdss-dsi-panel-framerate = <60>;
				qcom,mdss-dsi-panel-jitter = <0x1 0x1>;

				/* Compression */
				qcom,compression-mode = "dsc";
				qcom,mdss-dsc-version = <0x11>;
				qcom,mdss-dsc-scr-version = <0x0>;
				qcom,mdss-dsc-encoders = <1>;
				qcom,mdss-dsc-slice-per-pkt = <2>;
				qcom,mdss-dsc-slice-height = <902>;
				qcom,mdss-dsc-slice-width = <675>;
				qcom,mdss-dsc-bit-per-component = <8>;
				qcom,mdss-dsc-bit-per-pixel = <8>;
				qcom,mdss-dsc-block-prediction-enable;

				// Get same pixel/byte clk as R2,700 for video mode.
                                qcom,mdss-dsi-panel-clockrate = <700000000>;
				/* Values calculated with 'DSI_Timing_Parameters_User_Interactive_Spreadsheet' */
				qcom,mdss-dsi-t-clk-post = <0x16>;
				qcom,mdss-dsi-t-clk-pre = <0x015>;
				qcom,mdss-dsi-panel-phy-timings = [00 19 06 06 21 20 06 06 04 02 04 00 15 16];

				qcom,mdss-dsi-on-command = [
					07 01 00 00 00 00 02 11 00		// Sleep out command AND wait 120 ms
					0A 01 00 00 00 00 80
                                                11 00 00 89 30 80 07 0C
						05 46 03 86 02 A3 02 A3
						02 00 02 51 00 20 5F 4B
						00 09 00 0C 00 1C 00 18
						18 00 10 F0 03 0C 20 00
						06 0B 0B 33 0E 1C 2A 38
                                                46 54 62 69 70 77 79 7B
						7D 7E 01 02 01 00 09 40
						09 BE 19 FC 19 FA 19 F8
						1A 38 1A 78 1A B6 2A F6
						2B 34 2B 74 3B 74 6B F4
						00 00 00 00 00 00 00 00
						00 00 00 00 00 00 00 00
						00 00 00 00 00 00 00 00
						00 00 00 00 00 00 00 00
						00 00 00 00 00 00 00 00
					15 01 00 00 00 00 02 B0 AC                // Unlock MCS
                                        39 01 00 00 00 00 05 2A 00 00 05 45       // Window Size
                                        39 01 00 00 00 00 05 2B 00 00 07 0B       // Window Size
                                        15 01 00 00 00 00 02 26 02                // Gama set
                                        39 01 00 00 00 00 03 44 03 84       //Scan line 1700
                                        05 01 00 00 00 00 01 35			      // TE ON
                                        15 01 00 00 00 00 02 3D 10                // Video Mode
                                        39 01 00 00 00 00 03 51 03 7F             // Write Brightness Value
                                        39 01 00 00 00 00 03 53 0C 30             // Write Control Display 1
                                        39 01 00 00 00 00 07 55 04 70 DB 00 78 DB // Write Control Display 2
					39 01 00 00 00 00 11 B1 47 00 80 00 00 00 00 00 00 00 00 00 00 00 00 00
                                        39 01 00 00 00 00 0C B6 61 32 00 2F 14 00 1F 08 40 22 0C
                                        39 01 00 00 00 00 04 C0 02 29 0C
                                        15 01 00 00 00 00 02 F3 AC                // OTP protection
                                        15 01 00 00 00 00 02 B0 CA                // lock MCS
					05 01 00 00 82 00 01 11	                 // Sleep out command AND wait 130 ms
                                        05 01 00 00 82 00 01 29		// Display ON
				];

				qcom,mdss-dsi-off-command = [
					05 01 00 00 C0 00 01 28			// Display Off command
					05 01 00 00 C0 00 01 10			// Sleep in command
				];

				qcom,mdss-dsi-on-command-state = "dsi_lp_mode";
				qcom,mdss-dsi-off-command-state = "dsi_hs_mode";

				qcom,display-topology = <1 1 1>;
				qcom,default-topology-index = <0>;
			};
		};

	};

};
