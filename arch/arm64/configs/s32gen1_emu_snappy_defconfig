## arch/arm64/configs/xilinx_versal_defconfig
```kconfig
CONFIG_SYSVIPC=y
CONFIG_POSIX_MQUEUE=y
CONFIG_AUDIT=y
CONFIG_NO_HZ=y
CONFIG_HIGH_RES_TIMERS=y
CONFIG_BSD_PROCESS_ACCT=y
CONFIG_IKCONFIG=y
CONFIG_IKCONFIG_PROC=y
CONFIG_LOG_BUF_SHIFT=16
CONFIG_BLK_DEV_INITRD=y
CONFIG_EMBEDDED=y
CONFIG_PERF_EVENTS=y
# CONFIG_COMPAT_BRK is not set
CONFIG_SLAB=y
CONFIG_ARCH_ZYNQMP=y
CONFIG_NR_CPUS=8
CONFIG_COMPAT=y
# CONFIG_EFI is not set
CONFIG_CPU_FREQ=y
CONFIG_CPU_FREQ_DEFAULT_GOV_USERSPACE=y
CONFIG_CPUFREQ_DT=y
CONFIG_ZYNQMP_FIRMWARE_DEBUG=y
CONFIG_MODULES=y
CONFIG_MODULE_UNLOAD=y
# CONFIG_SPARSEMEM_VMEMMAP is not set
# CONFIG_COMPACTION is not set
CONFIG_DEFAULT_MMAP_MIN_ADDR=32768
CONFIG_CMA=y
CONFIG_NET=y
CONFIG_PACKET=y
CONFIG_UNIX=y
CONFIG_XFRM_USER=y
CONFIG_NET_KEY=y
CONFIG_NET_KEY_MIGRATE=y
CONFIG_INET=y
CONFIG_IP_MULTICAST=y
CONFIG_IP_PNP=y
CONFIG_IP_PNP_DHCP=y
CONFIG_IP_PNP_BOOTP=y
CONFIG_IP_PNP_RARP=y
CONFIG_SYN_COOKIES=y
CONFIG_NETWORK_SECMARK=y
CONFIG_NETFILTER=y
CONFIG_NETFILTER_NETLINK_LOG=y
CONFIG_NF_CONNTRACK=y
CONFIG_NF_CONNTRACK_FTP=y
CONFIG_NF_CONNTRACK_SNMP=y
CONFIG_NF_CONNTRACK_TFTP=y
CONFIG_NF_CT_NETLINK=y
CONFIG_NETFILTER_XTABLES=y
CONFIG_NETFILTER_XT_MARK=y
CONFIG_NETFILTER_XT_CONNMARK=y
CONFIG_BRIDGE_NF_EBTABLES=y
CONFIG_BRIDGE_EBT_T_FILTER=y
CONFIG_BRIDGE_EBT_T_NAT=y
CONFIG_BRIDGE_EBT_MARK_T=y
CONFIG_BRIDGE=y
CONFIG_NET_PKTGEN=y
CONFIG_CAN=y
CONFIG_CAN_XILINXCAN=y
CONFIG_DEVTMPFS=y
CONFIG_DEVTMPFS_MOUNT=y
CONFIG_MTD=y
CONFIG_MTD_TESTS=m
CONFIG_MTD_CMDLINE_PARTS=y
CONFIG_MTD_BLOCK=y
CONFIG_MTD_OOPS=y
CONFIG_MTD_CFI=y
CONFIG_MTD_CFI_INTELEXT=y
CONFIG_MTD_DATAFLASH=y
CONFIG_MTD_RAW_NAND=y
CONFIG_MTD_SPI_NOR=y
CONFIG_SPI_CADENCE_QUADSPI=y
CONFIG_OF_OVERLAY=y
CONFIG_OF_CONFIGFS=y
CONFIG_BLK_DEV_LOOP=y
CONFIG_BLK_DEV_RAM=y
CONFIG_BLK_DEV_RAM_SIZE=65536
CONFIG_SRAM=y
CONFIG_EEPROM_AT24=y
CONFIG_SCSI=y
CONFIG_BLK_DEV_SD=y
CONFIG_NETDEVICES=y
CONFIG_TUN=y
CONFIG_MACB=y
CONFIG_DP83848_PHY=y
CONFIG_DP83867_PHY=y
CONFIG_MARVELL_PHY=y
CONFIG_MICROSEMI_PHY=y
CONFIG_REALTEK_PHY=y
# CONFIG_INPUT_KEYBOARD is not set
# CONFIG_INPUT_MOUSE is not set
# CONFIG_SERIO is not set
CONFIG_VT_HW_CONSOLE_BINDING=y
CONFIG_SERIAL_AMBA_PL010=y
CONFIG_SERIAL_AMBA_PL010_CONSOLE=y
CONFIG_SERIAL_AMBA_PL011=y
CONFIG_SERIAL_AMBA_PL011_CONSOLE=y
CONFIG_SERIAL_XILINX_PS_UART=y
CONFIG_SERIAL_XILINX_PS_UART_CONSOLE=y
# CONFIG_HW_RANDOM is not set
CONFIG_I2C_CHARDEV=y
CONFIG_I2C_CADENCE=y
CONFIG_SPI=y
CONFIG_SPI_CADENCE=y
CONFIG_SPI_XILINX=y
CONFIG_SPI_ZYNQMP_GQSPI=y
CONFIG_GPIOLIB=y
CONFIG_GPIO_ZYNQ=y
# CONFIG_HWMON is not set
CONFIG_WATCHDOG=y
CONFIG_XILINX_WATCHDOG=y
CONFIG_MEDIA_SUPPORT=y
CONFIG_MEDIA_CAMERA_SUPPORT=y
CONFIG_MEDIA_CONTROLLER=y
CONFIG_VIDEO_V4L2_SUBDEV_API=y
CONFIG_V4L_PLATFORM_DRIVERS=y
CONFIG_VIDEO_XILINX=y
CONFIG_VIDEO_XILINX_AXI4S_SWITCH=y
CONFIG_VIDEO_XILINX_CFA=y
CONFIG_VIDEO_XILINX_CRESAMPLE=y
CONFIG_VIDEO_XILINX_DEMOSAIC=y
CONFIG_VIDEO_XILINX_GAMMA=y
CONFIG_VIDEO_XILINX_HLS=y
CONFIG_VIDEO_XILINX_REMAPPER=y
CONFIG_VIDEO_XILINX_RGB2YUV=y
CONFIG_VIDEO_XILINX_SCALER=y
CONFIG_VIDEO_XILINX_MULTISCALER=y
CONFIG_VIDEO_XILINX_SDIRXSS=y
CONFIG_VIDEO_XILINX_SWITCH=y
CONFIG_VIDEO_XILINX_TPG=y
CONFIG_VIDEO_XILINX_VPSS_CSC=y
CONFIG_VIDEO_XILINX_VPSS_SCALER=y
CONFIG_VIDEO_XILINX_CSI2RXSS=y
CONFIG_VIDEO_XILINX_SCD=y
CONFIG_VIDEO_XILINX_M2M=y
CONFIG_DRM=y
CONFIG_DRM_XLNX=y
CONFIG_DRM_XLNX_BRIDGE=y
CONFIG_DRM_XLNX_BRIDGE_DEBUG_FS=y
CONFIG_DRM_XLNX_DSI=y
CONFIG_DRM_XLNX_MIXER=y
CONFIG_DRM_XLNX_PL_DISP=y
CONFIG_DRM_XLNX_SDI=y
CONFIG_DRM_XLNX_BRIDGE_CSC=y
CONFIG_DRM_XLNX_BRIDGE_SCALER=y
CONFIG_USB=y
CONFIG_USB_ANNOUNCE_NEW_DEVICES=y
CONFIG_USB_OTG=y
CONFIG_USB_OTG_FSM=y
CONFIG_USB_XHCI_HCD=y
CONFIG_USB_STORAGE=y
CONFIG_USB_DWC3=y
CONFIG_USB_GADGET=y
CONFIG_USB_CONFIGFS=y
CONFIG_USB_CONFIGFS_MASS_STORAGE=y
CONFIG_MMC=y
CONFIG_MMC_SDHCI=y
CONFIG_MMC_SDHCI_PLTFM=y
CONFIG_MMC_SDHCI_OF_ARASAN=y
CONFIG_RTC_CLASS=y
CONFIG_RTC_DRV_ZYNQMP=y
CONFIG_XILINX_ZYNQMP_DMA=y
CONFIG_DMATEST=y
CONFIG_UIO=y
CONFIG_UIO_XILINX_AI_ENGINE=y
CONFIG_STAGING=y
CONFIG_ION=y
CONFIG_ION_SYSTEM_HEAP=y
CONFIG_ION_CMA_HEAP=y
CONFIG_COMMON_CLK_ZYNQMP=y
# CONFIG_ARM_ARCH_TIMER_EVTSTREAM is not set
# CONFIG_FSL_ERRATUM_A008585 is not set
CONFIG_XILINX_INTC=y
CONFIG_ARM_CCI_PMU=y
# CONFIG_ARM_PMU is not set
CONFIG_ANDROID=y
CONFIG_FPGA=y
CONFIG_FPGA_BRIDGE=y
CONFIG_XILINX_PR_DECOUPLER=y
CONFIG_FPGA_REGION=y
CONFIG_OF_FPGA_REGION=y
CONFIG_FPGA_MGR_VERSAL_FPGA=y
CONFIG_EXT3_FS=y
CONFIG_EXT4_FS_POSIX_ACL=y
CONFIG_EXT4_FS_SECURITY=y
CONFIG_BTRFS_FS=y
CONFIG_EXPORTFS_BLOCK_OPS=y
CONFIG_QUOTA=y
CONFIG_QFMT_V2=y
CONFIG_AUTOFS4_FS=y
CONFIG_MSDOS_FS=y
CONFIG_VFAT_FS=y
CONFIG_TMPFS=y
CONFIG_TMPFS_POSIX_ACL=y
CONFIG_ECRYPT_FS=y
CONFIG_JFFS2_FS=y
CONFIG_JFFS2_SUMMARY=y
CONFIG_JFFS2_FS_XATTR=y
CONFIG_JFFS2_COMPRESSION_OPTIONS=y
CONFIG_JFFS2_LZO=y
CONFIG_JFFS2_RUBIN=y
CONFIG_CRAMFS=y
CONFIG_NFS_FS=y
CONFIG_NFS_V3_ACL=y
CONFIG_NFS_V4=y
CONFIG_ROOT_NFS=y
CONFIG_NLS_CODEPAGE_437=y
CONFIG_NLS_ISO8859_1=y
# CONFIG_XZ_DEC_X86 is not set
# CONFIG_XZ_DEC_POWERPC is not set
# CONFIG_XZ_DEC_IA64 is not set
# CONFIG_XZ_DEC_ARM is not set
# CONFIG_XZ_DEC_ARMTHUMB is not set
# CONFIG_XZ_DEC_SPARC is not set
CONFIG_DMA_CMA=y
CONFIG_CMA_SIZE_MBYTES=256
CONFIG_PRINTK_TIME=y
# CONFIG_ENABLE_MUST_CHECK is not set
CONFIG_DEBUG_FS=y
# CONFIG_SECTION_MISMATCH_WARN_ONLY is not set
# CONFIG_SCHED_DEBUG is not set
# CONFIG_FTRACE is not set
# CONFIG_STRICT_DEVMEM is not set
# CONFIG_ACPI_CUSTOM_METHOD is not set
CONFIG_AUFS_FS=m
CONFIG_AUTOFS4_FS=y
# CONFIG_BFQ_CGROUP_DEBUG is not set
CONFIG_BFQ_GROUP_IOSCHED=y
CONFIG_BLK_CGROUP=y
CONFIG_BLK_CGROUP_IOCOST=y
# CONFIG_BLK_CGROUP_IOLATENCY is not set
CONFIG_BLK_DEV_DM=y
CONFIG_BLK_DEV_DM_BUILTIN=y
CONFIG_BLK_DEV_LOOP_MIN_COUNT=256
CONFIG_BRIDGE_EBT_VLAN=m
CONFIG_BRIDGE_NF_EBTABLES=m
CONFIG_BRIDGE_VLAN_FILTERING=y
CONFIG_CC_STACKPROTECTOR=y
CONFIG_CC_STACKPROTECTOR_REGULAR=y
CONFIG_CGROUP_BPF=y
CONFIG_CGROUP_CPUACCT=y
CONFIG_CGROUP_DEVICE=y
CONFIG_CGROUP_FREEZER=y
CONFIG_CGROUP_HUGETLB=y
CONFIG_CGROUP_NET_CLASSID=y
CONFIG_CGROUP_NET_PRIO=y
CONFIG_CGROUP_PERF=y
CONFIG_CGROUP_PIDS=y
CONFIG_CGROUP_RDMA=y
CONFIG_CGROUP_SCHED=y
CONFIG_CGROUP_WRITEBACK=y
CONFIG_CHECKPOINT_RESTORE=y
# CONFIG_COMPAT_BRK is not set
# CONFIG_COMPAT_VDSO is not set
CONFIG_CPUSETS=y
# CONFIG_DEBUG_INFO is not set
CONFIG_DEBUG_RODATA=y
CONFIG_DEBUG_SET_MODULE_RONX=y
CONFIG_DEFAULT_MMAP_MIN_ADDR=32768            -
CONFIG_DEFAULT_SECURITY_APPARMOR=y
# CONFIG_DEVKMEM is not set
CONFIG_DEVPTS_MULTIPLE_INSTANCES=y
CONFIG_DM_THIN_PROVISIONING=m
CONFIG_ENCRYPTED_KEYS=y
CONFIG_FAIR_GROUP_SCHED=y
CONFIG_FANOTIFY=y
CONFIG_FUSE_FS=y
CONFIG_GENERIC_PINCTRL_GROUPS=y
CONFIG_HW_RANDOM=y
CONFIG_IP6_NF_MATCH_SRH=m
CONFIG_IP6_NF_NAT=m
CONFIG_IP6_NF_TARGET_MASQUERADE=m
CONFIG_IPC_NS=y
CONFIG_IPVLAN=m
CONFIG_IP_NF_ARPFILTER=m
CONFIG_IP_NF_ARPTABLES=m
CONFIG_IP_NF_ARP_MANGLE=m
CONFIG_IP_NF_MATCH_AH=m
CONFIG_IP_NF_MATCH_ECN=m
CONFIG_IP_NF_MATCH_RPFILTER=m
CONFIG_IP_NF_MATCH_TTL=m
CONFIG_IP_NF_NAT=m
CONFIG_IP_NF_TARGET_CLUSTERIP=m
CONFIG_IP_NF_TARGET_ECN=m
CONFIG_IP_NF_TARGET_MASQUERADE=m
CONFIG_IP_NF_TARGET_NETMAP=m
CONFIG_IP_NF_TARGET_REDIRECT=m
CONFIG_IP_NF_TARGET_SYNPROXY=m
CONFIG_IP_NF_TARGET_TTL=m
CONFIG_LSM_MMAP_MIN_ADDR=0
CONFIG_LSM="lockdown,yama,integrity,apparmor"
CONFIG_MACVLAN=m
CONFIG_MEMCG=y
CONFIG_MEMCG_KMEM=y
CONFIG_NAMESPACES=y
CONFIG_NETFILTER_XT_MATCH_CGROUP=m
CONFIG_NETFILTER_XT_MATCH_COMMENT=m
CONFIG_NETFILTER_XT_MATCH_DEVGROUP=m
CONFIG_NETLINK_DIAG=m
CONFIG_NET_ACT_VLAN=m
CONFIG_NET_CLS_ACT=y
CONFIG_NET_CLS_CGROUP=m
CONFIG_NET_NS=y
CONFIG_NET_SCHED=y
CONFIG_NFT_BRIDGE_META=m
CONFIG_NFT_BRIDGE_REJECT=m
CONFIG_NFT_COMPAT=m
CONFIG_NFT_CONNLIMIT=m
CONFIG_NFT_COUNTER=m
CONFIG_NFT_CT=m
CONFIG_NFT_DUP_IPV4=m
CONFIG_NFT_DUP_IPV6=m
CONFIG_NFT_DUP_NETDEV=m
CONFIG_NFT_FIB=m
# CONFIG_NFT_FIB_INET is not set
CONFIG_NFT_FIB_IPV4=m
CONFIG_NFT_FIB_IPV6=m
CONFIG_NFT_FIB_NETDEV=m
CONFIG_NFT_FLOW_OFFLOAD=m
CONFIG_NFT_FWD_NETDEV=m
CONFIG_NFT_HASH=m
CONFIG_NFT_LIMIT=m
CONFIG_NFT_LOG=m
CONFIG_NFT_MASQ=m
CONFIG_NFT_NAT=m
CONFIG_NFT_NUMGEN=m
CONFIG_NFT_OBJREF=m
CONFIG_NFT_OSF=m
CONFIG_NFT_QUEUE=m
CONFIG_NFT_QUOTA=m
CONFIG_NFT_REDIR=m
CONFIG_NFT_REJECT=m
CONFIG_NFT_REJECT_INET=m
CONFIG_NFT_REJECT_IPV4=m
CONFIG_NFT_REJECT_IPV6=m
CONFIG_NFT_SOCKET=m
CONFIG_NFT_SYNPROXY=m
CONFIG_NFT_TPROXY=m
CONFIG_NFT_TUNNEL=m
CONFIG_NFT_XFRM=m
CONFIG_NF_CONNTRACK_BRIDGE=m
# CONFIG_NF_CONNTRACK_PROCFS is not set
CONFIG_NF_CONNTRACK_SECMARK=y
CONFIG_NF_CT_NETLINK=m
CONFIG_NF_CT_NETLINK_HELPER=m
CONFIG_NF_CT_NETLINK_TIMEOUT=m
CONFIG_NF_DUP_IPV4=m
CONFIG_NF_DUP_NETDEV=m
CONFIG_NF_FLOW_TABLE=m
CONFIG_NF_LOG_ARP=m
CONFIG_NF_LOG_BRIDGE=m
CONFIG_NF_LOG_NETDEV=m
CONFIG_NF_NAT=m
CONFIG_NF_NAT_IPV4=m
CONFIG_NF_NAT_IPV6=m
CONFIG_NF_NAT_REDIRECT=y
CONFIG_NF_SOCKET_IPV4=m
CONFIG_NF_SOCKET_IPV6=m
CONFIG_NF_TABLES=m
CONFIG_NF_TABLES_ARP=m
CONFIG_NF_TABLES_BRIDGE=m
CONFIG_NF_TABLES_INET=y
CONFIG_NF_TABLES_IPV4=y
CONFIG_NF_TABLES_IPV6=y
CONFIG_NF_TABLES_NETDEV=y
CONFIG_NF_TABLES_SET=m
CONFIG_NF_TPROXY_IPV4=m
CONFIG_NF_TPROXY_IPV6=m
CONFIG_OVERLAY_FS=m
CONFIG_OVERLAY_FS_REDIRECT_ALWAYS_FOLLOW=y
CONFIG_OVERLAY_FS_XINO_AUTO=y
CONFIG_PACKET_DIAG=m
CONFIG_PID_NS=y
CONFIG_PROC_PID_CPUSET=y
CONFIG_RAW_DRIVER=m
CONFIG_RD_BZIP2=y
CONFIG_RD_LZMA=y
CONFIG_RD_XZ=y
CONFIG_REGULATOR=y
CONFIG_RFKILL=y
CONFIG_RFKILL_GPIO=m
CONFIG_RFKILL_INPUT=y
CONFIG_RFKILL_REGULATOR=m
CONFIG_RT_GROUP_SCHED=y
CONFIG_SCHED_AUTOGROUP=y
CONFIG_SECCOMP=y
CONFIG_SECCOMP_FILTER=y
CONFIG_SECURITY=y
CONFIG_SECURITY_APPARMOR=y
CONFIG_SECURITY_SELINUX=y
CONFIG_SECURITY_SMACK=y
CONFIG_SECURITY_YAMA=y
CONFIG_SOCK_CGROUP_DATA=y
CONFIG_SQUASHFS=y
CONFIG_SQUASHFS_DECOMP_SINGLE=y
CONFIG_SQUASHFS_FILE_DIRECT=y
CONFIG_SQUASHFS_LZ4=y
CONFIG_SQUASHFS_LZO=y
CONFIG_SQUASHFS_XATTR=y
CONFIG_SQUASHFS_XZ=y
CONFIG_SQUASHFS_ZLIB=y
CONFIG_STRICT_DEVMEM=y
CONFIG_SYN_COOKIES=y
CONFIG_UNIX_DIAG=m
CONFIG_USER_NS=y
CONFIG_UTS_NS=y
CONFIG_VETH=m
CONFIG_VLAN_8021Q=m
CONFIG_VLAN_8021Q_GVRP=y
CONFIG_VLAN_8021Q_MVRP=y
CONFIG_VXLAN=m
```

## arch/arm64/mach-s32/Kconfig
```kconfig
menuconfig ARCH_S32
	bool "Freescale S32 family" if ARCH_VEXPRESS
	select PINCTRL
	help
	  Support for Freescale S32 family of processors

if ARCH_S32

config ARCH_S32_CLK
	bool "Enable S32 CLK Framework"

config GALCORE_ANON_INODES
	bool "Support for anonymous inodes"
	select ANON_INODES

menu "S32 SOC selection"
	config SOC_S32V234
		bool "S32V234 SOC"
endmenu

menu "STM timer used as system timer"
	config S32V234_STM_SYSTIMER
		bool "STM used as system timer"
	select FSL_STM_TIMER if S32V234_STM_SYSTIMER
	config STM_CLKSRC_RATE
		int "STM Rating for ClockSource"
		default 460
	config STM_CLKEVT_RATE
		int "STM Rating for ClockEvents"
		default 460
endmenu

menu "PIT timer used as system timer"
	config S32V234_PIT_SYSTIMER
		bool "PIT used as system timer"
	select VF_PIT_TIMER if S32V234_PIT_SYSTIMER
	config PIT_CLKSRC_RATE
		int "PIT Rating for ClockSource"
		default 460
	config PIT_CLKEVT_RATE
		int "PIT Rating for ClockEvents"
		default 460
endmenu

if SOC_S32V234
menu "S32V234 execution target"

	config S32V234_EVB
		bool "S32V234 evb"

	config S32V234_PALLADIUM
		bool "S32V234 Palladium"

	config S32V234_PCIE
		bool "S32V234 pcie"
		help
			S32V234 pcie is a derivate of S32V234 platform which
			is designed to be connected to master board via PCI
			Express.

	config S32V234_SIMULATOR
		bool "S32V234 Synopsis Simulator"

	config S32V234_TMDP
		bool "S32V234 tmdp"

endmenu
endif

endif
```

## arch/arm64/mach-s32x/Kconfig
```kconfig
menuconfig ARCH_S32X
	bool "Freescale S32VX family" if ARCH_VEXPRESS
	help
	  Support for Freescale S32X family of processors

if ARCH_S32X

config ARCH_S32X_IOMUX
	bool "Enable S32X IOMUX"

endif

#source "arch/arm64/mach-s32x/devices/Kconfig"
```

## drivers/char/fsm-dp/Kconfig
```kconfig
menuconfig FSM_DP
	tristate "FSM DP Interface Core"
	depends on MHI_BUS
	default m
	help
	  FSM DP driver interface. The FSM DP character driver
	  provides a datapath server to user space.

if FSM_DP
config FSM_DP_TEST
	bool "FSM DP driver testing"
	depends on FSM_DP
	help
	  To enable the features in driver for testing.
endif # FSM_DP
```

## drivers/char/fsm-mhi-cntl/Kconfig
```kconfig
menuconfig FSM_MHI_CNTL
	tristate "FSM MHI Ops Control Driver"
	depends on MHI_QCOM
	help
	  This driver can control the MHI power management
	  operations to communicate with FSM-EP.
```

## drivers/char/fsm-oru-forwarder/Kconfig
```kconfig
menuconfig FSM_ORU_FORWARDER
	tristate "FSM ORU Forwarder"
	depends on FSM_DP
	default m
	help
	  FSM ORU Forwarder interface. The FSM ORU Forwarder character driver
	  provides Forwarding function between FSM DP datapath and ethernet interface.
```

## drivers/char/fsm-tti-intr/Kconfig
```kconfig
menuconfig FSM_TTI_INTR
	tristate "FSM TTI INTERRUPT Interface Driver"
	default m
	help
	  The driver updates sfn and slot number based
	  on TTI interrupts and provides a notification
	  to user space.
```

## drivers/crypto/hse/Kconfig
```kconfig
# SPDX-License-Identifier: BSD-3-Clause

config CRYPTO_DEV_NXP_HSE
	tristate "NXP HSE crypto driver"
	depends on SOC_S32GEN1
	default m
	select CRYPTO_HASH
	select CRYPTO_BLKCIPHER
	select CRYPTO_AEAD
	help
	  Enables the driver module for NXP's Hardware Security Engine (HSE).

config CRYPTO_DEV_NXP_HSE_MU_ID
	depends on CRYPTO_DEV_NXP_HSE
	int "Messaging Unit (MU) Instance: [0-3]"
	range 0 3
	default "0"
	help
	  The Messaging Unit (MU) Instance index used by HSE crypto driver.

config CRYPTO_DEV_NXP_HSE_HWRNG
	bool "NXP HSE hardware RNG support"
	depends on CRYPTO_DEV_NXP_HSE
	default y
	select HW_RANDOM
	help
	  Enables hardware RNG support for NXP's HSE.

config CRYPTO_DEV_NXP_HSE_KEY_WRAPPING
	bool "NXP key wrapping/blobbing support"
	depends on CRYPTO_DEV_NXP_HSE
	default n
	help
	  Enables NXP key wrapping/blobbing support.

config CRYPTO_DEV_NXP_HSE_AES_KEY_GID
	depends on CRYPTO_DEV_NXP_HSE
	int "AES Key Group ID within RAM Key Catalog: [0-256]"
	range 0 256
	default "1"
	help
	  The AES 256-bit Key Group ID within RAM Key Catalog.

config CRYPTO_DEV_NXP_HSE_AES_KEY_GSIZE
	depends on CRYPTO_DEV_NXP_HSE
	int "Number of AES Key Slots in AES Key Group: [0-256]"
	range 0 256
	default "20"
	help
	  Number of Key Slots available in the 256-bit AES Key Group.

config CRYPTO_DEV_NXP_HSE_HMAC_KEY_GID
	depends on CRYPTO_DEV_NXP_HSE
	int "HMAC Key Group ID within RAM Key Catalog: [0-256]"
	range 0 256
	default "2"
	help
	  The HMAC Key Group ID within RAM Key Catalog.

config CRYPTO_DEV_NXP_HSE_HMAC_KEY_GSIZE
	depends on CRYPTO_DEV_NXP_HSE
	int "Number of HMAC Key Slots in HMAC Key Group: [0-256]"
	range 0 256
	default "10"
	help
	  Number of Key Slots available in the HMAC Key Group.
```

## drivers/ddr/s32-gen1/Kconfig
```kconfig
# SPDX-License-Identifier: GPL-2.0-only

config NXP_ERRATUM_ERR050543
	tristate "Workaround for NXP Erratum ERR050543"
	depends on SOC_S32GEN1
	help
	  This option enables a workaround for NXP Erratum ERR050543
	  (This erratum applies for LPDDR4 memories only. The memories
	  require a periodic refresh to maintain memory contents and the
	  refresh rate has to vary over temperature and S32G contains an
	  hardware-based automatism to carry this dynamic adjustment out.
	  This automatism however does not work under all conditions.)
```

## drivers/eeprom/Kconfig
```kconfig
menuconfig EEPROM
	tristate "EEPROM Support"
	depends on OF
	select REGMAP
	help
	  Support for EEPROM alike devices.

	  This framework is designed to provide a generic interface to EEPROM
	  from both the Linux Kernel and the userspace.

	  If unsure, say no.

if EEPROM

config EEPROM_SUNXI_SID
	tristate "Allwinner SoCs SID support"
	depends on ARCH_SUNXI
	select REGMAP_MMIO
	help
	  This is a driver for the 'security ID' available on various Allwinner
	  devices.

	  This driver can also be built as a module. If so, the module
	  will be called eeprom-sunxi-sid.

endif
```
