## drivers/firmware/oema0/Kconfig
```kconfig
config OEMA0_FIRMWARE
        bool "Firmware drivers for OEMA0"
        default y
        help
          This option selects drivers included as part of surface customization.

config OEMA0_FIRMWARE_FACTORY
        tristate "OEMA0 Factory firmware modules"
          default n
        depends on OEMA0_FIRMWARE
          select OEMA0_FACTORY_UTIL

config FACTORY_UTIL
	def_bool y
  depends on OEMA0_FIRMWARE && OEMA0_FIRMWARE_FACTORY

config OEMA0_LIBRARY
	def_bool y
```

## drivers/firmware/surface/Kconfig
```kconfig
config SURFACE_FIRMWARE
        bool "Firmware drivers for Microsoft Surface"
        default y
        help
          This option selects drivers included as part of surface customization.

config SURFACE_FIRMWARE_FACTORY
        tristate "Microsoft Surface Factory firmware modules"
          default n
        depends on SURFACE_FIRMWARE
          select SURFACE_FACTORY_UTIL

config FACTORY_UTIL
	def_bool y
  depends on SURFACE_FIRMWARE && SURFACE_FIRMWARE_FACTORY

config SURFACE_LIBRARY
	def_bool y
```

## drivers/gpu/drm/i2c/Kconfig
```kconfig
menu "I2C encoder or helper chips"
     depends on DRM && DRM_KMS_HELPER && I2C

config DRM_I2C_ADV7511
	tristate "AV7511 encoder"
	select REGMAP_I2C
	help
	  Support for the Analog Device ADV7511(W) and ADV7513 HDMI encoders.

config DRM_I2C_CH7006
	tristate "Chrontel ch7006 TV encoder"
	default m if DRM_NOUVEAU
	help
	  Support for Chrontel ch7006 and similar TV encoders, found
	  on some nVidia video cards.

	  This driver is currently only useful if you're also using
	  the nouveau driver.

config DRM_I2C_SIL164
	tristate "Silicon Image sil164 TMDS transmitter"
	default m if DRM_NOUVEAU
	help
	  Support for sil164 and similar single-link (or dual-link
	  when used in pairs) TMDS transmitters, used in some nVidia
	  video cards.

config DRM_I2C_NXP_TDA998X
	tristate "NXP Semiconductors TDA998X HDMI encoder"
	default m if DRM_TILCDC
	help
	  Support for NXP Semiconductors TDA998X HDMI encoders.

config DRM_ICN_6201
        tristate "ICN6201 --- MIPI DSI BRIDGE TO FLATLINKTM LVDS"
        depends on OF
        depends on DRM_MIPI_DSI
       # depends on BACKLIGHT_CLASS_DEVICE
        help
          Say Y here if you want to enable support for ICN6201

endmenu
```

## drivers/infiniband/hw/vmbus-rdma/Kconfig
```kconfig
config HYPERV_INFINIBAND_ND 
	tristate "Microsoft Hyper-V Network Direct"
	depends on PCI && INET && INFINIBAND && HYPERV && X86_64
	---help---
	  This is a low-level driver for Vmbus based NetworkDirect. 
```

## drivers/mailbox/Kconfig
```kconfig
menuconfig MAILBOX
	bool "Mailbox Hardware Support"
	help
	  Mailbox is a framework to control hardware communication between
	  on-chip processors through queued messages and interrupt driven
	  signals. Say Y if your platform supports hardware mailboxes.

if MAILBOX
config ARM_MHU_MBOX
	bool "ARM Message Handling Unit (MHU) Mailbox"
	help
	  This driver provides support for inter-processor communication
	  between System Control Processor (SCP) with Cortex-M3 processor
	  and Application Processors (AP) on some ARM based systems with
	  MHU peripheral.

	  SCP controls most of the power managament on the Application
	  Processors. It offers control and management of: the core/cluster
	  power states, various power domain DVFS including the core/cluster,
	  certain system clocks configuration, thermal sensors and many
	  others.

config ARM_SCPI_PROTOCOL
	bool "ARM System Control and Power Interface (SCPI) Message Protocol"
	select ARM_MHU_MBOX
	help
	  System Control and Power Interface (SCPI) Message Protocol is
	  defined for the purpose of communication between the Application
	  Cores(AP) and the System Control Processor(SCP). The MHU peripheral
	  provides a mechanism for inter-processor communication between SCP
	  and AP.

	  This protocol library provides interface for all the client drivers
	  making use of the features offered by the SCP.

config PL320_MBOX
	bool "ARM PL320 Mailbox"
	depends on ARM_AMBA
	help
	  An implementation of the ARM PL320 Interprocessor Communication
	  Mailbox (IPCM), tailored for the Calxeda Highbank. It is used to
	  send short messages between Highbank's A9 cores and the EnergyCore
	  Management Engine, primarily for cpufreq. Say Y here if you want
	  to use the PL320 IPCM support.

endif
```

## drivers/media/platform/msm/Kconfig
```kconfig
# MSM camera configuration
#

comment "Qualcomm MSM Camera And Video"

source "drivers/media/platform/msm/camss-8x16/Kconfig"
source "drivers/media/platform/msm/cci/Kconfig"
source "drivers/media/platform/msm/vidc/Kconfig"
```

## drivers/media/platform/msm/ais/cam_sensor_module/Kconfig
```kconfig
config MSM_AIS_SENSOR_SERDES
            bool "QTI AIS camera sensor SerDes support"
            depends on MSM_AIS
        ---help---
          This flag enables support for AIS Camera Sensor SerDes.
          The sensor driver is capable of providing real time
          data for camera support. The driver support V4L2
          subdev APIs.
```

## drivers/media/platform/msm/camss-8x16/Kconfig
```kconfig
#
# CAMERA SUB-SYTEM
#

menuconfig MSM_CAMSS_V4L2
	tristate "Qualcomm MSM 8x16 V4L2 based camera sub-system driver"
	depends on ARCH_QCOM && VIDEO_V4L2
#	select ARM64_DMA_USE_IOMMU
	select VIDEOBUF2_DMA_CONTIG
```

## drivers/media/platform/msm/vidc/Kconfig
```kconfig
#
# VIDEO CORE
#

menuconfig MSM_VIDC_V4L2
	tristate "Qualcomm MSM V4L2 based video driver"
	depends on ARCH_QCOM && VIDEO_V4L2
	select ARM64_DMA_USE_IOMMU
	select VIDEOBUF2_DMA_CONTIG
```

## drivers/media/platform/qcom/Kconfig
```kconfig
menuconfig VIDEO_QCOM_CAMSS
	tristate "Qualcomm 8x16 V4L2 Camera Subsystem driver"
	depends on ARCH_QCOM && VIDEO_V4L2
	select VIDEOBUF2_DMA_CONTIG

source "drivers/media/platform/qcom/cci/Kconfig"
```

## drivers/media/platform/qcom/cci/Kconfig
```kconfig
#
# CAMERA CONTROL INTERFACE
#

menuconfig MSM_CCI
	tristate "Qualcomm MSM camera control interface driver"
	depends on ARCH_QCOM
```
