/*
 * Copyright 2014 Freescale Semiconductor, Inc.
 *
 * This program is free software; you can redistribute it and/or modify
 * it under the terms of the GNU General Public License as published by
 * the Free Software Foundation; either version 2 of the License, or
 * (at your option) any later version.
 */

/dts-v1/;
#include "sac58r.dtsi"

/ {
	model = "Rayleigh Palladium";
	compatible = "fsl,sac58r-palladium", "fsl,sac58r";


	chosen {
		bootargs = "console=ttyLP0,1200 lpj=1394688";
	};

	memory {
		reg = <0x80000000 0x8000000>;
	};
};

&uart0 {
	status = "okay";
};
