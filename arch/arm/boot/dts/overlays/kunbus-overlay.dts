/dts-v1/;

/ {
	compatible = "brcm,bcm2835", "brcm,bcm2836", "brcm,bcm2708", "brcm,bcm2709", "brcm,bcm2710";

	fragment@0 {
		target = <0xdeadbeef>;

		__overlay__ {
			status = "okay";
			bcm2835,rt_prio = <60>;

			spidev@0 {
				status = "disabled";
			};

			spidev@1 {
				status = "disabled";
			};
		};
	};

	fragment@1 {
		target = <0xdeadbeef>;

		__overlay__ {
			brcm,pins = <0x3 0x4 0x25 0x26 0x27>;
		};
	};

	__fixups__ {
		spi0 = "/fragment@0:target:0";
		spi0_pins = "/fragment@1:target:0";
	};
};
