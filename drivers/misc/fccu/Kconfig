## image.its
```
/*
 * Simple U-Boot uImage source file containing a single kernel, ramdisk and FDT blob
 */

/dts-v1/;

/ {
    description = "Simple image with single Linux kernel, ramdisk and FDT blob";
    #address-cells = <1>;

    images {
        kernel-1 {
            description = "Ubuntu kernel";
            data = /incbin/("./Image");
            type = "kernel";
            arch = "arm64";
            os = "linux";
            compression = "none";
            load = <0x00080000>;
            entry = <0x00080000>;
            hash-1 {
                algo = "sha1";
            };
        };

        ramdisk-1 {
            description = "Ubuntu Core ramdisk";
            data = /incbin/("./initrd.img");
            type = "ramdisk";
            arch = "arm64";
            os = "linux";
            compression = "gzip";
            hash-1 {
                algo = "sha1";
            };
        };

        fdt-1 {
            description = "zcu-100 rev C Device Tree blob";
            data = /incbin/("./dtbs/xilinx/zynqmp-zcu100-revC.dtb");
            type = "flat_dt";
            arch = "arm64";
            compression = "none";
            hash-1 {
                algo = "sha1";
            };
        };
        fdt-2 {
            description = "zcu-102 rev 1.0 Device Tree blob";
            data = /incbin/("./dtbs/xilinx/zynqmp-zcu102-rev1.0.dtb");
            type = "flat_dt";
            arch = "arm64";
            compression = "none";
            hash-1 {
                algo = "sha1";
            };
        };
        fdt-3 {
            description = "zcu-102 rev A Device Tree blob";
            data = /incbin/("./dtbs/xilinx/zynqmp-zcu102-revA.dtb");
            type = "flat_dt";
            arch = "arm64";
            compression = "none";
            hash-1 {
                algo = "sha1";
            };
        };
        fdt-4 {
            description = "zcu-102 rev B Device Tree blob";
            data = /incbin/("./dtbs/xilinx/zynqmp-zcu102-revB.dtb");
            type = "flat_dt";
            arch = "arm64";
            compression = "none";
            hash-1 {
                algo = "sha1";
            };
        };
        fdt-5 {
            description = "zcu-104 rev A revCDevice Tree blob";
            data = /incbin/("./dtbs/xilinx/zynqmp-zcu104-revA.dtb");
            type = "flat_dt";
            arch = "arm64";
            compression = "none";
            hash-1 {
                algo = "sha1";
            };
        };
        fdt-6 {
            description = "zcu-104 rev C Device Tree blob";
            data = /incbin/("./dtbs/xilinx/zynqmp-zcu104-revC.dtb");
            type = "flat_dt";
            arch = "arm64";
            compression = "none";
            hash-1 {
                algo = "sha1";
            };
        };
        fdt-7 {
            description = "zcu-106 rev A Device Tree blob";
            data = /incbin/("./dtbs/xilinx/zynqmp-zcu106-revA.dtb");
            type = "flat_dt";
            arch = "arm64";
            compression = "none";
            hash-1 {
                algo = "sha1";
            };
        };
        fdt-8 {
            description = "zcu-111 rev A Device Tree blob";
            data = /incbin/("./dtbs/xilinx/zynqmp-zcu111-revA.dtb");
            type = "flat_dt";
            arch = "arm64";
            compression = "none";
            hash-1 {
                algo = "sha1";
            };
        };
    };

    configurations {
        default = "zcu-102";
        zcu-100 {
            description = "Boot Ubuntu Core on zcu-100";
            kernel = "kernel-1";
            ramdisk = "ramdisk-1";
            fdt = "fdt-1";
            hash-1 {
                algo = "sha1";
            };
        };
        zcu-102 {
            description = "Boot Ubuntu Core on zcu-102 rev 1";
            kernel = "kernel-1";
            ramdisk = "ramdisk-1";
            fdt = "fdt-2";
            hash-1 {
                algo = "sha1";
            };
        };
        zcu-102-a {
            description = "Boot Ubuntu Core on zcu-102 rev A";
            kernel = "kernel-1";
            ramdisk = "ramdisk-1";
            fdt = "fdt-3";
            hash-1 {
                algo = "sha1";
            };
        };
        zcu-102-b {
            description = "Boot Ubuntu Core on zcu-102 rev B";
            kernel = "kernel-1";
            ramdisk = "ramdisk-1";
            fdt = "fdt-4";
            hash-1 {
                algo = "sha1";
            };
        };
        zcu-104-a {
            description = "Boot Ubuntu Core on zcu-104 rev A";
            kernel = "kernel-1";
            ramdisk = "ramdisk-1";
            fdt = "fdt-5";
            hash-1 {
                algo = "sha1";
            };
        };
        zcu-104-c {
            description = "Boot Ubuntu Core on zcu-104 rev C";
            kernel = "kernel-1";
            ramdisk = "ramdisk-1";
            fdt = "fdt-6";
            hash-1 {
                algo = "sha1";
            };
        };
        zcu-106-c {
            description = "Boot Ubuntu Core on zcu-106 rev C";
            kernel = "kernel-1";
            ramdisk = "ramdisk-1";
            fdt = "fdt-7";
            hash-1 {
                algo = "sha1";
            };
        };
        zcu-111-a {
            description = "Boot Ubuntu Core on zcu-111 rev A";
            kernel = "kernel-1";
            ramdisk = "ramdisk-1";
            fdt = "fdt-8";
            hash-1 {
                algo = "sha1";
            };
        };
    };
};
```

## kernel_arm64.its
```
/*
 * U-Boot uImage source file with multiple kernels, ramdisks and FDT blobs
 */

/dts-v1/;

/ {
	description = "Ubuntu Core kernel, ramdisk and FDT blobs for i.MX8M board family";
	#address-cells = <1>;

	images {
		kernel-ubuntu {
			description = "ubuntu-kernel";
			data = /incbin/("./Image");
			type = "kernel";
			arch = "arm64";
			os = "linux";
			compression = "none";
			load =  <0x80080000>;
			entry = <0x80080000>;
			hash-1 {
				algo = "sha256";
			};
		};

		ramdisk-uc {
			description = "Ubuntu-Core-ramdisk";
			data = /incbin/("./initrd.img");
			type = "ramdisk";
			arch = "arm64";
			os = "linux";
			compression = "none";
			hash-1 {
				algo = "sha256";
			};
		};

		fsl-s32g274a-rdb2 {
			description = "s32g274ardb2";
			data = /incbin/("./dtbs/freescale/fsl-s32g274a-rdb2.dtb");
			type = "flat_dt";
			arch = "arm64";
			compression = "none";
			hash-1 {
				algo = "sha256";
			};
		};

	};

	configurations {
	default = "fsl-s32g274a-rdb2.dtb";

		fsl-s32g274a-rdb2.dtb {
			description = "s32g274a-rdb2";
			kernel = "kernel-ubuntu";
			ramdisk = "ramdisk-uc";
			fdt = "fsl-s32g274a-rdb2";
			signature@1 {
				algo = "sha256,rsa2048";
				key-name-hint="dev-key";
				sign-images="fdt","kernel", "ramdisk";
			};
		};

	};
};
```

## kernel_armhf.its
```
/*
 * U-Boot uImage source file with multiple kernels, ramdisks and FDT blobs
 */

/dts-v1/;

/ {
	description = "Ubuntu Core kernel, ramdisk and FDT blobs for i.MX8M board family";
	#address-cells = <1>;

	images {
		kernel-ubuntu {
			description = "ubuntu-kernel";
			data = /incbin/("./Image");
			type = "kernel";
			arch = "arm";
			os = "linux";
			compression = "none";
			load =  <0x80800000>;
			entry = <0x80800000>;
			hash-1 {
				algo = "sha256";
			};
		};

		ramdisk-uc {
			description = "Ubuntu-Core-ramdisk";
			data = /incbin/("./initrd.img");
			type = "ramdisk";
			arch = "arm";
			os = "linux";
			compression = "none";
			load =  <0x83800000>;
			entry = <0x83800000>;
			hash-1 {
				algo = "sha256";
			};
		};

		fdt-imx6sx-sdb {
			description = "i.MX6SoloX-SabreSD";
			data = /incbin/("./dtbs/imx6sx-sdb.dtb");
			type = "flat_dt";
			arch = "armhf";
			compression = "none";
			load =  <0x43000000>;
			entry = <0x43000000>;
			hash-1 {
				algo = "sha256";
			};
		};
	};

	configurations {
		default = "imx6sx-sdb.dtb";

		imx6sx-sdb.dtb {
			description = "i.MX6SoloX-Sabre Smart Devices";
			kernel = "kernel-ubuntu";
			ramdisk = "ramdisk-uc";
			fdt = "fdt-imx6sx-sdb";
			signature@1 {
				algo = "sha256,rsa2048";
				key-name-hint="dev-key";
				sign-images="fdt","kernel", "ramdisk";
			};
		};
	};
};
```

## sound/soc/msm/Kconfig
```kconfig
menu "MSM SoC Audio support"

config SND_MSM_DAI_SOC
	tristate

config SND_MSM_SOC
	tristate "SoC Audio for the MSM series chips"
	depends on ARCH_MSM7X27
	select SND_MSM_DAI_SOC
	select SND_MSM_SOC_MSM7K
	default n
	help
	  To add support for ALSA PCM driver for MSM board.

#8660 Variants
config SND_SOC_MSM8X60_PCM
	tristate

config SND_SOC_MSM8X60_DAI
	tristate

config SND_SOC_MSM_QDSP6_HDMI_AUDIO
	tristate "Soc QDSP6 HDMI Audio DAI driver"
	depends on FB_MSM_HDMI_MSM_PANEL || DRM_MSM
	default n
	help
	 To support HDMI Audio on MSM8960 over QDSP6.

config SND_SOC_MSM_QDSP6_INTF
	bool "SoC Q6 audio driver for MSM8960"
	default n
	help
	 To add support for SoC audio on MSM8960.

config SND_SOC_MSM_QDSP6V2_INTF
	bool "SoC Q6 audio driver for MSM8974"
	help
	 To add support for SoC audio on MSM8974.
	 This will enable all the platform specific
	 interactions towards DSP. It includes asm,
	 adm and afe interfaces on the DSP.


config SND_SOC_QDSP6
	tristate "SoC ALSA audio driver for QDSP6"
	select SND_SOC_MSM_QDSP6_INTF
	default n
	help
	 To add support for MSM QDSP6 Soc Audio.

config SND_SOC_QDSP6V2
	tristate "SoC ALSA audio driver for QDSP6V2"
	select SND_SOC_MSM_QDSP6V2_INTF
	help
	 To add support for MSM QDSP6V2 Soc Audio.
	 This will enable sound soc platform specific
	 audio drivers. This includes q6asm, q6adm,
	 q6afe interfaces to DSP using apr.

config SND_SOC_MSM8960
	tristate "SoC Machine driver for MSM8960 and APQ8064 boards"
	depends on ARCH_MSM8960 || ARCH_APQ8064
	select SND_SOC_VOICE
	select SND_SOC_QDSP6
	select SND_SOC_MSM_STUB
	select SND_SOC_MSM_HOSTLESS_PCM
	select SND_SOC_MSM_QDSP6_HDMI_AUDIO if FB_MSM_HDMI_MSM_PANEL
	default n
	help
	 To add support for SoC audio on MSM8960 and APQ8064 boards

endmenu
```

## sound/soc/qcom/Kconfig
```kconfig
config SND_SOC_QCOM
	tristate "ASoC support for QCOM platforms"
	depends on ARCH_QCOM || COMPILE_TEST
	help
          Say Y or M if you want to add support to use audio devices
          in Qualcomm Technologies SOC-based platforms.

config SND_SOC_LPASS_CPU
	tristate
	select REGMAP_MMIO

config SND_SOC_LPASS_PLATFORM
	tristate
	select REGMAP_MMIO

config SND_SOC_LPASS_IPQ806X
	tristate
	select SND_SOC_LPASS_CPU
	select SND_SOC_LPASS_PLATFORM

config SND_SOC_LPASS_APQ8016
	tristate
	select SND_SOC_LPASS_CPU
	select SND_SOC_LPASS_PLATFORM

config SND_SOC_STORM
	tristate "ASoC I2S support for Storm boards"
	depends on SND_SOC_QCOM
	select SND_SOC_LPASS_IPQ806X
	select SND_SOC_MAX98357A
	help
          Say Y or M if you want add support for SoC audio on the
          Qualcomm Technologies IPQ806X-based Storm board.

config SND_SOC_APQ8016_SBC
	tristate "SoC Audio support for APQ8016 SBC platforms"
	depends on SND_SOC_QCOM
	select SND_SOC_LPASS_APQ8016
	help
          Support for Qualcomm Technologies LPASS audio block in
          APQ8016 SOC-based systems.
          Say Y if you want to use audio devices on MI2S.

menu "QCOM QDSP Audio support"

config SND_MSM_DAI_SOC
	tristate

config SND_MSM_SOC
	tristate "SoC Audio for the MSM series chips"
	select SND_MSM_DAI_SOC
	select SND_MSM_SOC_MSM7K
	default n
	help
	  To add support for ALSA PCM driver for MSM board.

config SND_SOC_MSM_QDSP6_HDMI_AUDIO
	tristate "Soc QDSP6 HDMI Audio DAI driver"
	default n
	help
	 To support HDMI Audio on MSM8960 over QDSP6.

config SND_SOC_MSM_QDSP6_INTF
	bool "SoC Q6 audio driver for MSM8960"
	default n
	help
	 To add support for SoC audio on MSM8960.

config SND_SOC_MSM_QDSP6V2_INTF
	bool "SoC Q6 audio driver for MSM8974"
	help
	 To add support for SoC audio on MSM8974.
	 This will enable all the platform specific
	 interactions towards DSP. It includes asm,
	 adm and afe interfaces on the DSP.


config SND_SOC_QDSP6
	tristate "SoC ALSA audio driver for QDSP6"
	select SND_SOC_MSM_QDSP6_INTF
	default n
	help
	 To add support for MSM QDSP6 Soc Audio.

config SND_SOC_QDSP6V2
	tristate "SoC ALSA audio driver for QDSP6V2"
	select SND_SOC_MSM_QDSP6V2_INTF
	help
	 To add support for MSM QDSP6V2 Soc Audio.
	 This will enable sound soc platform specific
	 audio drivers. This includes q6asm, q6adm,
	 q6afe interfaces to DSP using apr.

config SND_SOC_MSM8960
	tristate "SoC Machine driver for MSM8960 and APQ8064 boards"
	select SND_SOC_QDSP6
	select SND_SOC_MSM_STUB
	select SND_SOC_MSM_HOSTLESS_PCM
	select SND_SOC_MSM_QDSP6_HDMI_AUDIO if FB_MSM_HDMI_MSM_PANEL
	default n
	help
	 To add support for SoC audio on MSM8960 and APQ8064 boards

endmenu
```

## ubuntu/bnxt/Kconfig
```kconfig
config BNXT_BPO
	tristate "Broadcom NetXtreme-C/E support"
	depends on PCI
	depends on VXLAN || VXLAN=n
	select FW_LOADER
	select LIBCRC32C
	---help---
	  This driver supports Broadcom NetXtreme-C/E 10/25/40/50 gigabit
	  Ethernet cards.  To compile this driver as a module, choose M here:
	  the module will be called bnxt_en_bpo.  This is recommended.

config BNXT_BPO_SRIOV
	bool "Broadcom NetXtreme-C/E SR-IOV support"
	depends on BNXT_BPO && PCI_IOV
	default y
	---help---
	  This configuration parameter enables Single Root Input Output
	  Virtualization support in the NetXtreme-C/E products. This
	  allows for virtual function acceleration in virtual environments.

config BNXT_BPO_DCB
	bool "Data Center Bridging (DCB) Support"
	default n
	depends on BNXT_BPO && DCB
	---help---
	  Say Y here if you want to use Data Center Bridging (DCB) in the
	  driver.

	  If unsure, say N.
```

## ubuntu/opennsl/Kconfig
```kconfig
#
# OpenNSL configuration
#

menuconfig OPENNSL
	bool "OpenNSL options"
	depends on NET

if OPENNSL
config OPENNSL_KERNEL_BDE
	default y
	tristate "OpenNSL kernel BDE"

config OPENNSL_BCM_KNET
	default y
	depends on OPENNSL_KERNEL_BDE
	tristate "OpenNSL KNET support"

config OPENNSL_USER_BDE
	default y
	depends on OPENNSL_KERNEL_BDE
	tristate "OpenNSL user BDE"
endif
```
