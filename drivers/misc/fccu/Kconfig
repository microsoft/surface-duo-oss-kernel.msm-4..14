## drivers/misc/fccu/Kconfig
```kconfig
#
# FCCU device configuration
#

config FCCU
	tristate "Fault Collection and Control Unit"
	depends on SOC_S32V234 || SOC_S32GEN1
	default y
	help
	  This is the driver for Fault Collection and Control Unit
	  on the Freescale/NXP S32V234 and S32Gen1 SoC.
```

## drivers/mmc/core/Kconfig
```kconfig
#
# MMC core configuration
#
config PWRSEQ_EMMC
	tristate "PwrSeq EMMC"
	depends on OF

config PWRSEQ_SIMPLE
	tristate "PwrSeq Simple"
	depends on OF
```

## drivers/phy/freescale/Kconfig
```kconfig
# SPDX-License-Identifier: GPL-2.0-only
config PHY_FSL_IMX8MQ_USB
	tristate "Freescale i.MX8M USB3 PHY"
	depends on OF && HAS_IOMEM
	select GENERIC_PHY
	default ARCH_MXC && ARM64

config PHY_MIXEL_MIPI_DPHY
	tristate "Mixel MIPI DSI PHY support"
	depends on OF && HAS_IOMEM
	select GENERIC_PHY
	select GENERIC_PHY_MIPI_DPHY
	select REGMAP_MMIO
	help
	  Enable this to add support for the Mixel DSI PHY as found
	  on NXP's i.MX8 family of SOCs.

config PHY_S32GEN1_SERDES
	tristate "NXP S32GEN1 SERDES support"
	depends on OF && SOC_S32GEN1
	help
	  This option enables support for S32GEN1 SerDes PHY used for
	  PCIe & Ethernet
```

## drivers/soc/fsl/Kconfig
```kconfig
#
# NXP/Freescale QorIQ series SOC drivers
#

source "drivers/soc/fsl/qbman/Kconfig"
source "drivers/soc/fsl/qe/Kconfig"

config FSL_GUTS
	bool
	select SOC_BUS
	help
	  The global utilities block controls power management, I/O device
	  enabling, power-onreset(POR) configuration monitoring, alternate
	  function selection for multiplexed signals,and clock control.
	  This driver is to manage and access global utilities block.
	  Initially only reading SVR and registering soc device are supported.
	  Other guts accesses, such as reading RCW, should eventually be moved
	  into this driver as well.

menu "NXP/Freescale QorIQ SoC drivers"

config FSL_MC_DPIO
        tristate "QorIQ DPAA2 DPIO driver"
        depends on FSL_MC_BUS
        help
	  Driver for the DPAA2 DPIO object.  A DPIO provides queue and
	  buffer management facilities for software to interact with
	  other DPAA2 objects. This driver does not expose the DPIO
	  objects individually, but groups them under a service layer
	  API.

endmenu

menu "NXP SoC drivers"

config S32_DEBUG_REGACCESS
	bool "Userspace access to SoC registers"
	help
	  Enabling this option leads to the creation of entries in
	  /sys/kernel/s32_regaccess which can be used to read and write
	  SoC registers from userspace.

endmenu
```

## drivers/soc/qcom/Kconfig
```kconfig
#
# QCOM Soc drivers
#
config QCOM_GSBI
        tristate "QCOM General Serial Bus Interface"
        depends on ARCH_QCOM
        help
          Say y here to enable GSBI support.  The GSBI provides control
          functions for connecting the underlying serial UART, SPI, and I2C
          devices to the output pins.

config QCOM_SCM
	bool

config QCOM_PM
	bool "Qualcomm Power Management"
	depends on ARCH_QCOM
	help
	  QCOM Platform specific power driver to manage cores and L2 low power
	  modes. It interface with various system drivers to put the cores in
	  low power modes.

config QCOM_SMD
	tristate "Shared Memory device"
	---help---
          Supports the Shared memory device

config MSM_PIL
        tristate "MSM Periphera Loader"
        depends on ARCH_QCOM
        help
          Say y here to enable Periphera loader support.  The PIL provides support
          to download firmware securely and reset peripherials.

config MSM_PIL_Q6V4
        tristate "MSM Periphera Loader for QDSP 6V4"
        depends on MSM_PIL
        help
          Say y here to enable Periphera loader support for QDSP.

config MSM_REMOTE_SPINLOCKS
        tristate "MSM Remote Spinlocks"
        depends on ARCH_QCOM
        help
          Say y here to enable Remote Spinlock support.
```

## drivers/staging/android/ion/Kconfig
```kconfig
menuconfig ION
	bool "Ion Memory Manager"
	depends on HAVE_MEMBLOCK
	select GENERIC_ALLOCATOR
	select DMA_SHARED_BUFFER
	---help---
	  Chose this option to enable the ION Memory Manager,
	  used by Android to efficiently allocate buffers
	  from userspace that can be shared between drivers.
	  If you're not using Android its probably safe to
	  say N here.

config ION_TEST
	tristate "Ion Test Device"
	depends on ION
	help
	  Choose this option to create a device that can be used to test the
	  kernel and device side ION functions.

config ION_DUMMY
	bool "Dummy Ion driver"
	depends on ION
	help
	  Provides a dummy ION driver that registers the
	  /dev/ion device and some basic heaps. This can
	  be used for testing the ION infrastructure if
	  one doesn't have access to hardware drivers that
	  use ION.

config ION_TEGRA
	tristate "Ion for Tegra"
	depends on ARCH_TEGRA && ION
	help
	  Choose this option if you wish to use ion on an nVidia Tegra.

config ION_JUNO
	bool "Ion for Juno board"
	depends on ION
	help
	  ION support for arm juno reference board.

config ION_COMPOUND_PAGE
	bool "Ion compound page system pool"
	depends on ION
	help
	  Enable use of compound pages (default to 2MB) system memory pool.
	  Backs a buffer with large and aligned pages where possible,
	  to ease TLB pressure and lessen memory fragmentation.

config ION_COMPOUND_PAGE_STATS
	bool "Collect statistics for the compound page pool"
	depends on ION_COMPOUND_PAGE && DEBUG_FS
	help
	  Collect extra usage statistics for the compound page pool.
	  Available via ion's debugfs entry for the pool.
```

## drivers/staging/goldfish/Kconfig
```kconfig
config GOLDFISH_AUDIO
	tristate "Goldfish AVD Audio Device"
	depends on GOLDFISH
	help
	  Emulated audio channel for the Goldfish Android Virtual Device

config GOLDFISH_SYNC
	tristate "Goldfish AVD Sync Driver"
	depends on GOLDFISH
	depends on SW_SYNC
	depends on SYNC_FILE
	help
	  Emulated sync fences for the Goldfish Android Virtual Device
```

## drivers/thermal/qcom/Kconfig
```kconfig
config QCOM_TSENS
	tristate "Qualcomm Tsens Temperature Alarm"
	depends on THERMAL
	depends on QCOM_QFPROM
	help
	  This enables the thermal sysfs driver for the Tsens device. It shows
	  up in Sysfs as a thermal zone with multiple trip points. Disabling the
	  thermal zone device via the mode file results in disabling the sensor.
	  Also able to set threshold temperature for both hot and cold and update
	  when a threshold is reached.
```

## drivers/video/Kconfig
```kconfig
#
# Video configuration
#

menu "Graphics support"
	depends on HAS_IOMEM

config HAVE_FB_ATMEL
	bool

config SH_LCD_MIPI_DSI
	bool

source "drivers/char/agp/Kconfig"
source "drivers/gpu/vga/Kconfig"
source "drivers/gpu/host1x/Kconfig"
source "drivers/gpu/ipu-v3/Kconfig"
source "drivers/video/mxc/Kconfig"

source "drivers/gpu/drm/Kconfig"

menu "Frame buffer Devices"
source "drivers/video/fbdev/Kconfig"
endmenu

source "drivers/video/backlight/Kconfig"

config VGASTATE
       tristate
       default n

config VIDEOMODE_HELPERS
	bool

config HDMI
	bool

if VT
	source "drivers/video/console/Kconfig"
endif

if FB || SGI_NEWPORT_CONSOLE
	source "drivers/video/logo/Kconfig"

endif

menuconfig FB
	tristate "Support for frame buffer devices"
	---help---
	  The frame buffer device provides an abstraction for the graphics
	  hardware. It represents the frame buffer of some video hardware and
	  allows application software to access the graphics hardware through
	  a well-defined interface, so the software doesn't need to know
	  anything about the low-level (hardware register) stuff.

	  Frame buffer devices work identically across the different
	  architectures supported by Linux and make the implementation of
	  application programs easier and more portable; at this point, an X
	  server exists which uses the frame buffer device exclusively.
	  On several non-X86 architectures, the frame buffer device is the
	  only way to use the graphics hardware.

	  The device is accessed through special device nodes, usually located
	  in the /dev directory, i.e. /dev/fb*.

	  You need an utility program called fbset to make full use of frame
	  buffer devices. Please read <file:Documentation/fb/framebuffer.txt>
	  and the Framebuffer-HOWTO at
	  <http://www.munted.org.uk/programming/Framebuffer-HOWTO-1.3.html> for more
	  information.

	  Say Y here and to the driver for your graphics board below if you
	  are compiling a kernel for a non-x86 architecture.

	  If you are compiling for the x86 architecture, you can say Y if you
	  want to play with it, but it is not essential. Please note that
	  running graphical applications that directly touch the hardware
	  (e.g. an accelerated X server) and that are not frame buffer
	  device-aware may cause unexpected results. If unsure, say N.

config FB_MODE_HELPERS
        bool "Enable Video Mode Handling Helpers"
        depends on FB
	default n
	---help---
	  This enables functions for handling video modes using the
	  Generalized Timing Formula and the EDID parser. A few drivers rely
          on this feature such as the radeonfb, rivafb, and the i810fb. If
	  your driver does not take advantage of this feature, choosing Y will
	  just increase the kernel size by about 5K.

config FB_MXS
	tristate "MXS LCD framebuffer support"
	depends on FB
	select FB_CFB_FILLRECT
	select FB_CFB_COPYAREA
	select FB_CFB_IMAGEBLIT
	select FB_MODE_HELPERS
	select VIDEOMODE_HELPERS
	help
	  Framebuffer support for the MXS SoC.

config FB_FSL
	tristate "Freescale FB support"
	depends on FB
	select FB_CFB_FILLRECT
	select FB_CFB_COPYAREA
	select FB_CFB_IMAGEBLIT
	select VIDEOMODE_HELPERS
	select FB_MODE_HELPERS
	---help---
	FB driver for the Freescale SoC DCU
config DCU_FSL
	tristate "Freescale DCU support"
	depends on FB
	select FB_CFB_FILLRECT
	select FB_CFB_COPYAREA
	select FB_CFB_IMAGEBLIT
	select VIDEOMODE_HELPERS
	select FB_MODE_HELPERS
	---help---
	DCU driver for the Freescale SoC DCU
config DEC200_FSL
	tristate "Freescale DEC200 support"
	depends on DCU_FSL
	default n
	---help---
	DEC200 driver for the Freescale SoC DEC200
endmenu
```

## drivers/video/si/Kconfig
```kconfig
config SIL164_SIMPLE
	tristate "Silicon Image sil164 TMDS transmitter simple"
	depends on I2C
	help
	  Support for sil164 simple used in some cl-sb-som boards.
```

## fit-image/kernel.its
```
/*
 * Simple U-Boot uImage source file containing a single kernel, ramdisk and FDT blob
 */

/dts-v1/;

/ {
    description = "Simple image with single Linux kernel, ramdisk and FDT blob";
    #address-cells = <1>;

    images {
        kernel@1 {
            description = "snapdragon Ubuntu Core kernel";
            data = /incbin/("./Image-4.4");
            type = "kernel";
            arch = "arm64";
            os = "linux";
            compression = "none";
            load = <0x80080000>;
            entry = <0x80080000>;
            hash@1 {
                algo = "crc32";
            };
            hash@2 {
                algo = "sha1";
            };
            signature@1 {
                algo = "sha256,rsa2048";
                key-name-hint = "ondra";
                sign-images = "kernel";
            };
            signature@2 {
                algo = "sha256,rsa2048";
                key-name-hint = "ubuntu";
                sign-images = "kernel";
            };
        };

        ramdisk@1 {
            description = "Ubuntu Core ramdisk";
            data = /incbin/("./initrd.img");
            type = "ramdisk";
            arch = "arm64";
            os = "linux";
            compression = "gzip";
            load = <0x84000000>;
            entry = <0x84000000>;
            hash@1 {
                algo = "crc32";
            };
            hash@2 {
                algo = "sha1";
            };
            signature@1 {
                algo = "sha256,rsa2048";
                key-name-hint = "ondra";
                sign-images = "ramdisk";
            };
            signature@2 {
                algo = "sha256,rsa2048";
                key-name-hint = "ubuntu";
                sign-images = "ramdisk";
            };
        };

        fdt@1 {
            description = "DB410c Device Tree blob";
            data = /incbin/("./dtbs/apq8016-sbc.dtb");
            type = "flat_dt";
            arch = "arm64";
            compression = "none";
                load = <0x83000000>;
                entry = <0x83000000>;
            hash@1 {
                algo = "crc32";
            };
            hash@2 {
                algo = "sha1";
            };
            signature@1 {
                algo = "sha256,rsa2048";
                key-name-hint = "ondra";
                sign-images = "fdt";
            };
            signature@2 {
                algo = "sha256,rsa2048";
                key-name-hint = "ubuntu";
                sign-images = "fdt";
            };
        };
    };

    configurations {
        default = "config@1";
        config@1 {
            description = "Boot Ubuntu Core with DB410c FDT blob";
            kernel = "kernel@1";
            ramdisk = "ramdisk@1";
            fdt = "fdt@1";
            hash@1 {
                algo = "crc32";
            };
            hash@2 {
                algo = "sha1";
            };
            signature@1 {
                algo = "sha256,rsa2048";
                key-name-hint = "ondra";
                sign-images = "kernel", "ramdisk","fdt";
            };
            signature@2 {
                algo = "sha256,rsa2048";
                key-name-hint = "ubuntu";
                sign-images = "kernel", "ramdisk","fdt";
            };
        };
    };
};
```

## fs/crypto/Kconfig
```kconfig
config FS_ENCRYPTION
	bool "FS Encryption (Per-file encryption)"
	select CRYPTO
	select CRYPTO_AES
	select CRYPTO_CBC
	select CRYPTO_ECB
	select CRYPTO_XTS
	select CRYPTO_CTS
	select CRYPTO_SHA512
	select CRYPTO_HMAC
	select KEYS
	help
	  Enable encryption of files and directories.  This
	  feature is similar to ecryptfs, but it is more memory
	  efficient since it avoids caching the encrypted and
	  decrypted pages in the page cache.  Currently Ext4,
	  F2FS and UBIFS make use of this feature.

config ENABLE_LEGACY_PFK
	bool "Legacy method to generate per file key"
	depends on PFK
	default n
	help
	  Enable legacy method to generate aes keys derived
	  from nonce and master key. In private mode the keys
	  will be use as file encryption keys and set into
	  inline crypto engine hardware.
```
